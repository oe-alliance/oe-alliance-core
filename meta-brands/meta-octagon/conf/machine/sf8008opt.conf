## meta-brands/meta-octagon/conf/machine/sf8008opt.conf
```bitbake
#@TYPE: Machine
#@NAME: sf8008opt
#@DESCRIPTION: Machine configuration for the sf8008 optima

EXTRA_OECONF:append:pn-enigma2 = " --with-lcddev=/dev/null --with-alphablendingacceleration=always --with-blitaccelerationthreshold=250  --with-fillaccelerationthreshold=190000 --with-subttxtabnormalptsdiffs=3600000"

MACHINE_FEATURES += " no-subssupport HDMI AV_JACK multitranscoding blindscan-dvbs 7segment"

SOC_FAMILY = "hisi3798mv200h"
HICHIPSET = "3798mv200h"
LINUX_VERSION = "4.4.176"

MTD_KERNEL = "mmcblk0p12"
MTD_ROOTFS = "mmcblk0p16"

MACHINE_NAME = "SF8008 Optima 4K UHD"
RCNAME = "sf8008"

require conf/machine/include/octagon-hisi.inc
```

## meta-brands/meta-octagon/conf/machine/sf8008ta.conf
```bitbake
#@TYPE: Machine
#@NAME: sf8008ta
#@DESCRIPTION: Machine configuration for the sf8008 optima

EXTRA_OECONF:append:pn-enigma2 = "--with-lcddev=/dev/null --with-alphablendingacceleration=always --with-blitaccelerationthreshold=250  --with-fillaccelerationthreshold=190000 --with-subttxtabnormalptsdiffs=3600000"

MACHINE_FEATURES += " no-subssupport HDMI AV_JACK multitranscoding"

SOC_FAMILY = "hisi3798mv200h"
HICHIPSET = "3798mv200h"
LINUX_VERSION = "4.4.176"

MACHINE_NAME = "SF8008 Optima 4K UHD"

require conf/machine/include/octagon-hisi.inc
```

## meta-brands/meta-octagon/conf/machine/sfx6008.conf
```bitbake
#@TYPE: Machine
#@NAME: sfx6008
#@DESCRIPTION: Machine configuration for the sfx6008

EXTRA_OECONF_append_pn-enigma2 = "--with-lcddev=/dev/null --with-alphablendingacceleration=always --with-blitaccelerationthreshold=250  --with-fillaccelerationthreshold=190000 --with-subttxtabnormalptsdiffs=3600000"

MACHINE_FEATURES += " no-subssupport HDMI AV_JACK blindscan-dvbs 7segment noopengl emmc"

SOC_FAMILY = "hisi3716mv430"
HICHIPSET = "3716mv430"
LINUX_VERSION = "4.4.176"

HAVE_GLES = ""

MTD_KERNEL = "mtd10"
MTD_ROOTFS = "mtd12"

MACHINE_NAME = "SFX6008 IP"

require conf/machine/include/octagon-hisi-3716mv430.inc
```

## meta-brands/meta-octagon/conf/machine/sx88v2.conf
```bitbake
#@TYPE: Machine
#@NAME: sx88v2
#@DESCRIPTION: Machine configuration for the sx88v2

EXTRA_OECONF:append:pn-enigma2 = " --with-lcddev=/dev/null --with-alphablendingacceleration=always --with-blitaccelerationthreshold=250  --with-fillaccelerationthreshold=190000 --with-subttxtabnormalptsdiffs=3600000"

MACHINE_FEATURES += " no-subssupport HDMI AV_JACK multitranscoding blindscan-dvbs 7segment"

SOC_FAMILY = "hisi3798mv300"
HICHIPSET = "3798mv300"
LINUX_VERSION = "4.4.176"

MACHINE_NAME = "SX88V2 4K DUAL OS"

MTD_KERNEL = "mmcblk0p12"
MTD_ROOTFS = "mmcblk0p16"
RCNAME = "octagon3"

require conf/machine/include/octagon-hisi.inc
```

## meta-brands/meta-octagon/conf/machine/sx988.conf
```bitbake
#@TYPE: Machine
#@NAME: sx988
#@DESCRIPTION: Machine configuration for the sx988

EXTRA_OECONF:append:pn-enigma2 = "--with-lcddev=/dev/null --with-alphablendingacceleration=always --with-blitaccelerationthreshold=250  --with-fillaccelerationthreshold=190000 --with-subttxtabnormalptsdiffs=3600000"

MACHINE_FEATURES += " no-subssupport HDMI AV_JACK multitranscoding"

SOC_FAMILY = "hisi3798mv200advca"
HICHIPSET = "3798mv200advca"
LINUX_VERSION = "4.4.176"

MACHINE_NAME = "SX988 4K DUAL OS"

MTD_KERNEL = "mmcblk0p15"
MTD_ROOTFS = "mmcblk0p19"
RCNAME = "octagon1"

require conf/machine/include/octagon-hisi.inc
```

## meta-brands/meta-odin/conf/layer.conf
```bitbake
# We have a conf and classes directory, append to BBPATH
BBPATH .= ":${LAYERDIR}"

# We have a recipes directory, add to BBFILES
BBFILES += "${LAYERDIR}/recipes-*/*.bb ${LAYERDIR}/recipes-*/*.bbappend \
            ${LAYERDIR}/recipes-*/*/*.bb ${LAYERDIR}/recipes-*/*/*.bbappend"

BBFILE_COLLECTIONS += "odin-layer"
BBFILE_PATTERN_odin-layer := "^${LAYERDIR}/"
BBFILE_PRIORITY_odin-layer = "7"

OEA-META-ODIN-BASE := '${@os.path.normpath("${LAYERDIR}/../")}'
```

## meta-brands/meta-odin/conf/machine/include/odin-oem.inc
```bitbake
# We know about rtc
include conf/machine/include/build-extras.inc

BRAND_OEM = "odin"

MACHINE_NAME = "\
${@bb.utils.contains('MACHINEBUILD', 'classm', 'CLASS M' , '', d)}\
${@bb.utils.contains('MACHINEBUILD', 'axodin', 'AX ODIN' , '', d)}\
${@bb.utils.contains('MACHINEBUILD', 'axodinc', 'AX ODIN-C' , '', d)}\
${@bb.utils.contains('MACHINEBUILD', 'starsatlx', 'LX' , '', d)}\
${@bb.utils.contains('MACHINEBUILD', 'genius', 'genius' , '', d)}\
${@bb.utils.contains('MACHINEBUILD', 'evo', 'EVO' , '', d)}\
${@bb.utils.contains('MACHINEBUILD', 'galaxym6', 'GalaxyM6' , '', d)}\
${@bb.utils.contains('MACHINEBUILD', 'geniuse3hd', 'Genius E3HD' , '', d)}\
${@bb.utils.contains('MACHINEBUILD', 'evoe3hd', 'E3HD' , '', d)}\
${@bb.utils.contains('MACHINEBUILD', 'axase3', 'E3HD' , '', d)}\
${@bb.utils.contains('MACHINEBUILD', 'axase3c', 'E3HD-C' , '', d)}\
${@bb.utils.contains('MACHINEBUILD', 'maram9', 'M9' , '', d)}\
"

MACHINE_BRAND = "\
${@bb.utils.contains('MACHINEBUILD', 'classm', 'Axas' , '', d)}\
${@bb.utils.contains('MACHINEBUILD', 'axodin', 'Opticum' , '', d)}\
${@bb.utils.contains('MACHINEBUILD', 'axodinc', 'Opticum' , '', d)}\
${@bb.utils.contains('MACHINEBUILD', 'starsatlx', 'Starsat' , '', d)}\
${@bb.utils.contains('MACHINEBUILD', 'genius', 'Galaxy Innovations' , '', d)}\
${@bb.utils.contains('MACHINEBUILD', 'evo', 'Optibox' , '', d)}\
${@bb.utils.contains('MACHINEBUILD', 'galaxym6', 'T-rex' , '', d)}\
${@bb.utils.contains('MACHINEBUILD', 'geniuse3hd', 'Galaxy Innovations' , '', d)}\
${@bb.utils.contains('MACHINEBUILD', 'evoe3hd', 'Optibox' , '', d)}\
${@bb.utils.contains('MACHINEBUILD', 'axase3', 'Axas' , '', d)}\
${@bb.utils.contains('MACHINEBUILD', 'axase3c', 'Axas' , '', d)}\
${@bb.utils.contains('MACHINEBUILD', 'maram9', 'ODIN' , '', d)}\
"

IMAGEDIR ?= "\
${@bb.utils.contains('MACHINEBUILD', 'classm', 'en2' , '', d)}\
${@bb.utils.contains('MACHINEBUILD', 'axodin', 'en2' , '', d)}\
${@bb.utils.contains('MACHINEBUILD', 'axodinc', 'en2' , '', d)}\
${@bb.utils.contains('MACHINEBUILD', 'starsatlx', 'en2' , '', d)}\
${@bb.utils.contains('MACHINEBUILD', 'genius', 'en2' , '', d)}\
${@bb.utils.contains('MACHINEBUILD', 'evo', 'en2' , '', d)}\
${@bb.utils.contains('MACHINEBUILD', 'galaxym6', 'en2' , '', d)}\
${@bb.utils.contains('MACHINEBUILD', 'geniuse3hd', 'e3hd' , '', d)}\
${@bb.utils.contains('MACHINEBUILD', 'evoe3hd', 'e3hd' , '', d)}\
${@bb.utils.contains('MACHINEBUILD', 'axase3', 'e3hd' , '', d)}\
${@bb.utils.contains('MACHINEBUILD', 'axase3c', 'e3hd' , '', d)}\
${@bb.utils.contains('MACHINEBUILD', 'maram9', 'odinm9' , '', d)}\
"

MTD_KERNEL = "\
${@bb.utils.contains('MACHINEBUILD', 'classm', 'mtd3' , '', d)}\
${@bb.utils.contains('MACHINEBUILD', 'axodin', 'mtd3' , '', d)}\
${@bb.utils.contains('MACHINEBUILD', 'axodinc', 'mtd3' , '', d)}\
${@bb.utils.contains('MACHINEBUILD', 'starsatlx', 'mtd3' , '', d)}\
${@bb.utils.contains('MACHINEBUILD', 'genius', 'mtd3' , '', d)}\
${@bb.utils.contains('MACHINEBUILD', 'evo', 'mtd3' , '', d)}\
${@bb.utils.contains('MACHINEBUILD', 'galaxym6', 'mtd3' , '', d)}\
${@bb.utils.contains('MACHINEBUILD', 'geniuse3hd', 'mtd1' , '', d)}\
${@bb.utils.contains('MACHINEBUILD', 'evoe3hd', 'mtd1' , '', d)}\
${@bb.utils.contains('MACHINEBUILD', 'axase3', 'mtd1' , '', d)}\
${@bb.utils.contains('MACHINEBUILD', 'axase3c', 'mtd1' , '', d)}\
${@bb.utils.contains('MACHINEBUILD', 'maram9', 'mtd2' , '', d)}\
"

MTD_ROOTFS = "\
${@bb.utils.contains('MACHINEBUILD', 'classm', 'mtd4' , '', d)}\
${@bb.utils.contains('MACHINEBUILD', 'axodin', 'mtd4' , '', d)}\
${@bb.utils.contains('MACHINEBUILD', 'axodinc', 'mtd4' , '', d)}\
${@bb.utils.contains('MACHINEBUILD', 'starsatlx', 'mtd4' , '', d)}\
${@bb.utils.contains('MACHINEBUILD', 'genius', 'mtd4' , '', d)}\
${@bb.utils.contains('MACHINEBUILD', 'evo', 'mtd4' , '', d)}\
${@bb.utils.contains('MACHINEBUILD', 'galaxym6', 'mtd4' , '', d)}\
${@bb.utils.contains('MACHINEBUILD', 'geniuse3hd', 'mtd2' , '', d)}\
${@bb.utils.contains('MACHINEBUILD', 'evoe3hd', 'mtd2' , '', d)}\
${@bb.utils.contains('MACHINEBUILD', 'axase3', 'mtd2' , '', d)}\
${@bb.utils.contains('MACHINEBUILD', 'axase3c', 'mtd2' , '', d)}\
${@bb.utils.contains('MACHINEBUILD', 'maram9', 'mtd3' , '', d)}\
"

MACHINE_DRIVER = "\
${@bb.utils.contains('MACHINEBUILD', 'classm', 'odinm7' , '', d)}\
${@bb.utils.contains('MACHINEBUILD', 'axodin', 'odinm7' , '', d)}\
${@bb.utils.contains('MACHINEBUILD', 'axodinc', 'odinm7' , '', d)}\
${@bb.utils.contains('MACHINEBUILD', 'starsatlx', 'odinm7' , '', d)}\
${@bb.utils.contains('MACHINEBUILD', 'genius', 'odinm7' , '', d)}\
${@bb.utils.contains('MACHINEBUILD', 'evo', 'odinm7' , '', d)}\
${@bb.utils.contains('MACHINEBUILD', 'galaxym6', 'odinm7' , '', d)}\
${@bb.utils.contains('MACHINEBUILD', 'geniuse3hd', 'e3hd' , '', d)}\
${@bb.utils.contains('MACHINEBUILD', 'evoe3hd', 'e3hd' , '', d)}\
${@bb.utils.contains('MACHINEBUILD', 'axase3', 'e3hd' , '', d)}\
${@bb.utils.contains('MACHINEBUILD', 'axase3c', 'e3hd' , '', d)}\
${@bb.utils.contains('MACHINEBUILD', 'maram9', 'odinm9' , '', d)}\
"

KERNEL_FILE = "kernel.bin"
ROOTFS_FILE = "rootfs.bin"

DVBPROVIDER = "kernel"

MACHINE_ESSENTIAL_EXTRA_RDEPENDS = "\
    odin-dvb-modules-${MACHINE_DRIVER} \
    "

MACHINE_ESSENTIAL_EXTRA_RRECOMMENDS = "\
    kernel-module-cdfs \
    "

MACHINE_EXTRA_RRECOMMENDS = " \
    gstreamer1.0-plugin-dvbmediasink \
    "

include conf/machine/include/autoload-filesystems.inc

DVBMEDIASINK_CONFIG = "--with-wma --with-wmv --with-pcm --with-dtsdownmix"

TARGET_ARCH = "mipsel"
DEFAULTTUNE = "mips32el"

PREFERRED_PROVIDER_virtual/kernel = "linux-odin"
PREFERRED_PROVIDER_virtual/blindscan-dvbc = "odin-blindscan-utils-${MACHINE}"
PREFERRED_PROVIDER_virtual/blindscan-dvbs = "odin-blindscan-utils-${MACHINE}"

PREFERRED_VERSION_nfs-utils ?= "1.2.8"

KERNEL_IMAGETYPE = "vmlinux"
KERNEL_OUTPUT = "${KERNEL_IMAGETYPE}"
KERNEL_CONSOLE = "ttyS0,115200n8"

IMAGE_FSTYPES ?= "ubi"

UBI_VOLNAME = "rootfs"
MKUBIFS_ARGS = "-m 2048 -e 126976 -c 4096"
UBINIZE_ARGS = "-m 2048 -p 128KiB"

IMAGE_CMD_ubi_prepend = " \
    rm -rf ${IMAGE_ROOTFS}/boot/*; \
    rm -rf ${IMAGE_ROOTFS}/tmp/*; \
    "

IMAGE_CMD_ubi_append = "\
    mkdir -p ${DEPLOY_DIR_IMAGE}/${IMAGEDIR}; \
    ${@bb.utils.contains("MACHINE_FEATURES", "bootsplash", "cp ${DEPLOY_DIR_IMAGE}/${BOOTLOGO_FILENAME} ${DEPLOY_DIR_IMAGE}/${IMAGEDIR}/${BOOTLOGO_FILENAME};" , "", d)} \
    mv ${DEPLOY_DIR_IMAGE}/${IMAGE_NAME}.rootfs.ubi ${DEPLOY_DIR_IMAGE}/${IMAGEDIR}/${ROOTFS_FILE}; \
    gzip -9c ${DEPLOY_DIR_IMAGE}/vmlinux-${MACHINE}.bin > ${DEPLOY_DIR_IMAGE}/${IMAGEDIR}/${KERNEL_FILE}; \
    echo ${IMAGE_VER_STRING} > ${DEPLOY_DIR_IMAGE}/${IMAGEDIR}/imageversion; \
    echo "rename this file to 'force' to force an update without confirmation" > ${DEPLOY_DIR_IMAGE}/${IMAGEDIR}/noforce; \
    cd ${DEPLOY_DIR_IMAGE}; \  
    zip ${IMAGE_NAME}_usb.zip ${IMAGEDIR}/*; \
    rm -f ${DEPLOY_DIR_IMAGE}/*.ubi; \
    rm -f ${DEPLOY_DIR_IMAGE}/*.ubifs; \
    rm -f ${DEPLOY_DIR_IMAGE}/*.manifest; \
    rm -f ${DEPLOY_DIR_IMAGE}/.ubifs; \
    rm -f ${DEPLOY_DIR_IMAGE}/.manifest; \
    rm -Rf ${IMAGEDIR}; \
    "

MACHINE_FEATURES += "3dtv alsa hdmicec switchoff bootsplash blindscan-dvbs blindscan-dvbc omb boxmodel feature1 feature2 \
    ${@bb.utils.contains('MACHINEBUILD', 'axodinc', 'dvb-c dvbc-only' , '', d)} \
    ${@bb.utils.contains('MACHINEBUILD', 'axase3c', 'dvb-c dvbc-only' , '', d)} \
    "

BOOTLOGO_FILENAME = "splash.bin"

require conf/machine/include/tune-mips32.inc

# add support for extra feeds
PACKAGE_ARCHS += " ${MACHINEBUILD}"
```

## meta-brands/meta-odin/conf/machine/odinm7c.conf
```bitbake
require conf/machine/include/odin-oem.inc

EXTRA_IMAGEDEPENDS += "\
    enigma2-plugin-systemplugins-vfdcontrol \
    odin-backup \
    "

MACHINE_EXTRA_RDEPENDS = "\
    enigma2-plugin-systemplugins-vfdcontrol \
    odin-backup \
    "

MACHINE_FEATURES += " videoenhancement singlecore oldrewindseek"

PREFERRED_VERSION_linux-odin = "3.6.0"
PREFERRED_VERSION_linux-libc-headers = "3.6"

CHIPSET = "bcm7358"

MACHINE_KERNEL_PR = "r3"
```

## meta-brands/meta-odin/conf/machine/odinm9.conf
```bitbake
require conf/machine/include/odin-oem.inc

EXTRA_IMAGEDEPENDS += "\
    odin-backup \
    "

MACHINE_EXTRA_RDEPENDS = "\
    odin-backup \
    "

MACHINE_FEATURES += " boxmodel"

SOC_FAMILY = "bcm7413"

RCTYPE = "3"
RCNAME = "odinm9"

PREFERRED_VERSION_linux-odin = "3.6.0"

MACHINE_FEATURES += "ci fanctrl textlcd skins1080 RCA SCART YUV"
```

## meta-brands/meta-odroid/conf/layer.conf
```bitbake
# We have a conf and classes directory, add to BBPATH
BBPATH .= ":${LAYERDIR}"

# We have recipes-* directories, add to BBFILES
BBFILES += "${LAYERDIR}/recipes-*/*.bb ${LAYERDIR}/recipes-*/*.bbappend \
            ${LAYERDIR}/recipes-*/*/*.bb ${LAYERDIR}/recipes-*/*/*.bbappend"

BBFILE_COLLECTIONS += "odroid-layer"
BBFILE_PATTERN_odroid-layer = "^${LAYERDIR}/"
BBFILE_PRIORITY_odroid-layer = "7"

LAYERSERIES_COMPAT_odroid-layer = "sumo"

OEA-META-ODROID-BASE := '${@os.path.normpath("${LAYERDIR}/")}'
```

## meta-brands/meta-odroid/conf/machine/include/odroid-default-settings.inc
```bitbake
# Odroid BSP default settings
LINUX_VERSION_EXTENSION ?= ""

IMAGE_CLASSES += "image_types_odroid"
```

## meta-brands/meta-odroid/conf/machine/include/odroid.inc
```bitbake
require conf/machine/include/soc-family.inc
include conf/machine/include/autoload-filesystems.inc

# We know about rtc
include conf/machine/include/build-extras.inc

PREFERRED_PROVIDER_virtual/libgles1 = "odroid-opengl-amlogic"
PREFERRED_PROVIDER_virtual/libgles2 = "odroid-opengl-amlogic"
PREFERRED_PROVIDER_virtual/egl = "odroid-opengl-amlogic"
PREFERRED_PROVIDER_virtual/kodi = "stb-kodi-${MACHINE}"

PREFERRED_PROVIDER_jpeg = "libjpeg-turbo"
PREFERRED_PROVIDER_jpeg-native = "libjpeg-turbo-native"

EXTRA_OECONF_append_pn-enigma2 = " --with-alsa --with-alsacard=hw:0 --with-alsamixer=Master --with-fbdev=/dev/fb0 --with-lcddev=/dev/null --with-amlogic"
DEPENDS_append_pn-enigma2 = " libdvbcsa odroid-libamcodec-${MACHINE} odroid-libamadec-${MACHINE}"
EXTRA_OECONF_append_pn-tuxtxt-enigma2 = " --with-fbdev=/dev/fb0"
CC_append_pn-showiframe = " -DHAVE_AMLOGIC -I${STAGING_INCDIR}/amlogic/amcodec -lamcodec"
DEPENDS_append_pn-showiframe = " odroid-libamcodec-${MACHINE}"


MACHINE_EXTRA_RRECOMMENDS = " \
    odroid-libamplayer-${MACHINE} \
    odroid-libamavutils-${MACHINE} \
    odroid-libamadec-${MACHINE} \
    odroid-libamcodec-${MACHINE} \
    "

# Serial console to be used
SERIAL_CONSOLE = "115200 ttyS0"

DVBPROVIDER = "kernel"
DVBSKYPROVIDER = "kernel"

IMAGEDIR ?= "${MACHINE}"

IMAGE_CLASSES += "image_types_odroid"

SDCARD_ROOTFS ?= "${DEPLOY_DIR_IMAGE}/${IMAGE_NAME}.rootfs.ext4"
IMAGE_FSTYPES ?= "ext4 sdcard"

IMAGE_CMD_sdcard_append  = " \
    mkdir -p ${DEPLOY_DIR_IMAGE}/${IMAGEDIR}; \
    mv ${SDIMG} ${DEPLOY_DIR_IMAGE}/${IMAGEDIR}; \
    echo ${DISTRO_NAME}-${DISTRO_VERSION}.${BUILD_VERSION} > ${DEPLOY_DIR_IMAGE}/${IMAGEDIR}/imageversion; \
    cd ${DEPLOY_DIR_IMAGE}; \
    zip ${SDIMG}.zip ${IMAGEDIR}/*; \
    rm -f ${DEPLOY_DIR_IMAGE}/*.ext4; \
    rm -f ${DEPLOY_DIR_IMAGE}/*.manifest; \
    rm -f ${DEPLOY_DIR_IMAGE}/*.rootfs.sdcard.img; \
    rm -f ${DEPLOY_DIR_IMAGE}/.manifest; \
    rm -Rf ${IMAGEDIR}; \
"

# Add "MACHINEBUILD" override for recipes
MACHINEOVERRIDES =. "${@['', '${MACHINEBUILD}:']['${MACHINEBUILD}' != '']}"

BBMASK .= "meta-vuplus/recipes-webkit/"
BBMASK += "meta-vuplus/recipes-webkit/"
```
