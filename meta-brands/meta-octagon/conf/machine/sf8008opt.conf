## meta-brands/meta-odroid/conf/machine/odroid-c1.conf
```bitbake
#@TYPE: Machine
#@NAME: ODROID-C1
#@DESCRIPTION: Machine configuration for the ODROID-C1 by Hardkernel

DEFAULTTUNE ?= "cortexa5hf-neon"
require conf/machine/include/tune-cortexa5.inc

MACHINE_ESSENTIAL_EXTRA_RRECOMMENDS += " \
        u-boot-ini \
        kernel-image \
        kernel-devicetree \
        "

MACHINE_EXTRA_RRECOMMENDS += " \
        kernel-modules \
        "

PREFERRED_PROVIDER_virtual/kernel ?= "linux-hardkernel"

PREFERRED_PROVIDER_virtual/bootloader ?= "u-boot-hardkernel"
PREFERRED_PROVIDER_u-boot ?= "u-boot-hardkernel"
PREFERRED_VERSION_u-boot-hardkernel ?= "v2011.03%"

UBOOT_MACHINE ?= "odroidc_config"

KERNEL_DEVICETREE ?= "meson8b_odroidc.dtb"
SERIAL_CONSOLE ?= "115200 ttyS0"

KERNEL_IMAGETYPE ?= "uImage"
IMAGE_CLASSES += "odroidc-sdimg"
# ${SDIMG_ROOTFS_TYPE} is workaround, otherwise system mkfs.extX is used
# (e2fsprogs-native aren't built automatically). Native e2fsprogs should be
# built automatically because of IMAGE_TYPEDEP specified in odroidc-sdimg class.
IMAGE_FSTYPES += "tar.gz odroidc-sdimg ${SDIMG_ROOTFS_TYPE}"
```

## meta-brands/meta-odroid/conf/machine/odroid-xu3.conf
```bitbake
#@TYPE: Machine
#@NAME: odroid-xu3
#@DESCRIPTION: Machine configuration for odroid-xu3 systems
#@MAINTAINER: Armin Kuster <akuster808@gmail.com>

DEFAULTTUNE = "cortexa15hf-neon"
include conf/machine/include/tune-cortexa15.inc
include conf/machine/include/odroid-default-settings.inc

PREFERRED_PROVIDER_virtual/xserver ?= "xserver-xorg"
XSERVER ?= "xserver-xorg \
           xf86-input-evdev \
           xf86-input-mouse \
           xf86-video-fbdev \
           xf86-input-keyboard"

MACHINE_EXTRA_RRECOMMENDS = " kernel-modules kernel-devicetree"

EXTRA_IMAGEDEPENDS += "u-boot secure-odroid-xu3 u-boot-config"

IMAGE_FSTYPES_append = " ext4 sdcard"

SERIAL_CONSOLE = "115200 ttySAC2"

PREFERRED_PROVIDER_virtual/kernel ?= "linux-stable"
PREFERRED_VERSION_linux-stable ?= "4.8%"

#specify u-boot parameters
PREFERRED_PROVIDER_virtual/bootloader ?= "u-boot"
PREFERRED_PROVIDER_u-boot ?= "u-boot"
PREFERRED_VERSION_u-boot ?= "v2016.03%"
UBOOT_MACHINE_odroid-xu3 = "odroid-xu3_defconfig"

KERNEL_IMAGETYPE ?= "zImage"
KERNEL_DEVICETREE ?= "exynos5422-odroidxu3.dtb"
UBOOT_BINARY ?= "u-boot-dtb.bin"

MACHINE_FEATURES = "serial usbgadget usbhost vfat ext2 rtc alsa screen"
```

## meta-brands/meta-odroid/conf/machine/odroidc2.conf
```bitbake
#@TYPE: Machine
#@NAME: odroid-c2
#@DESCRIPTION: Machine configuration for odroid-c2 systems
#@MAINTAINER: Armin Kuster <akuster808@gmail.com>

MACHINE_NAME = "C2"
BRAND_OEM = "hardkernel"
MACHINE_BRAND = "ODROID"

GST_VERSION = "0.10"

SOC_FAMILY = "AMLS905"

# Amlogic defaults
require conf/machine/include/odroid.inc
require conf/machine/include/arm/arch-armv8.inc

require conf/machine/include/multilib.inc


MACHINE_ESSENTIAL_EXTRA_RDEPENDS = "\
    odroid-shutdown \
    odroid-mali-${MACHINE} \
    enigma2-plugin-extensions-rcuselect \
    enigma2-plugin-extensions-rezap \
    ${@bb.utils.contains('GST_VERSION', '1.0', 'odroid-gst-amlavsink1 ', 'odroid-gst-amlavsink odroid-gst-amlavout  gst-ffmpeg gst-fluendo-mpegdemux ', d)} \
    \
    odroid-opengl-amlogic \
    "

KERNEL_MODULE_AUTOLOAD += "\
    e2-procfs \
    sysfillrect \
    syscopyarea \
    mceusb \
    rc-core \
    mali \
    dhd \
    CH341 \
    rfcomm \
    hidp \
    cfg80211 \
    bluetooth \
    6lowpan-iphc \
    libcrc32c \
"

module_conf_dhd = "options dhd firmware_path=/lib/firmware/brcm/ nvram_path=/lib/firmware/brcm/"

KERNEL_MODULE_PROBECONF += "\
	dhd \
"

EXTRA_IMAGEDEPENDS += "u-boot-odroid"

PREFERRED_PROVIDER_virtual/kernel ?= "linux-odroid"
PREFERRED_VERSION_linux-odroid ?= "3.14.79"
PREFERRED_VERSION_linux-libc-headers = "3.14.79"
LINUX_VERSION_EXTENSION ?= ""

#specify u-boot parameters
PREFERRED_PROVIDER_virtual/bootloader ?= "u-boot-odroid"
PREFERRED_PROVIDER_u-boot ?= "u-boot-odroid"
PREFERRED_VERSION_u-boot-odroid ?= "2015.01"

KERNEL_IMAGETYPE ?= "Image"
UBOOT_BINARY ?= "u-boot.bin"
UBOOT_MACHINE = "odroidc2_defconfig"

MACHINE_FEATURES = "serial usbgadget usbhost vfat ext2 rtc alsa nolcd skins1080 emmc kodi aml-plugins"
MTD_BLACK  = "mmcblk0"
```

## meta-brands/meta-protek/conf/layer.conf
```bitbake
# We have a conf and classes directory, append to BBPATH
BBPATH .= ":${LAYERDIR}"

# We have a recipes directory, add to BBFILES
BBFILES += "${LAYERDIR}/recipes-*/*.bb ${LAYERDIR}/recipes-*/*.bbappend \
            ${LAYERDIR}/recipes-*/*/*.bb ${LAYERDIR}/recipes-*/*/*.bbappend"

BBFILE_COLLECTIONS += "protek-layer"
BBFILE_PATTERN_protek-layer := "^${LAYERDIR}/"
BBFILE_PRIORITY_protek-layer = "7"

LAYERSERIES_COMPAT_protek-layer = "sumo"

OEA-META-PROTEK-BASE := '${@os.path.normpath("${LAYERDIR}/")}'
```

## meta-brands/meta-protek/conf/machine/9900lx.conf
```bitbake
require conf/machine/include/protek.inc

MACHINE_NAME = "9900 LX"
MACHINE_BRAND = "Protek"
MACHINE_DRIVER = "9900lx"
IMAGEDIR = "9900lx"
RCNAME = "protek1"

SOC_FAMILY = "bcm7362"

MACHINE_FEATURES += " videoenhancement ci blindscan-tbs 7segment RCA ci singlecore"

EXTRA_IMAGEDEPENDS += "\
    curl \
    "

MACHINE_EXTRA_RDEPENDS = "\
    curl \
    "

MACHINE_KERNEL_PR = "r0"
```

## meta-brands/meta-protek/conf/machine/include/protek.inc
```bitbake
# We know about rtc
include conf/machine/include/build-extras.inc

BRAND_OEM = "protek"

MTD_KERNEL = "mtd1"
MTD_ROOTFS = "mtd2"
KERNEL_FILE = "kernel.bin"
ROOTFS_FILE = "rootfs.bin"

DVBPROVIDER = "kernel"
DVBSKYPROVIDER = "kernel"

MACHINE_ESSENTIAL_EXTRA_RDEPENDS = "\
    protek-dvb-modules-${MACHINE} \
    "

MACHINE_ESSENTIAL_EXTRA_RRECOMMENDS = "\
    kernel-module-cdfs \
    "

MACHINE_EXTRA_RRECOMMENDS = " \
    gstreamer1.0-plugin-dvbmediasink \
    "

include conf/machine/include/autoload-filesystems.inc

DVBMEDIASINK_CONFIG = "--with-wma --with-wmv --with-pcm --with-dtsdownmix \
    ${@bb.utils.contains('MACHINE', '9900lx', '--with-vb6 --with-vb8 --with-spark' , '', d)} \
"

TARGET_ARCH = "mipsel"
DEFAULTTUNE = "mips32el"

PREFERRED_PROVIDER_virtual/kernel = "linux-protek"
PREFERRED_VERSION_linux-protek = "4.1.21"
PREFERRED_VERSION_linux-libc-headers = "4.1"
PREFERRED_PROVIDER_virtual/blindscan-dvbc = "protek-blindscan-utils-dvbc"
PREFERRED_PROVIDER_virtual/blindscan-dvbs = "protek-blindscan-utils-dvbs"

PREFERRED_VERSION_nfs-utils ?= "1.2.8"

KERNEL_IMAGETYPE = "vmlinux"
KERNEL_OUTPUT = "${KERNEL_IMAGETYPE}"
KERNEL_CONSOLE = "ttyS0,115200n8"

IMAGE_FSTYPES ?= "ubi"

UBI_VOLNAME = "rootfs"
MKUBIFS_ARGS = "-m 2048 -e 126976 -c 4096"
UBINIZE_ARGS = "-m 2048 -p 128KiB"

IMAGE_CMD_ubi_prepend = " \
    rm -rf ${IMAGE_ROOTFS}/boot/*; \
    rm -rf ${IMAGE_ROOTFS}/tmp/*; \
    "

IMAGE_CMD_ubi_append = "\
    mkdir -p ${DEPLOY_DIR_IMAGE}/${IMAGEDIR}; \
    ${@bb.utils.contains("MACHINE_FEATURES", "bootsplash", "cp ${DEPLOY_DIR_IMAGE}/${BOOTLOGO_FILENAME} ${DEPLOY_DIR_IMAGE}/${IMAGEDIR}/${BOOTLOGO_FILENAME};" , "", d)} \
    mv ${IMGDEPLOYDIR}/${IMAGE_NAME}.rootfs.ubi ${DEPLOY_DIR_IMAGE}/${IMAGEDIR}/${ROOTFS_FILE}; \
    gzip -9c ${DEPLOY_DIR_IMAGE}/vmlinux-${MACHINE}.bin > ${DEPLOY_DIR_IMAGE}/${IMAGEDIR}/${KERNEL_FILE}; \
    echo ${IMAGE_VER_STRING} > ${DEPLOY_DIR_IMAGE}/${IMAGEDIR}/imageversion; \
    echo "rename this file to 'force' to force an update without confirmation" > ${DEPLOY_DIR_IMAGE}/${IMAGEDIR}/noforce; \
    cd ${DEPLOY_DIR_IMAGE}; \
    zip ${IMAGE_NAME}_usb.zip ${IMAGEDIR}/*; \
    rm -f ${DEPLOY_DIR_IMAGE}/*.ubi; \
    rm -f ${DEPLOY_DIR_IMAGE}/*.ubifs; \
    rm -f ${DEPLOY_DIR_IMAGE}/*.manifest; \
    rm -f ${DEPLOY_DIR_IMAGE}/.ubifs; \
    rm -f ${DEPLOY_DIR_IMAGE}/.manifest; \
    rm -Rf ${IMAGEDIR}; \
    "

MACHINE_FEATURES += "3dtv alsa hdmicec switchoff wifi bootsplash omb skins1080 feature1 feature2"

BOOTLOGO_FILENAME = "splash.bin"

require conf/machine/include/tune-mips32.inc
require conf/machine/include/soc-family.inc

# Add "MACHINEBUILD" override for recipes
MACHINEOVERRIDES =. "${@['', '${MACHINEBUILD}:']['${MACHINEBUILD}' != '']}"
```

## meta-brands/meta-qviart/conf/layer.conf
```bitbake
# We have a conf and classes directory, append to BBPATH
BBPATH .= ":${LAYERDIR}"

# We have a recipes directory, add to BBFILES
BBFILES += "${LAYERDIR}/recipes-*/*.bb ${LAYERDIR}/recipes-*/*.bbappend \
            ${LAYERDIR}/recipes-*/*/*.bb ${LAYERDIR}/recipes-*/*/*.bbappend"

BBFILE_COLLECTIONS += "qviart-layer"
BBFILE_PATTERN_qviart-layer := "^${LAYERDIR}/"
BBFILE_PRIORITY_qviart-layer = "7"

LAYERSERIES_COMPAT_qviart-layer = "langdale mickledore"

OEA-META-QVIART-BASE := '${@os.path.normpath("${LAYERDIR}/")}'
```

## meta-brands/meta-qviart/conf/machine/include/qviart-hisi.inc
```bitbake
PACKAGECONFIG_GL:pn-qtbase = "gles2 eglfs linuxfb"
PACKAGECONFIG_FB:pn-qtbase = " "

# We know about rtc
include conf/machine/include/build-extras.inc

DISTRO_FEATURES:remove = "x11 wayland"

BRAND_OEM = "qviart"

IMAGEDIR = "qviart/${MACHINE}"

MACHINE_BRAND = "Qviart"

KERNEL_FILE = "kernel.bin"
ROOTFS_FILE = "rootfs.tar.bz2"
MTD_BLACK  = "mmcblk0"

VER = "-og2ott4k"

MACHINE_ESSENTIAL_EXTRA_RDEPENDS += "\
    qviart-dvb-modules-${MACHINE} \
    qviart-loadmodules-${SOC_FAMILY} \ 
    qviart-opengl-${SOC_FAMILY} \
    qviart-libs-${MACHINE} \
    qviart-hihalt-${SOC_FAMILY} \
    qviart-reader-${MACHINE} \
    qviart-libreader-${SOC_FAMILY} \
    qviart-partitions-${MACHINE} \
    qviart-tntfs-${HICHIPSET} \
    qviart-buildimage \
    e2fsprogs-resize2fs \
    gptfdisk \
"

MACHINE_FEATURES += "hisil switchoff hdmicec skins1080 emmc mmc kodi20 alsa hbbtv-browser-webkit qtstalker qtnetflix openhbbtv hisichromium mali HDMISTANDBY"

IMAGE_CLASSES  += "qviart-emmc2_image"
IMAGE_FSTYPES += "qviartemmc2"
IMAGE_ROOTFS_SIZE ?= "624288"

TARGET_ARCH = "arm"
DEFAULTTUNE = "cortexa15hf-neon-vfpv4"

PREFERRED_VERSION_linux-qviart = "${LINUX_VERSION}"
PREFERRED_PROVIDER_virtual/kernel = "linux-qviart"
PREFERRED_VERSION_wpa-supplicant = "${@bb.utils.contains('MACHINE', 'og2s4k', '2.9' , '2.10', d)}"
PREFERRED_PROVIDER_virtual/egl = "qviart-opengl-${SOC_FAMILY}" 
PREFERRED_PROVIDER_virtual/libgles1 = "qviart-opengl-${SOC_FAMILY}"
PREFERRED_PROVIDER_virtual/libgles2 = "qviart-opengl-${SOC_FAMILY}"
PREFERRED_PROVIDER_virtual/kodi = "stb-kodi-${MACHINE}"
PREFERRED_PROVIDER_virtual/blindscan-dvbs = "qviart-blindscan-${SOC_FAMILY}"

PREFERRED_RPROVIDER_showiframe = "qviart-showiframe-${SOC_FAMILY}"
PREFERRED_RPROVIDER_aio-grab = "qviart-grab-${SOC_FAMILY}"

require conf/machine/include/arm/armv7a/tune-cortexa15.inc

MACHINE_EXTRA_RRECOMMENDS += " \
    gstreamer1.0-plugin-dvbmediasink \
    gstreamer1.0-libav \
    ${@bb.utils.contains('MACHINE', 'og2ott4k', 'enigma2-plugin-extensions-gbipboxclient enigma2-plugin-systemplugins-satipclient' , '', d)} \
    ${@bb.utils.contains('MACHINE', 'og2s4k', 'firmware-uwe5621' , '', d)} \
    "

DVBPROVIDER = "kernel"
DVBSKYPROVIDER = "kernel"

include conf/machine/include/autoload-filesystems.inc
require conf/machine/include/soc-family.inc
require conf/machine/box-hardware.inc

DVBMEDIASINK_CONFIG = "--with-h265 --with-vb8 --with-vb9 --with-spark --with-wma --with-wmv --with-pcm --with-dts --with-eac3"

IMAGE_CMD:qviartemmc2:append = "\
	mkdir -p ${IMAGE_ROOTFS}/usr/lib; \
	if [ "${PACKAGE_LIST}" = "1" ]; then \
        cp ${IMAGE_MANIFEST} ${IMAGE_ROOTFS}/usr/lib/package.lst; \
    fi; \
    mkdir -p ${DEPLOY_DIR_IMAGE}/${IMAGEDIR}; \
    mv ${IMGDEPLOYDIR}/${IMAGE_NAME}.rootfs.ext4 ${DEPLOY_DIR_IMAGE}/${MACHINE}-partitions/rootfs.ext4; \
    cd ${IMAGE_ROOTFS}; \
    tar -cvf ${DEPLOY_DIR_IMAGE}/rootfs.tar -C ${IMAGE_ROOTFS} .; \
    mv ${DEPLOY_DIR_IMAGE}/rootfs.tar ${DEPLOY_DIR_IMAGE}/${IMAGEDIR}/rootfs.tar; \
    bzip2 ${DEPLOY_DIR_IMAGE}/${IMAGEDIR}/rootfs.tar; \
    cp ${DEPLOY_DIR_IMAGE}/uImage ${DEPLOY_DIR_IMAGE}/${IMAGEDIR}/${KERNEL_FILE}; \
    cp ${DEPLOY_DIR_IMAGE}/uImage ${DEPLOY_DIR_IMAGE}/${MACHINE}-partitions/${KERNEL_FILE}; \
    if [ -e ${DEPLOY_DIR_IMAGE}/logo-${DISTRO_NAME}.img ]; then \
        cp -f ${DEPLOY_DIR_IMAGE}/logo-${DISTRO_NAME}.img ${DEPLOY_DIR_IMAGE}/${MACHINE}-partitions/logo.img; \
    fi; \
    echo ${IMAGE_VER_STRING} > ${DEPLOY_DIR_IMAGE}/${IMAGEDIR}/imageversion; \
    cd ${DEPLOY_DIR_IMAGE}/${MACHINE}-partitions; \
    mkupdate -s 00000003-00000001-01010101 -f ${DEPLOY_DIR_IMAGE}/${MACHINE}-partitions/emmc_partitions.xml -d ${DEPLOY_DIR_IMAGE}/usb_update.bin; \ 
    cd ${DEPLOY_DIR_IMAGE}; \
    cp ${IMGDEPLOYDIR}/${IMAGE_NAME}.rootfs.manifest ${IMAGE_NAME}_usb.zip.manifest; \
    zip -j ${IMAGE_NAME}_recovery_emmc.zip ${DEPLOY_DIR_IMAGE}/usb_update.bin ${DEPLOY_DIR_IMAGE}/${IMAGEDIR}/imageversion ${DEPLOY_DIR_IMAGE}/${MACHINE}-partitions/bootargs.bin ${DEPLOY_DIR_IMAGE}/${MACHINE}-partitions/fastboot.bin ${DEPLOY_DIR_IMAGE}/${MACHINE}-partitions/apploader.bin; \
    if [ -e ${DEPLOY_DIR_IMAGE}/${MACHINE}-partitions/6605s.upg ]; then \
        zip -j ${IMAGE_NAME}_recovery_emmc.zip ${DEPLOY_DIR_IMAGE}/${MACHINE}-partitions/6605s.upg; \
    fi; \
    zip ${IMAGE_NAME}_mmc.zip ${IMAGEDIR}/*; \
    rm -f ${DEPLOY_DIR_IMAGE}/*.ext4; \
    rm -f ${DEPLOY_DIR_IMAGE}/.ext4; \
    rm -f -f ${DEPLOY_DIR_IMAGE}/*.json; \
    rm -Rf ${DEPLOY_DIR_IMAGE}/usb_update.bin; \
    rm -Rf ${IMAGEDIR}; \
    rm -Rf ${IMGDEPLOYDIR}/userdata; \
    "

# Add "MACHINEBUILD" override for recipes
MACHINEOVERRIDES =. "${@['', '${MACHINEBUILD}:']['${MACHINEBUILD}' != '']}"

BBMASK = "meta-vuplus/recipes-graphics/"
BBMASK += "meta-vuplus/recipes-webkit/"
```

## meta-brands/meta-qviart/conf/machine/og2ott4k.conf
```bitbake
#@TYPE: Machine
#@NAME: og2ott4k
#@DESCRIPTION: Machine configuration for the og2 ott 4k

EXTRA_OECONF:append:pn-enigma2 = "--with-lcddev=/dev/null --with-alphablendingacceleration=always --with-blitaccelerationthreshold=250  --with-fillaccelerationthreshold=190000"

MACHINE_FEATURES += " no-subssupport HDMI AV_JACK multitranscoding"

SOC_FAMILY = "hisi3798mv200advca"
HICHIPSET = "3798mv200advca"
LINUX_VERSION = "4.4.176"

MTD_KERNEL = "mmcblk0p15"
MTD_ROOTFS = "mmcblk0p19"

MACHINE_NAME = "OG2 OTT 4K"

require conf/machine/include/qviart-hisi.inc
```

## meta-brands/meta-qviart/conf/machine/og2s4k.conf
```bitbake
#@TYPE: Machine
#@NAME: og2s4k
#@DESCRIPTION: Machine configuration for the og2s4k

EXTRA_OECONF:append:pn-enigma2 = " --with-lcddev=/dev/null --with-alphablendingacceleration=always --with-blitaccelerationthreshold=250  --with-fillaccelerationthreshold=190000 --with-subttxtabnormalptsdiffs=3600000"

MACHINE_FEATURES += " no-subssupport HDMI AV_JACK multitranscoding blindscan-dvbs 7segment"

SOC_FAMILY = "hisi3798mv300"
HICHIPSET = "3798mv300"
LINUX_VERSION = "4.4.176"

MACHINE_NAME = "Qviart OG 2S 4K"

MTD_KERNEL = "mmcblk0p12"
MTD_ROOTFS = "mmcblk0p16"
RCNAME = "qviart8"

require conf/machine/include/qviart-hisi.inc
```

## meta-brands/meta-skylake/conf/machine/hd1100.conf
```bitbake
CHIPSET = "bcm7358"

UBI_VOLNAME = "rootfs"
MKUBIFS_ARGS = "-m 2048 -e 126976 -c 4096"
UBINIZE_ARGS = "-m 2048 -p 128KiB"

require conf/machine/include/skylake-oem.inc

MACHINE_FEATURES += "extrakernelwifi kernelrt2800 textlcd videoenhancement singlecore"


MACHINE_KERNEL_PR = "r0"
```
