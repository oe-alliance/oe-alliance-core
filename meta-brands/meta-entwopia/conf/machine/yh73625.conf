## meta-brands/meta-entwopia/conf/machine/yh73625.conf
```bitbake
#@TYPE: Machine
#@NAME: ENTWOPIA yh73625
#@DESCRIPTION: Machine configuration for the ENTWOPIA yh73625

SOC_FAMILY = "bcm73625"

MACHINE_FEATURES += " videoenhancement linuxwifi AV_JACK"

PREFERRED_VERSION_linux-entwopia = "4.10.6"

require conf/machine/include/entwopia-oem.inc

MACHINE_KERNEL_PR = "r0"

DVBSKYPROVIDER = "kernel"

FORCE = "yes"
```

## meta-brands/meta-formuler/conf/layer.conf
```bitbake
# We have a conf and classes directory, append to BBPATH
BBPATH .= ":${LAYERDIR}"

# We have a recipes directory, add to BBFILES
BBFILES += "${LAYERDIR}/recipes-*/*.bb ${LAYERDIR}/recipes-*/*.bbappend \
            ${LAYERDIR}/recipes-*/*/*.bb ${LAYERDIR}/recipes-*/*/*.bbappend"

BBFILE_COLLECTIONS += "formuler-layer"
BBFILE_PATTERN_formuler-layer := "^${LAYERDIR}/"
BBFILE_PRIORITY_formuler-layer = "7"

OEA-META-FORMULER-BASE := '${@os.path.normpath("${LAYERDIR}/")}'
```

## meta-brands/meta-formuler/conf/machine/formuler1.conf
```bitbake
#@TYPE: Machine
#@NAME: Formuler F1
#@DESCRIPTION: Machine configuration for the Formuler F1

MACHINE_NAME = "F1"

FLASHSIZE = "512"

PREFERRED_VERSION_linux-formuler = "4.10.6"

SOC_FAMILY = "bcm7356"

UBI_VOLNAME = "rootfs"
MKUBIFS_ARGS = "-m 2048 -e 126976 -c 8192"
UBINIZE_ARGS = "-m 2048 -p 128KiB"

require conf/machine/include/formuler.inc

MACHINE_FEATURES += "dvb-c textlcd videoenhancement v3d kodi19 HDMI YUV RCA"
```

## meta-brands/meta-formuler/conf/machine/formuler3.conf
```bitbake
#@TYPE: Machine
#@NAME: Formuler F3
#@DESCRIPTION: Machine configuration for the Formuler F3

MACHINE_NAME = "F3"

PREFERRED_VERSION_linux-formuler = "4.10.6"
PREFERRED_VERSION_linux-libc-headers = "4.10"

SOC_FAMILY = "bcm7362"

UBI_VOLNAME = "rootfs"
MKUBIFS_ARGS = "-m 2048 -e 126976 -c 8192"
UBINIZE_ARGS = "-m 2048 -p 128KiB"

MACHINE_FEATURES += "textlcd videoenhancement"

require conf/machine/include/formuler.inc

EXTRA_IMAGEDEPENDS += "\
    enigma2-plugin-systemplugins-vfdcontrol \
    "

MACHINE_EXTRA_RDEPENDS = "\
    enigma2-plugin-systemplugins-vfdcontrol \
    "
```

## meta-brands/meta-formuler/conf/machine/formuler3ip.conf
```bitbake
#@TYPE: Machine
#@NAME: Formuler F3
#@DESCRIPTION: Machine configuration for the Formuler F3

MACHINE_NAME = "F3"

PREFERRED_VERSION_linux-formuler = "4.10.6"
PREFERRED_VERSION_linux-libc-headers = "4.10"

SOC_FAMILY = "bcm7362"

UBI_VOLNAME = "rootfs"
MKUBIFS_ARGS = "-m 2048 -e 126976 -c 8192"
UBINIZE_ARGS = "-m 2048 -p 128KiB"

MACHINE_FEATURES += "textlcd videoenhancement al-driver 7segment textlcd"

IMAGEDIR = "formuler3"

require conf/machine/include/formuler.inc
```

## meta-brands/meta-formuler/conf/machine/formuler4.conf
```bitbake
#@TYPE: Machine
#@NAME: Formuler F4
#@DESCRIPTION: Machine configuration for the Formuler F4

MACHINE_NAME = "F4"
RCHARDWARE = "V2"

FLASHSIZE = "256"

PREFERRED_VERSION_linux-formuler = "4.10.6"

SOC_FAMILY = "bcm7362"

UBI_VOLNAME = "rootfs"
MKUBIFS_ARGS = "-m 2048 -e 126976 -c 8192"
UBINIZE_ARGS = "-m 2048 -p 128KiB"

MACHINE_FEATURES += "videoenhancement 7segment HDMI AV_JACK"

require conf/machine/include/formuler.inc
```

## meta-brands/meta-formuler/conf/machine/formuler4ip.conf
```bitbake
#@TYPE: Machine
#@NAME: Formuler F4
#@DESCRIPTION: Machine configuration for the Formuler F4

MACHINE_NAME = "F4"

PREFERRED_VERSION_linux-formuler = "4.10.6"
PREFERRED_VERSION_linux-libc-headers = "4.10"

SOC_FAMILY = "bcm7362"

UBI_VOLNAME = "rootfs"
MKUBIFS_ARGS = "-m 2048 -e 126976 -c 8192"
UBINIZE_ARGS = "-m 2048 -p 128KiB"

MACHINE_FEATURES += "textlcd videoenhancement al-driver"

require conf/machine/include/formuler.inc

EXTRA_IMAGEDEPENDS += "\
    enigma2-plugin-systemplugins-vfdcontrol \
    "

MACHINE_EXTRA_RDEPENDS = "\
    enigma2-plugin-systemplugins-vfdcontrol \
    "
```

## meta-brands/meta-formuler/conf/machine/formuler4turbo.conf
```bitbake
#@TYPE: Machine
#@NAME: Formuler F4 turbo
#@DESCRIPTION: Machine configuration for the Formuler F4 turbo

MACHINE_NAME = "F4 turbo"

FLASHSIZE = "256"

PREFERRED_VERSION_linux-formuler = "4.10.6"
PREFERRED_VERSION_linux-libc-headers = "4.10"

SOC_FAMILY = "bcm73625"

UBI_VOLNAME = "rootfs"
MKUBIFS_ARGS = "-m 2048 -e 126976 -c 8192"
UBINIZE_ARGS = "-m 2048 -p 128KiB"

MACHINE_FEATURES += "textlcd videoenhancement bootsplash al-driver 7segment"

require conf/machine/include/formuler.inc
```

## meta-brands/meta-formuler/conf/machine/include/formuler.inc
```bitbake
# We know about rtc
include conf/machine/include/build-extras.inc

BRAND_OEM = "formuler"
MACHINE_BRAND = "Formuler"

MTD_KERNEL = "mtd1"
MTD_ROOTFS = "mtd2"
KERNEL_FILE = "kernel.bin"
ROOTFS_FILE = "rootfs.bin"

MACHINE_ESSENTIAL_EXTRA_RDEPENDS = "\
    ${@bb.utils.contains('MACHINE_FEATURES', 'al-driver', 'formuler-dvb-modules-al-${MACHINE}', 'formuler-dvb-modules-${MACHINE}',d)} \
    ${@bb.utils.contains('MACHINE_FEATURES', 'v3d', 'formuler-v3ddriver-${MACHINE}', '',d)} \
    "

DVBPROVIDER = "kernel"
DVBSKYPROVIDER = "kernel"

MACHINE_ESSENTIAL_EXTRA_RRECOMMENDS = "\
    kernel-module-cdfs \
    "

MACHINE_EXTRA_RRECOMMENDS = " \
    gstreamer1.0-plugin-dvbmediasink \
    "

include conf/machine/include/autoload-filesystems.inc

DVBMEDIASINK_CONFIG = "--with-wma --with-wmv --with-pcm --with-dts --with-eac3 \
    ${@bb.utils.contains('MACHINEBUILD', 'formuler4turbo', '--with-h265 --with-vb6 --with-vb8 --with-spark' , '', d)} \
    "

TARGET_ARCH = "mipsel"
DEFAULTTUNE = "mips32el"

PREFERRED_PROVIDER_virtual/kernel = "linux-formuler"
PREFERRED_PROVIDER_virtual/egl = "formuler-v3ddriver-${MACHINE}" 
PREFERRED_PROVIDER_virtual/libgles2 = "formuler-v3ddriver-${MACHINE}"
PREFERRED_PROVIDER_virtual/kodi = "stb-kodi-${MACHINE}"

KERNEL_IMAGETYPE = "vmlinux"
KERNEL_OUTPUT = "${KERNEL_IMAGETYPE}"
KERNEL_CONSOLE = "ttyS0,115200n8"

IMAGE_FSTYPES ?= "ubi"

IMAGEDIR ?= "${MACHINE}"

IMAGE_CMD_ubi_prepend = " \
    rm -rf ${IMAGE_ROOTFS}/boot/*; \
    rm -rf ${IMAGE_ROOTFS}/tmp/*; \
    "

IMAGE_CMD_ubi_append = "\
    mkdir -p ${DEPLOY_DIR_IMAGE}/${IMAGEDIR}; \
    ${@bb.utils.contains("MACHINE_FEATURES", "bootsplash", "cp ${DEPLOY_DIR_IMAGE}/${BOOTLOGO_FILENAME} ${DEPLOY_DIR_IMAGE}/${IMAGEDIR}/${BOOTLOGO_FILENAME};" , "", d)} \
    mv ${IMGDEPLOYDIR}/${IMAGE_NAME}.rootfs.ubi ${DEPLOY_DIR_IMAGE}/${IMAGEDIR}/${ROOTFS_FILE}; \
    gzip -9c ${DEPLOY_DIR_IMAGE}/vmlinux-${MACHINE}.bin > ${DEPLOY_DIR_IMAGE}/${IMAGEDIR}/${KERNEL_FILE}; \
    echo ${IMAGE_VER_STRING} > ${DEPLOY_DIR_IMAGE}/${IMAGEDIR}/imageversion; \
    echo "rename this file to 'force' to force an update without confirmation" > ${DEPLOY_DIR_IMAGE}/${IMAGEDIR}/noforce; \
    cd ${DEPLOY_DIR_IMAGE}; \
    zip ${IMAGE_NAME}_usb.zip ${IMAGEDIR}/*; \
    rm -f ${DEPLOY_DIR_IMAGE}/*.ubi; \
    rm -f ${DEPLOY_DIR_IMAGE}/*.ubifs; \
    rm -f ${DEPLOY_DIR_IMAGE}/*.manifest; \
    rm -f ${DEPLOY_DIR_IMAGE}/.ubifs; \
    rm -f ${DEPLOY_DIR_IMAGE}/.manifest; \
    rm -Rf ${IMAGEDIR}; \
    "


MACHINE_FEATURES += "ci 3dtv alsa hdmicec switchoff omb boxmodel feature1 blindscan-tbs skins1080 linuxwifi"

BOOTLOGO_FILENAME = "splash.bin"

require conf/machine/include/tune-mips32.inc
require conf/machine/include/soc-family.inc

# Add "MACHINEBUILD" override for recipes
MACHINEOVERRIDES =. "${@['', '${MACHINEBUILD}:']['${MACHINEBUILD}' != '']}"
```

## meta-brands/meta-fulan/conf/layer.conf
```bitbake
# We have a conf and classes directory, append to BBPATH
BBPATH .= ":${LAYERDIR}"

# We have a recipes directory, add to BBFILES
BBFILES += "${LAYERDIR}/recipes-*/*.bb ${LAYERDIR}/recipes-*/*.bbappend \
            ${LAYERDIR}/recipes-*/*/*.bb ${LAYERDIR}/recipes-*/*/*.bbappend"

BBFILE_COLLECTIONS += "fulan-layer"
BBFILE_PATTERN_fulan-layer := "^${LAYERDIR}/"
BBFILE_PRIORITY_fulan-layer = "7"

LAYERSERIES_COMPAT_fulan-layer = "dunfell"

OEA-META-FULAN-BASE := '${@os.path.normpath("${LAYERDIR}/")}'

WAF_CROSS_ANSWERS_PATH_sh4 = "${LAYERDIR}/files/waf-cross-answers"

DEBUG_FLAGS_sh4 = ""
DEBUG_PREFIX_MAP_sh4 = ""

# dont run update_gio_modules_cache - fails with kernel too old
# error on run postinstall intercept scripts at do_rootfs
GIO_MODULE_PACKAGES_sh4 = ""

WARN_QA_remove_sh4 = "ldflags textrel"
```
