## meta-brands/meta-beyonwiz/conf/layer.conf
```bitbake
# We have a conf and classes directory, append to BBPATH
BBPATH .= ":${LAYERDIR}"

# We have a recipes directory, add to BBFILES
BBFILES += "${LAYERDIR}/recipes-*/*.bb ${LAYERDIR}/recipes-*/*.bbappend \
            ${LAYERDIR}/recipes-*/*/*.bb ${LAYERDIR}/recipes-*/*/*.bbappend"

BBFILE_COLLECTIONS += "beyonwiz-layer"
BBFILE_PATTERN_beyonwiz-layer := "^${LAYERDIR}/"
BBFILE_PRIORITY_beyonwiz-layer = "7"

LAYERSERIES_COMPAT_beyonwiz-layer = "langdale mickledore nanbield scarthgap styhead"

OEA-META-BEYONWIZ-BASE := '${@os.path.normpath("${LAYERDIR}/")}'
```

## meta-brands/meta-beyonwiz/conf/machine/include/beyonwiz-hisi.inc
```bitbake
PACKAGECONFIG_GL_pn-qtbase = "gles2 eglfs linuxfb"
PACKAGECONFIG_FB_pn-qtbase = " "

# We know about rtc
include conf/machine/include/build-extras.inc

DISTRO_FEATURES_remove = "x11 wayland"

BRAND_OEM = "beyonwiz"

IMAGEDIR = "beyonwiz/v2"

MACHINE_NAME = "V2"

MACHINE_BRAND = "Beyonwiz"

MTD_KERNEL = "mmcblk0p12"

MTD_ROOTFS = "mmcblk0p16"

KERNEL_FILE = "kernel.bin"
ROOTFS_FILE = "rootfs.tar.bz2"
MTD_BLACK  = "mmcblk0"

VER = "-beyonwizv2"

MACHINE_ESSENTIAL_EXTRA_RDEPENDS += "\
    beyonwiz-dvb-modules-${MACHINE} \
    beyonwiz-loadmodules-${MACHINE} \ 
    beyonwiz-opengl-${MACHINE} \
    beyonwiz-libs-${MACHINE} \
    beyonwiz-hihalt-${MACHINE} \
    beyonwiz-reader-${MACHINE} \
    beyonwiz-libreader-${MACHINE} \
    beyonwiz-partitions-${MACHINE} \
    beyonwiz-tntfs-${HICHIPSET} \
    beyonwiz-buildimage \
    e2fsprogs-resize2fs \
    gptfdisk \
"

MACHINE_FEATURES += "hisil switchoff 7segment hdmicec skins1080 emmc mmc dvbc-only kodi19 alsa hbbtv-browser-webkit qtstalker qtnetflix"

IMAGE_CLASSES  += "beyonwiz-emmc_image"
IMAGE_FSTYPES += "beyonwizemmc"
IMAGE_ROOTFS_SIZE ?= "524288"

TARGET_ARCH = "arm"
DEFAULTTUNE = "cortexa15hf-neon-vfpv4"

PREFERRED_VERSION_linux-beyonwiz = "4.4.35"

PREFERRED_PROVIDER_virtual/kernel = "linux-beyonwiz"
PREFERRED_PROVIDER_virtual/egl = "beyonwiz-opengl-${MACHINE}" 
PREFERRED_PROVIDER_virtual/libgles1 = "beyonwiz-opengl-${MACHINE}"
PREFERRED_PROVIDER_virtual/libgles2 = "beyonwiz-opengl-${MACHINE}"
PREFERRED_PROVIDER_virtual/kodi = "stb-kodi-${MACHINE}"
PREFERRED_PROVIDER_virtual/blindscan-dvbs = "beyonwiz-blindscan-${MACHINE}"

PREFERRED_RPROVIDER_showiframe = "beyonwiz-showiframe-${MACHINE}"
PREFERRED_RPROVIDER_aio-grab = "beyonwiz-grab-${MACHINE}"

require conf/machine/include/tune-cortexa15.inc

MACHINE_EXTRA_RRECOMMENDS += " \
    gstreamer1.0-plugin-dvbmediasink \
    gstreamer1.0-libav \
    enigma2-plugin-drivers-dvb-usb-it913x \
    enigma2-plugin-drivers-dvb-usb-rtl2832 \
    enigma2-plugin-drivers-ct2-dvb-usb-dualhd \
    enigma2-plugin-picons-tv-australia \
    "

DVBPROVIDER = "kernel"
DVBSKYPROVIDER = "kernel"

include conf/machine/include/autoload-filesystems.inc
require conf/machine/include/soc-family.inc
require conf/machine/box-hardware.inc

DVBMEDIASINK_CONFIG = "--with-h265 --with-vb8 --with-vb9 --with-spark --with-wma --with-wmv --with-pcm --with-dts --with-eac3"

IMAGE_CMD_beyonwizemmc_append = "\
    mkdir -p ${DEPLOY_DIR_IMAGE}/${IMAGEDIR}; \
    mv ${IMGDEPLOYDIR}/${IMAGE_NAME}.rootfs.ext4 ${DEPLOY_DIR_IMAGE}/${MACHINE}-partitions/rootfs.ext4; \
    cd ${IMAGE_ROOTFS}; \
    tar -cvf ${DEPLOY_DIR_IMAGE}/rootfs.tar -C ${IMAGE_ROOTFS} .; \
    mv ${DEPLOY_DIR_IMAGE}/rootfs.tar ${DEPLOY_DIR_IMAGE}/${IMAGEDIR}/rootfs.tar; \
    bzip2 ${DEPLOY_DIR_IMAGE}/${IMAGEDIR}/rootfs.tar; \
    cp ${DEPLOY_DIR_IMAGE}/uImage ${DEPLOY_DIR_IMAGE}/${IMAGEDIR}/${KERNEL_FILE}; \
    cp ${DEPLOY_DIR_IMAGE}/uImage ${DEPLOY_DIR_IMAGE}/${MACHINE}-partitions/${KERNEL_FILE}; \
    if [ -e ${DEPLOY_DIR_IMAGE}/logo-${DISTRO_NAME}.img ]; then \
        cp -f ${DEPLOY_DIR_IMAGE}/logo-${DISTRO_NAME}.img ${DEPLOY_DIR_IMAGE}/${MACHINE}-partitions/logo.img; \
    fi; \
    echo ${IMAGE_VER_STRING} > ${DEPLOY_DIR_IMAGE}/${IMAGEDIR}/imageversion; \
    cd ${DEPLOY_DIR_IMAGE}/${MACHINE}-partitions; \
    mkupdate -s 00000003-00000001-01010101 -f ${DEPLOY_DIR_IMAGE}/${MACHINE}-partitions/emmc_partitions.xml -d ${DEPLOY_DIR_IMAGE}/usb_update.bin; \ 
    cd ${DEPLOY_DIR_IMAGE}; \
    cp ${IMGDEPLOYDIR}/${IMAGE_NAME}.rootfs.manifest ${IMAGE_NAME}_usb.zip.manifest; \
    zip -j ${IMAGE_NAME}_recovery_emmc.zip ${DEPLOY_DIR_IMAGE}/usb_update.bin ${DEPLOY_DIR_IMAGE}/${IMAGEDIR}/imageversion ${DEPLOY_DIR_IMAGE}/${MACHINE}-partitions/bootargs.bin ${DEPLOY_DIR_IMAGE}/${MACHINE}-partitions/fastboot.bin ${DEPLOY_DIR_IMAGE}/${MACHINE}-partitions/apploader.bin; \
    zip ${IMAGE_NAME}_mmc.zip ${IMAGEDIR}/*; \
    rm -f ${DEPLOY_DIR_IMAGE}/*.ext4; \
    rm -f ${DEPLOY_DIR_IMAGE}/.ext4; \
    rm -f -f ${DEPLOY_DIR_IMAGE}/*.json; \
    rm -Rf ${DEPLOY_DIR_IMAGE}/usb_update.bin; \
    rm -Rf ${IMAGEDIR}; \
    "

# Add "MACHINEBUILD" override for recipes
MACHINEOVERRIDES =. "${@['', '${MACHINEBUILD}:']['${MACHINEBUILD}' != '']}"

BBMASK = "meta-vuplus/recipes-graphics/"
BBMASK += "meta-fulan/recipes-graphics/"
BBMASK += "meta-vuplus/recipes-webkit/"
BBMASK += "meta-oe/recipes-qt5.14/"
```

## meta-brands/meta-blackbox/conf/layer.conf
```bitbake
# We have a conf and classes directory, append to BBPATH
BBPATH .= ":${LAYERDIR}"

# We have a recipes directory, add to BBFILES
BBFILES += "${LAYERDIR}/recipes-*/*.bb ${LAYERDIR}/recipes-*/*.bbappend \
            ${LAYERDIR}/recipes-*/*/*.bb ${LAYERDIR}/recipes-*/*/*.bbappend"

BBFILE_COLLECTIONS += "blackbox-layer"
BBFILE_PATTERN_blackbox-layer := "^${LAYERDIR}/"
BBFILE_PRIORITY_blackbox-layer = "7"

OEA-META-BLACKBOX-BASE := '${@os.path.normpath("${LAYERDIR}/../")}'
```

## meta-brands/meta-blackbox/conf/machine/blackbox7405.conf
```bitbake
require conf/machine/include/blackbox-oem.inc

PREFERRED_PROVIDER_virtual/kernel = "linux-blackbox"
PREFERRED_VERSION_linux-blackbox = "3.14.21"

MACHINE_FEATURES += "textlcd ci omb dvb-c blindscan-dvbc blindscan-dvbs skins1080 blindscan-tbs HDMI SCART RCA"

SOC_FAMILY = "bcm7413"

# Broken bootloader can only flash around 100 MB
FLASHSIZE = "96"

MACHINE_ESSENTIAL_EXTRA_RDEPENDS = "\
    blackbox-dvb-modules-blackbox7405 \
    "
```

## meta-brands/meta-blackbox/conf/machine/include/blackbox-oem.inc
```bitbake
# We know about rtc
include conf/machine/include/build-extras.inc

BRAND_OEM = "blackbox"

MACHINE_NAME = "\
${@bb.utils.contains('MACHINEBUILD', 'sogno8800hd', '8800HD' , '', d)}\
${@bb.utils.contains('MACHINEBUILD', 'uniboxhde', 'HDECO+' , '', d)}\
"

MACHINE_BRAND = "\
${@bb.utils.contains('MACHINEBUILD', 'sogno8800hd', 'Sogno' , '', d)}\
${@bb.utils.contains('MACHINEBUILD', 'uniboxhde', 'UNiBOX' , '', d)}\
"

IMAGEDIR ?= "\
${@bb.utils.contains('MACHINEBUILD', 'sogno8800hd', 'sogno/8800hd' , '', d)}\
${@bb.utils.contains('MACHINEBUILD', 'uniboxhde', 'unibox/hde' , '', d)}\
"

MKUBIFS_ARGS = "\
${@bb.utils.contains('MACHINEBUILD', 'sogno8800hd', '-m 2048 -e 126976 -c 4096 -F' , '', d)}\
${@bb.utils.contains('MACHINEBUILD', 'uniboxhde', '-m 2048 -e 126976 -c 8160 -F' , '', d)}\
"

MTD_ROOTFS = "mtd6"
MTD_KERNEL = "mtd7"
KERNEL_FILE = "kernel.bin"
ROOTFS_FILE = "rootfs.bin"

DVBPROVIDER = "kernel"

MACHINE_ESSENTIAL_EXTRA_RRECOMMENDS = "\
    kernel-module-cdfs \
    "

MACHINE_EXTRA_RRECOMMENDS = " \
    gstreamer1.0-plugin-dvbmediasink \
    "

include conf/machine/include/autoload-filesystems.inc

DVBMEDIASINK_CONFIG = "--with-wma --with-wmv --with-pcm"

TARGET_ARCH = "mipsel"
DEFAULTTUNE = "mips32el"

GLIBC_EXTRA_OECONF = "--with-tls --with-__thread"

PREFERRED_PROVIDER_virtual/blindscan-dvbs = "blackbox-blindscan-utils"
PREFERRED_PROVIDER_virtual/blindscan-dvbc = "blackbox-blindscan-utils"

KERNEL_IMAGETYPE = "vmlinux"
KERNEL_OUTPUT = "${KERNEL_IMAGETYPE}"
KERNEL_CONSOLE = "ttyS0,115200n8"

IMAGE_FSTYPES ?= "ubi"

IMAGE_CMD_ubi_prepend = " \
    rm -rf ${IMAGE_ROOTFS}/boot/*; \
    rm -rf ${IMAGE_ROOTFS}/tmp/*; \
    "

UBI_VOLNAME = "rootfs"
UBINIZE_ARGS = "-m 2048 -p 128KiB"

IMAGE_CMD_ubi_append = "\
    mkdir -p ${DEPLOY_DIR_IMAGE}/${IMAGEDIR}; \
    ${@bb.utils.contains("MACHINE_FEATURES", "bootsplash", "cp ${DEPLOY_DIR_IMAGE}/${BOOTLOGO_FILENAME} ${DEPLOY_DIR_IMAGE}/${IMAGEDIR}/${BOOTLOGO_FILENAME};" , "", d)} \
    mv ${IMGDEPLOYDIR}/${IMAGE_NAME}.rootfs.ubi ${DEPLOY_DIR_IMAGE}/${IMAGEDIR}/rootfs.bin; \
    gzip -f -9c ${DEPLOY_DIR_IMAGE}/vmlinux-${MACHINE}.bin > ${DEPLOY_DIR_IMAGE}/${IMAGEDIR}/kernel.bin; \
    echo ${IMAGE_VER_STRING} > ${DEPLOY_DIR_IMAGE}/${IMAGEDIR}/imageversion; \
    echo "rename this file to 'force' to force an update without confirmation" > ${DEPLOY_DIR_IMAGE}/${IMAGEDIR}/noforce; \
    cd ${DEPLOY_DIR_IMAGE}; \
    zip ${IMAGE_NAME}_usb.zip ${IMAGEDIR}/*; \
    rm -f ${DEPLOY_DIR_IMAGE}/*.ubi; \
    rm -f ${DEPLOY_DIR_IMAGE}/*.ubifs; \
    rm -f ${DEPLOY_DIR_IMAGE}/*.manifest; \
    rm -f ${DEPLOY_DIR_IMAGE}/.ubifs; \
    rm -f ${DEPLOY_DIR_IMAGE}/.manifest; \
    rm -Rf ${IMAGEDIR}; \
    "

MACHINE_FEATURES += "3dtv alsa hdmicec switchoff 3dtvpli bootsplash omb feature1 feature2"

BOOTLOGO_FILENAME = "splash.bin"

require conf/machine/include/tune-mips32.inc
require conf/machine/include/soc-family.inc

# add support for extra feeds
PACKAGE_ARCHS += " ${MACHINEBUILD}"

# Add "MACHINEBUILD" override for recipes
MACHINEOVERRIDES =. "${@['', '${MACHINEBUILD}:']['${MACHINEBUILD}' != '']}"
```

## meta-brands/meta-broadmedia/conf/layer.conf
```bitbake
# We have a conf and classes directory, append to BBPATH
BBPATH .= ":${LAYERDIR}"

# We have a recipes directory, add to BBFILES
BBFILES += "${LAYERDIR}/recipes-*/*.bb ${LAYERDIR}/recipes-*/*.bbappend \
            ${LAYERDIR}/recipes-*/*/*.bb ${LAYERDIR}/recipes-*/*/*.bbappend"

BBFILE_COLLECTIONS += "broadmedia-layer"
BBFILE_PATTERN_broadmedia-layer := "^${LAYERDIR}/"
BBFILE_PRIORITY_broadmedia-layer = "7"

LAYERSERIES_COMPAT_broadmedia-layer = "sumo"

OEA-META-BROADMEDIA-BASE := '${@os.path.normpath("${LAYERDIR}/")}'
```

## meta-brands/meta-broadmedia/conf/machine/g100.conf
```bitbake
#@TYPE: Machine
#@NAME: BroadMedia G100
#@DESCRIPTION: Machine configuration for the BroadMedia G100

PREFERRED_VERSION_linux-broadmedia = "4.1.24"

SOC_FAMILY = "bcm73625"

UBI_VOLNAME = "rootfs"
MKUBIFS_ARGS = "-m 2048 -e 126976 -c 8192"
UBINIZE_ARGS = "-m 2048 -p 128KiB"

require conf/machine/include/broadmedia-oem.inc

MACHINE_FEATURES += "ci videoenhancement skins1080 7segment RCA \
    ${@bb.utils.contains('MACHINEBUILD', 'sf138', ' blindscan-dvbc dvb-c dvbc-only' , '', d)}\
"
```

## meta-brands/meta-broadmedia/conf/machine/g101.conf
```bitbake
#@TYPE: Machine
#@NAME: BroadMedia G101
#@DESCRIPTION: Machine configuration for the BroadMedia G101

PREFERRED_VERSION_linux-broadmedia = "4.1.24"

SOC_FAMILY = "bcm73625"

UBI_VOLNAME = "rootfs"
MKUBIFS_ARGS = "-m 2048 -e 126976 -c 8192"
UBINIZE_ARGS = "-m 2048 -p 128KiB"

require conf/machine/include/broadmedia-oem.inc

MACHINE_FEATURES += "ci videoenhancement skins1080 7segment RCA \
    ${@bb.utils.contains('MACHINEBUILD', 'bre2zet2c', ' blindscan-dvbc dvb-c dvbc-only' , '', d)}\
"
```

## meta-brands/meta-broadmedia/conf/machine/g300.conf
```bitbake
#@TYPE: Machine
#@NAME: BroadMedia G300
#@DESCRIPTION: Machine configuration for the BroadMedia G300

PREFERRED_VERSION_linux-broadmedia = "4.1.24"
PREFERRED_VERSION_linux-libc-headers = "4.1"

CHIPSET = "bcm7241"

UBI_VOLNAME = "rootfs"
MKUBIFS_ARGS = "-m 2048 -e 126976 -c 8192"
UBINIZE_ARGS = "-m 2048 -p 128KiB"

require conf/machine/include/broadmedia-oem.inc

MACHINE_FEATURES += "dvb-c ci textlcd videoenhancement blindscan-dvbc skins1080"

MACHINE_KERNEL_PR = "r0"
```
