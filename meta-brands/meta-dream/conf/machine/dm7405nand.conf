## meta-brands/meta-dream/conf/machine/dm7405nand.conf
```bitbake
# MACHINEBUILDS: dm500hd dm800se
#@TYPE: Machine
#@NAME: dm7405nand
#@DESCRIPTION: Shared machine for Dreambox DM500HD / DM800SE (bcm7405, 64MB brcmnand)

MACHINE_NAME:dm500hd = "DM500HD"
MACHINE_NAME:dm800se = "DM800SE"

OEM_ARCH = "${MACHINEBUILD}"
MACHINE_DRIVER = "${MACHINEBUILD}"

RCNAME = "dmm1"

MACHINE_FEATURES += "dvb-c blindscan-dvbc hdmicec fan libpassthrough usbconsole dreamboxv1 omb HDMI SCART"
MACHINE_FEATURES:append:dm800se = " colorlcd bwlcd96"

require conf/machine/include/dreambox-brcmnand.inc
require conf/machine/include/dreambox-nand-64mb.inc
require conf/machine/include/dreambox-part-64mb.inc
require conf/machine/include/dreambox-tar.inc
require conf/machine/include/dreambox-mips32el.inc

SOC_FAMILY = "bcm7405"

MACHINEOVERRIDES .= ":dreamboxv1"
```

## meta-brands/meta-dream/conf/machine/dm7405ubi.conf
```bitbake
# MACHINEBUILDS: dm500hdv2 dm800sev2 dm7020hdv2
#@TYPE: Machine
#@NAME: dm7405ubi
#@DESCRIPTION: Shared machine for Dreambox DM500HDv2 / DM800SEv2 / DM7020HDv2 (bcm7405, 1024MB 2k-page UBI)

MACHINE_NAME:dm500hdv2  = "DM500HDV2"
MACHINE_NAME:dm800sev2  = "DM800SEV2"
MACHINE_NAME:dm7020hdv2 = "DM7020HDV2"

OEM_ARCH = "${MACHINEBUILD}"
MACHINE_DRIVER = "${MACHINEBUILD}"

RCNAME = "dmm2"

FLASHSIZE:dm500hdv2  = "96"
FLASHSIZE:dm800sev2  = "96"
FLASHSIZE:dm7020hdv2 = "64"

MACHINE_FEATURES += "ubimb chkrootmb emmc dvb-c blindscan-dvbc hdmicec libpassthrough usbconsole dreamboxv1 omb smallflash HDMI SCART"
MACHINE_FEATURES:append:dm500hdv2  = " fan"
MACHINE_FEATURES:append:dm800sev2  = " colorlcd bwlcd96 fan"
MACHINE_FEATURES:append:dm7020hdv2 = " ci dvd colorlcd128 grautec RCA"

MACHINE_EXTRA_RRECOMMENDS:append:dm7020hdv2 = " dreambox-enigma2-config"

require conf/machine/include/dreambox-hw-ecc.inc
require conf/machine/include/dreambox-nand-1024mb-2k.inc
require conf/machine/include/dreambox-part-1024mb.inc
require conf/machine/include/dreambox-ubi.inc
require conf/machine/include/dreambox-mips32el.inc

SOC_FAMILY = "bcm7405"

MACHINEOVERRIDES .= ":dreamboxv1"
```

## meta-brands/meta-dream/conf/machine/dm800se.conf
```bitbake
#@TYPE: Machine
#@NAME: Dreambox DM800se
#@DESCRIPTION: Machine configuration for the Dreambox DM800se

MACHINE_NAME = "DM800SE"
RCNAME = "dmm1"

FLASHSIZE:openatv = "64"

MACHINE_FEATURES += "dvb-c blindscan-dvbc colorlcd bwlcd96 hdmicec fan libpassthrough usbconsole dreamboxv1 omb HDMI SCART"
MACHINE_FEATURES += "${@' ubimb chkrootmb emmc smallflash smallbox-chkroot-required' if d.getVar('DISTRO') == 'openatv' else ''}"

require conf/machine/include/dreambox-brcmnand.inc
require conf/machine/include/dreambox-nand-64mb.inc
require conf/machine/include/dreambox-part-64mb.inc
DREAMBOX_ROOTFS_INCLUDE = "${@'dreambox-ubi.inc' if d.getVar('DISTRO') == 'openatv' else 'dreambox-tar.inc'}"
require conf/machine/include/${DREAMBOX_ROOTFS_INCLUDE}
require conf/machine/include/dreambox-mips32el.inc

SOC_FAMILY = "bcm7405"

# Add "dreamboxv1" override for recipes
MACHINEOVERRIDES .= ":dreamboxv1"
```

## meta-brands/meta-dream/conf/machine/dms922x.conf
```bitbake
# MACHINEBUILDS: dreamone dreamtwo
#@TYPE: Machine
#@NAME: Dreambox Nextgen (One/Two)
#@DESCRIPTION: Shared machine for Dreambox DREAMBOX ONE and DREAMBOX TWO (AMLogic S922X)

MACHINE_NAME:dreamone = "dreamone"
MACHINE_NAME:dreamtwo = "dreamtwo"
RCNAME = "dmm3"

# Register MACHINEBUILD as an extra package arch so recipes with
# PACKAGE_ARCH = "${MACHINEBUILD}" (base-files, enigma2, dvb-modules, ...)
# can be found by dependencies. Consumed by PACKAGE_EXTRA_ARCHS in distro conf.
OEM_ARCH = "${MACHINEBUILD}"

BOARD:dreamone = "one"
BOARD:dreamtwo = "two"

MTD_ROOTFS = "mmcblk0p7"
MTD_KERNEL = "mmcblk0p6"
KERNEL_FILE = "kernel.bin"
ROOTFS_FILE = "rootfs-${BOARD}.tar.bz2"
MTD_BLACK  = "mmcblk0"

SOC_FAMILY = "meson64"

PREFERRED_PROVIDER_virtual/egl ?= "meson-mali"
PREFERRED_PROVIDER_virtual/libgles2 ?= "meson-mali"
PREFERRED_PROVIDER_virtual/libgl ?= "mesa-gl"
PREFERRED_PROVIDER_virtual/mesa ?= "mesa-gl"

SERIAL_CONSOLES = "1000000;ttyS0"
UBOOT_ENTRYPOINT = "0x1080000"
UBOOT_MACHINE:dreamone = "dreamone_defconfig"
UBOOT_MACHINE:dreamtwo = "dreamtwo_defconfig"

KERNEL_CLASSES = "kernel-fit-extra-artifacts"
KERNEL_IMAGETYPE = "Image.gz"

MACHINE_FEATURES = "hdmicec cec fb usbconsole serial usbgadget usbhost vfat ext2 rtc alsa screen ci usbconsole dreamboxv2 skins1080 ${E2EGL_WQHD_FEATURE} recovery blindscan-tbs mmc emmc HDMI sbc nogamma alsa-utils pulseaudio alsamixer ${E2EGL_MACHINE_FEATURE}"
MACHINE_FEATURES:append:dreamtwo = " colorlcd240"

require conf/machine/include/dreambox-meson64.inc
MACHINE_FEATURES += " retrogaming retrogaming-highperformance"

IMAGE_ROOTFS_SIZE_ext4 = "524288"

IMAGE_FSTYPES =+ "tar.bz2"
IMAGEDIR = "${MACHINEBUILD}"

do_image_tar[depends] += " mkbootimg-native:do_populate_sysroot"

IMAGE_CMD:tar:prepend = " \
	mkdir -p ${IMAGE_ROOTFS}/usr/lib; \
	if [ "${PACKAGE_LIST}" = "1" ]; then \
        cp ${IMAGE_MANIFEST} ${IMAGE_ROOTFS}/usr/lib/package.lst; \
    fi; \
    mkdir -p ${IMAGE_ROOTFS}/tmp; \
    mkdir -p ${IMAGE_ROOTFS}/var/lib/opkg/info; \
    echo "#!/bin/sh" > ${IMAGE_ROOTFS}/var/lib/opkg/info/kernel-image.postinst; \
    echo "[ -n \"$D\" ] || flash-kernel -c 'console=ttyS0,1000000 root=/dev/mmcblk0p7 rootwait rootfstype=ext4 no_console_suspend' /boot/Image.gz-4.9" >> ${IMAGE_ROOTFS}/var/lib/opkg/info/kernel-image.postinst; \
    chmod 777 ${IMAGE_ROOTFS}/var/lib/opkg/info/kernel-image.postinst; \
    mkdir -p ${DEPLOY_DIR_IMAGE}/${IMAGEDIR}; \
    mkbootimg --base 0 --kernel_offset 0x1080000 --second_offset 0x1000000 -o ${DEPLOY_DIR_IMAGE}/${IMAGEDIR}/${KERNEL_FILE} --kernel ${DEPLOY_DIR_IMAGE}/Image.gz --second ${DEPLOY_DIR_IMAGE}/${MACHINEBUILD}.dtb --board ${BOARD} --cmdline "logo=osd0,loaded,0x7f800000 vout=1080p60hz,enable hdmimode=1080p60hz fb_width=1280 fb_height=720  console=ttyS0,1000000 root=/dev/mmcblk0p7 rootwait rootfstype=ext4 no_console_suspend"; \
    echo ${DISTRO_NAME}-${DISTRO_VERSION}.${BUILD_VERSION} > ${DEPLOY_DIR_IMAGE}/${IMAGEDIR}/imageversion; \
    echo "To update with the webbrowser select rootfs-${BOARD}.tar.bz2" > ${DEPLOY_DIR_IMAGE}/${IMAGEDIR}/${MACHINEBUILD}_READ.ME; \
    cd ${IMAGE_ROOTFS}; \
    /usr/bin/fakeroot tar -cvf ${DEPLOY_DIR_IMAGE}/rootfs-${BOARD}.tar -C ${IMAGE_ROOTFS} .; \
    mv ${DEPLOY_DIR_IMAGE}/rootfs-${BOARD}.tar ${DEPLOY_DIR_IMAGE}/${IMAGEDIR}/rootfs-${BOARD}.tar; \
    bzip2 ${DEPLOY_DIR_IMAGE}/${IMAGEDIR}/rootfs-${BOARD}.tar; \
    cd ${DEPLOY_DIR_IMAGE}; \
    zip ${IMAGE_NAME}_mmc.zip ${IMAGEDIR}/*; \
    rm -f ${DEPLOY_DIR_IMAGE}/*.rootfs-${BOARD}.tar.bz2; \
    rm -f ${DEPLOY_DIR_IMAGE}/.tar.bz2; \
    rm -f ${DEPLOY_DIR_IMAGE}/*.manifest; \
    rm -f ${DEPLOY_DIR_IMAGE}/.manifest; \
    rm -Rf ${IMAGEDIR}; \
    "

IMAGE_CMD:tar:append = " ; \
    cd ${DEPLOY_DIR_IMAGE}; \
    rm -f .manifest; \
    "

MODUTILS_LOAD_MODULE = "modprobe"
MODUTILS_START_PRIORITY = "06"

BBMASK += "modutils-initscripts.*\.bbappend"
```

## meta-brands/meta-dream/conf/machine/include/dreambox-meson64.inc
```bitbake
# dreambox-arm.inc
# We know about rtc
include conf/machine/include/build-extras.inc

BRAND_OEM = "dreambox"
MACHINE_BRAND = "Dreambox"

DVBSKYPROVIDER = "kernel"

# the audio decoder of the dreamaudiod service, the video through the Dream decoder interface;
# H.263 and Sorenson Spark reach the MPEG-4 decoder through the flv2mpeg4 element
DVBMEDIASINK_CONFIG = "--with-pcm --with-eac3 --with-dts --with-aac-loas --with-audio-device=/dev/dvb/adapter0/dreamaudio0 --with-h265 --with-wmv --with-vb9 --with-vb6=no --with-vb8=no --with-spark=no --with-h263=no"

GLIBC_EXTRA_OECONF = "--with-tls --with-__thread"
TARGET_ARCH = "aarch64"
DEFAULTTUNE = "aarch64"

include conf/machine/include/autoload-filesystems.inc
require conf/machine/include/soc-family.inc
require conf/machine/box-hardware.inc
require conf/machine/include/arm/arch-armv8a.inc

# temp off gcc 10 build issue
#INHERIT += "opendreambox-multilib"
#require conf/machine/multilib.inc

MACHINE_EXTRA_RRECOMMENDS += "\
    ffmpeg \
    enigma2-plugin-systemplugins-serviceapp \
    gstreamer1.0-plugin-dvbmediasink \
    gstreamer1.0-plugins-ugly-realmedia \
    gstreamer1.0-libav \
    gstreamer1.0-plugins-ugly-dvdlpcmdec \
    gstreamer1.0-plugins-ugly-realmedia \
    kernel-module-cifs \
    kernel-module-autofs4 \
    kernel-module-hmac \
    kernel-module-md4 \
    kernel-module-ecb \
    kernel-module-fuse \
    kernel-module-nfsd \
    kernel-module-exportfs \
    kernel-module-snd-oss \
    kernel-module-snd-pcm-oss \
    kernel-modules \
"

MACHINE_ESSENTIAL_EXTRA_RRECOMMENDS = "\
    bcmdhd \
    dreambox-dvb-modules-${SOC_FAMILY} \
    dreammosaic \
    meson-mali-module-bifrost-r12p0 \
    flash-nrf52 \
    nrf52-firmware-${MACHINEBUILD} \
    nrf52-firmware-rcu \
    tpmd \
    tpm-ca \
    dreambox-bootlogo \
    fbset \
    fbset-modes \
    dp-device \
    dream-gpt-startup \
    bcm4356-bt-firmware \
"

MACHINE_ESSENTIAL_EXTRA_RDEPENDS += "\
    u-boot-bin \
    dreamaudiod \
"

MACHINE_FEATURES += "dreambox alsa usbhost 3dtv switchoff blindscan-dvbs kodi22 inibt"
# Add "dreambox" override for recipes
MACHINEOVERRIDES .= ":dreambox"

PREFERRED_PROVIDER_virtual/kodi = "stb-kodi-${SOC_FAMILY}"

VIRTUAL-RUNTIME_blindscan_dvbs = "dreambox-blindscan-utils"
VIRTUAL-RUNTIME_blindscan_dvbc = "dreambox-blindscan-utils"
PREFERRED_PROVIDER_jpeg = "libjpeg-turbo"
PREFERRED_PROVIDER_jpeg-native = "libjpeg-turbo-native"
PREFERRED_PROVIDER_virtual/fftw = "fftw"

PREFERRED_PROVIDER_virtual/kernel = "linux-${SOC_FAMILY}"
PREFERRED_VERSION_linux-${SOC_FAMILY} = "4.9.%"

MACHINE_FEATURES_OPTED_OUT = "rtc gobject-introspection-data"

# Add "MACHINEBUILD" override for recipes
MACHINEOVERRIDES =. "${@['', '${MACHINEBUILD}:']['${MACHINEBUILD}' != '']}"

PACKAGECONFIG:ffmpeg:append = "libv4l2"
EXTRA_OECONF:append:pn-enigma2 = " --with-alsa  --with-alsacard=hw:0  --with-alsamixer=Master --with-fbdev=/dev/fb0 --with-lcddev=/dev/null "
EXTRA_OECONF:append:pn-tuxtxt-enigma2 = " --with-fbdev=/dev/fb0"
```

## meta-brands/meta-edision/conf/machine/ed72604.conf
```bitbake
# MACHINEBUILDS: osmini4k osmio4k osmio4kplus
#@TYPE: Machine
#@NAME: ed72604
#@DESCRIPTION: Shared machine for Edision OSmini4K / OSmio4K / OSmio4K Plus (bcm72604)

MACHINE_NAME:osmini4k    = "OS mini 4k"
MACHINE_NAME:osmio4k     = "OS mio 4k"
MACHINE_NAME:osmio4kplus = "OS mio 4k plus"

OEM_ARCH = "${MACHINEBUILD}"

RCNAME     = "edision3"
SOC_FAMILY = "bcm72604"

MTD_BOOTFS  = "mmcblk1p1"
MTD_BLACK   = "mmcblk1"
MTD_KERNEL  = "mmcblk1p2"
MTD_ROOTFS  = "mmcblk1p3"
KERNEL_FILE = "kernel.bin"
ROOTFS_FILE = "rootfs.tar.bz2"

# Common MACHINE_FEATURES + per-box appends
MACHINE_FEATURES += "swap hbbtv-browser-webkit videoenhancement skins1080 ${E2EGL_WQHD_FEATURE} blindscan-tbs blindscan-dvbs mountboot HDMI kodi22 wifi-direct openhbbtv ${E2EGL_MACHINE_FEATURE}"
MACHINE_FEATURES:append:osmini4k    = " 7segment"
MACHINE_FEATURES:append:osmio4k     = " 7segment dvb-c inibt blindscan-dvbc"
MACHINE_FEATURES:append:osmio4kplus = " bwlcd128 dvb-c inibt blindscan-dvbc"

PREFERRED_PROVIDER_virtual/egl     = "edision-libv3d"

# Dedicated Edision V3D native ABI; enable only the current hardware target.
MACHINE_FEATURES += "retrogaming retrogaming-bcm-v3d"
PREFERRED_PROVIDER_virtual/libgles2 = "edision-libv3d"
PREFERRED_PROVIDER_virtual/kodi    = "stb-kodi-${MACHINEBUILD}"

# osmio4k and osmio4kplus want BT + Wi-Fi modules auto-loaded
KERNEL_MODULE_AUTOLOAD:append:osmio4k     = " hci_uart wlan"
KERNEL_MODULE_AUTOLOAD:append:osmio4kplus = " hci_uart wlan"

PACKAGECONFIG_ffmpeg:append:osmio4k     = " libv4l2"
PACKAGECONFIG_ffmpeg:append:osmio4kplus = " libv4l2"

MACHINE_ESSENTIAL_EXTRA_RRECOMMENDS:append:osmio4k     = " kernel-module-btqca kernel-module-hci-uart"
MACHINE_ESSENTIAL_EXTRA_RRECOMMENDS:append:osmio4kplus = " kernel-module-btqca kernel-module-hci-uart"

require conf/machine/include/edision-arm.inc
```

## meta-brands/meta-edision/conf/machine/ed73625.conf
```bitbake
# MACHINEBUILDS: osninoplus osninopro
#@TYPE: Machine
#@NAME: ed73625
#@DESCRIPTION: Shared machine for Edision OS nino+/nino pro (bcm73625)

MACHINE_NAME:osninoplus = "OS nino+"
MACHINE_NAME:osninopro  = "OS nino pro"

RCNAME:osninoplus = "edision1"
RCNAME:osninopro  = "edision2"

FLASHSIZE = "512"

PREFERRED_VERSION_linux-edision = "4.8.17"

OEM_ARCH = "${MACHINEBUILD}"

SOC_FAMILY = "bcm73625"

UBI_VOLNAME = "rootfs"
MKUBIFS_ARGS = "-m 2048 -e 126976 -c 4096 -F"
UBINIZE_ARGS = "-m 2048 -p 128KiB"

### 8723BS wireless/bluetooth ###
KERNEL_MODULE_AUTOLOAD += "r8723bs"
KERNEL_MODULE_AUTOLOAD += "8723ds"
KERNEL_MODULE_AUTOLOAD += "hci_uart"

MACHINE_ESSENTIAL_EXTRA_RRECOMMENDS += " \
    kernel-module-hci-uart \
    "

MACHINE_EXTRA_RRECOMMENDS += " \
    rtk-hciattach \
    linux-firmware-8723bs \
    linux-firmware-8723ds \
    "

DVBMEDIASINK_CONFIG = "--with-wma --with-wmv --with-pcm --with-dts --with-eac3 --with-h265 --with-vb6 --with-vb8 --with-spark"

require conf/machine/include/edision.inc

MACHINE_FEATURES += "ubimb chkrootmb emmc videoenhancement skins1080 7segment dvb-c inibt"
MACHINE_FEATURES:append:osninopro = " blindscan-dvbs blindscan-dvbc"
```

## meta-brands/meta-formuler/conf/machine/fm7356.conf
```bitbake
# MACHINEBUILDS: formuler1 formuler1tc
#@TYPE: Machine
#@NAME: fm7356
#@DESCRIPTION: Shared machine for Formuler F1 (bcm7356)

MACHINE_NAME = "F1"

RCHARDWARE:formuler1 = "V2"

IMAGEDIR:formuler1tc = "formuler1"

FLASHSIZE = "512"

PREFERRED_VERSION_linux-formuler = "4.10.6"

OEM_ARCH = "${MACHINEBUILD}"

SOC_FAMILY = "bcm7356"

UBI_VOLNAME = "rootfs"
MKUBIFS_ARGS = "-m 2048 -e 126976 -c 8192"
UBINIZE_ARGS = "-m 2048 -p 128KiB"

MACHINE_FEATURES += "ubimb chkrootmb emmc dvb-c textlcd videoenhancement HDMI YUV RCA"
MACHINE_FEATURES:append:formuler1   = " v3d kodi22 ${E2EGL_MACHINE_FEATURE}"
MACHINE_FEATURES:append:formuler1tc = " multitranscoding al-driver"

require conf/machine/include/formuler.inc
```

## meta-brands/meta-formuler/conf/machine/fm7362.conf
```bitbake
# MACHINEBUILDS: formuler3 formuler3ip formuler4 formuler4ip
#@TYPE: Machine
#@NAME: fm7362
#@DESCRIPTION: Shared machine for Formuler F3/F4 (bcm7362)

MACHINE_NAME:formuler3   = "F3"
MACHINE_NAME:formuler3ip = "F3"
MACHINE_NAME:formuler4   = "F4"
MACHINE_NAME:formuler4ip = "F4"

RCHARDWARE:formuler3 = "V2"
RCHARDWARE:formuler4 = "V2"

IMAGEDIR:formuler3ip = "formuler3"
IMAGEDIR:formuler4ip = "formuler4"

FLASHSIZE = "256"

PREFERRED_VERSION_linux-formuler = "4.10.6"

OEM_ARCH = "${MACHINEBUILD}"

SOC_FAMILY = "bcm7362"

UBI_VOLNAME = "rootfs"
MKUBIFS_ARGS = "-m 2048 -e 126976 -c 8192"
UBINIZE_ARGS = "-m 2048 -p 128KiB"

MACHINE_FEATURES += "ubimb chkrootmb emmc videoenhancement 7segment HDMI singlecore"
MACHINE_FEATURES:append:formuler3ip = " al-driver"
MACHINE_FEATURES:append:formuler4   = " AV_JACK"
MACHINE_FEATURES:append:formuler4ip = " al-driver AV_JACK"

require conf/machine/include/formuler.inc
```

## meta-brands/meta-gfutures/conf/machine/hd61.conf
```bitbake
# MACHINEBUILDS: ax61
#@TYPE: Machine
#@NAME: hd61
#@DESCRIPTION: Machine configuration for the hd61

SOC_FAMILY = "hisi3798mv200"
HICHIPSET = "3798mv200"
VER = "-v2"

MACHINE_FEATURES += " hisil mali emmc mmc 7segment skins1080 ${E2EGL_WQHD_FEATURE} multitranscoding kodi22 himedia no-subssupport blindscan-dvbs gfwol WOL dvb-c ci fastboot mountboot hbbtv-browser-webkit ${E2EGL_MACHINE_FEATURE}"

EXTRA_OECONF:append:pn-enigma2 = " --with-alphablendingacceleration=always --with-blitaccelerationthreshold=250  --with-fillaccelerationthreshold=190000"

KERNEL_FILE = "uImage"
ROOTFS_FILE = "rootfs.tar.bz2"
MTD_BLACK  = "mmcblk0"
MTD_BOOTFS = "mmcblk0p4"

IMAGE_CLASSES += "hdemmc-fastboot8gb_image"
IMAGE_FSTYPES += "hdfastboot8gb"

require conf/machine/include/gfutures-hisil-3798mv200.inc
```
