## meta-brands/meta-gfutures/conf/machine/vs1500.conf
```bitbake
# MACHINEBUILDS: vimastec1500
SOC_FAMILY = "bcm7251s"

FLASHSIZE = "1024"

require conf/machine/include/gfutures-arm.inc

MACHINE_FEATURES += " ci skins1080 ${E2EGL_WQHD_FEATURE} emmc mmc textlcd dvb-c swap kodi22 mountboot v3d-nxpl ${E2EGL_MACHINE_FEATURE}"

MACHINE_KERNEL_PR = "r0"

MTD_BOOTFS = "mmcblk0p1"
KERNEL_FILE = "kernel.bin"
ROOTFS_FILE = "rootfs.tar.bz2"
MTD_BLACK  = "mmcblk0"
```

## meta-brands/meta-maxytec/conf/machine/multiboxpro.conf
```bitbake
# MACHINEBUILDS: novaler4kpro
#@TYPE: Machine
#@NAME: Maxytec Multibox PRO
#@DESCRIPTION: Machine configuration for the Multibox PRO

SOC_FAMILY = "hisi3798mv200"
HICHIPSET = "3798mv200"
VER = "-v2"

MTD_ROOTFS = "mmcblk0p20"
MTD_KERNEL = "mmcblk0p19"
KERNEL_FILE = "uImage"
ROOTFS_FILE = "rootfs.tar.bz2"
MTD_BLACK  = "mmcblk0"
MTD_BOOTFS = "mmcblk0p4"

MACHINE_FEATURES += " AV_JACK hisil-3798mv200 mali emmc skins1080 ${E2EGL_WQHD_FEATURE} 7segment multitranscoding kodi22 himedia no-subssupport blindscan-dvbs dvb-c adwol WOL fastboot hisi-recovery mountboot ${E2EGL_MACHINE_FEATURE}"

EXTRA_OECONF:append:pn-enigma2 = " --with-alphablendingacceleration=always --with-blitaccelerationthreshold=250  --with-fillaccelerationthreshold=190000"

require conf/machine/include/maxytec-hisil-3798mv200.inc
```

## meta-brands/meta-odin/conf/machine/e3hd.conf
```bitbake
require conf/machine/include/odin-oem.inc

SOC_FAMILY = "bcm7358"

RCTYPE = "504"
RCNAME = "e3hd"

# Broken bootloader can only flash around 100 MB
FLASHSIZE = "96"

PREFERRED_VERSION_linux-odin = "3.18.24"

MACHINE_FEATURES += " ubimb chkrootmb emmc videoenhancement smallflash blindscan-tbs RCA NO_SCART_SWITCH singlecore"
```

## meta-brands/meta-skylake/conf/machine/hd2400.conf
```bitbake
# MACHINEBUILDS: mutant2400 quadbox2400
SOC_FAMILY = "bcm7425"

FLASHSIZE = "1024"

UBI_VOLNAME = "rootfs"
MKUBIFS_ARGS = "-m 2048 -e 126976 -c 8192"
UBINIZE_ARGS = "-m 2048 -p 128KiB"

PREFERRED_VERSION_linux-skylake = "4.10.12"

require conf/machine/include/skylake-oem.inc

MACHINE_FEATURES += "ubimb chkrootmb emmc dvb-c ci fanctrl bwlcd255 videoenhancement skins1080 ${E2EGL_WQHD_FEATURE} multitranscoding blindscan-tbs kodi22 SCART YUV RCA HDMI-IN-HD v3d-nxpl ${E2EGL_MACHINE_FEATURE}"

IMAGE_CMD:ubifs:prepend = " \
    rm -rf ${IMAGE_ROOTFS}/boot/*; \
    rm -rf ${IMAGE_ROOTFS}/tmp/*; \
    "
```

## meta-brands/meta-ultramini/conf/machine/ultramini.conf
```bitbake
# MACHINEBUILDS: et7x00mini xpeedlxcc xpeedlxcs2
require conf/machine/include/ultramini-oem.inc

SOC_FAMILY = "bcm7362"

PREFERRED_VERSION_linux-ultramini = "4.1.21"

MACHINE_FEATURES += " ubimb chkrootmb emmc videoenhancement blindscan-tbs HDMI RCA singlecore"

MACHINE_KERNEL_PR = "r0"
```

## meta-brands/meta-vuplusde/conf/machine/include/vuplus.inc
```bitbake
PACKAGECONFIG_GL:pn-qtbase ?= "gles2 eglfs linuxfb"
PACKAGECONFIG_FB:pn-qtbase = " "

# We know about rtc
include conf/machine/include/build-extras.inc

RCNAME = "vu6"
MACHINE_NAME = "Duo4kLite"
BRAND_OEM = "vuplus"
MACHINE_BRAND = "Vu+"
RCHARDWARE = "VU"
IMAGEDIR ?= "vuplus/duo4klite"
MTD_KERNEL = "mmcblk0p4"
MTD_ROOTFS = "mmcblk0p13"
MULTIBOOT_STARTUP_DEFAULT ?= "STARTUP_1"

MACHINE_ESSENTIAL_EXTRA_RDEPENDS += " \
    vuplus-platform-util-${MACHINE} \
    "

DVBPROVIDER = "kernel"

MACHINE_ESSENTIAL_EXTRA_RRECOMMENDS += " \
    kernel-module-cdfs \
    kernel-module-zram \
    kernel-module-ext2 \
    kernel-module-ext3 \
    kernel-module-ext4 \
    kernel-module-cifs \
    kernel-module-autofs4 \
    firmware-aic8800d80 \
    vuplus-aic8800-driver \
    resizerootfs \
    vuplus-swapcreate \
    "

MACHINE_EXTRA_RRECOMMENDS += " \
    gstreamer1.0-plugin-dvbmediasink \
    gstreamer1.0-libav \
    vuplus-initrd-cfe-${MACHINE} \
    "

include conf/machine/include/autoload-filesystems.inc

PREFERRED_PROVIDER_virtual/transtreamproxy = "vuplus-transtreamproxy"

PREFERRED_PROVIDER_virtual/kernel = "linux-vuplus"
PREFERRED_PROVIDER_virtual/kodi = "stb-kodi-${MACHINE}"

KERNEL_OUTPUT = "${KERNEL_IMAGETYPE}"
KERNEL_CONSOLE = "ttyS0,115200n8"

MACHINE_FEATURES += "3dtv alsa hdmicec switchoff bootsplash skins1080 blindscan-tbs HDMI HDMI-IN-FHD"

BOOTLOGO_FILENAME = "splash.bin"

require conf/machine/include/soc-family.inc
require conf/machine/box-hardware.inc

TARGET_ARCH = "arm"
DEFAULTTUNE = "cortexa15hf-neon-vfpv4"
IMAGE_FSTYPES =+ "tar.bz2"

require conf/machine/include/arm/armv7a/tune-cortexa15.inc

VIRTUAL-RUNTIME_blindscan_dvbc = "vuplus-blindscan-dvbc-utils"
VIRTUAL-RUNTIME_blindscan_dvbs = "vuplus-blindscan-dvbs-utils"
PREFERRED_PROVIDER_virtual/egl = "vuplus-v3ddriver-${MACHINE}"
PREFERRED_PROVIDER_virtual/libgles2 = "vuplus-v3ddriver-${MACHINE}"
PREFERRED_PROVIDER_virtual/chromium-browser = "chromium-browser-${MACHINE}"

DVBMEDIASINK_CONFIG = "--with-wma --with-wmv --with-amr --with-pcm --with-dts --with-eac3 --with-h265 --with-vb6 --with-vb8 --with-vb9 --with-spark"

MACHINE_FEATURES += " omb mmc emmc swap"

GLIBC_EXTRA_OECONF = "--with-tls --with-__thread"

IMAGE_CMD:tar:prepend = "\
	mkdir -p ${IMAGE_ROOTFS}/usr/lib; \
	if [ "${PACKAGE_LIST}" = "1" ]; then \
        cp ${IMAGE_MANIFEST} ${IMAGE_ROOTFS}/usr/lib/package.lst; \
    fi; \
    mkdir -p ${DEPLOY_DIR_IMAGE}/${IMAGEDIR}; \
    ${@bb.utils.contains("MACHINE_FEATURES", "bootsplash", "cp ${DEPLOY_DIR_IMAGE}/${BOOTLOGO_FILENAME} ${DEPLOY_DIR_IMAGE}/${IMAGEDIR}/${BOOTLOGO_FILENAME};" , "", d)} \
    cp ${DEPLOY_DIR_IMAGE}/${MACHINE}_boot.bin ${DEPLOY_DIR_IMAGE}/${IMAGEDIR}/boot.bin; \
    cp ${DEPLOY_DIR_IMAGE}/${MACHINE}_rescue.bin ${DEPLOY_DIR_IMAGE}/${IMAGEDIR}/rescue.bin; \
    cp ${DEPLOY_DIR_IMAGE}/${MACHINE}_initrd.bin ${DEPLOY_DIR_IMAGE}/${IMAGEDIR}/initrd.bin; \
    cp ${DEPLOY_DIR_IMAGE}/zImage ${DEPLOY_DIR_IMAGE}/${IMAGEDIR}/${KERNEL_FILE}; \
    echo ${DISTRO_NAME}-${DISTRO_VERSION}.${BUILD_VERSION} > ${DEPLOY_DIR_IMAGE}/${IMAGEDIR}/imageversion; \
    touch ${DEPLOY_DIR_IMAGE}/${IMAGEDIR}/${MULTIBOOT_STARTUP_DEFAULT}; \
    cd ${IMAGE_ROOTFS}; \
    rm -rf ${IMAGE_ROOTFS}/tmp/*; \
    tar -cvf ${DEPLOY_DIR_IMAGE}/rootfs.tar -C ${IMAGE_ROOTFS} .; \
    mv ${DEPLOY_DIR_IMAGE}/rootfs.tar ${DEPLOY_DIR_IMAGE}/${IMAGEDIR}/rootfs.tar; \
    bzip2 ${DEPLOY_DIR_IMAGE}/${IMAGEDIR}/rootfs.tar; \
    cd ${DEPLOY_DIR_IMAGE}; \
    zip ${IMAGE_NAME}_usb.zip ${IMAGEDIR}/*; \
    rm -f ${DEPLOY_DIR_IMAGE}/*.rootfs.tar.bz2; \
    rm -f ${DEPLOY_DIR_IMAGE}/.tar.bz2; \
    rm -f ${DEPLOY_DIR_IMAGE}/*.manifest; \
    rm -f ${DEPLOY_DIR_IMAGE}/.manifest; \
    rm -Rf vuplus; \
"

# Add "MACHINEBUILD" override for recipes
MACHINEOVERRIDES =. "${@['', '${MACHINEBUILD}:']['${MACHINEBUILD}' != '']}"
```

## meta-brands/meta-xtrend/conf/machine/xt7413.conf
```bitbake
# MACHINEBUILDS: et5x00 et6x00 et9x00
#@TYPE: Machine
#@NAME: xt7413
#@DESCRIPTION: Shared machine for Xtrend ET5X00/ET6X00/ET9X00 (bcm7413)

MACHINE_NAME:et5x00 = "ET5X00"
MACHINE_NAME:et6x00 = "ET6X00"
MACHINE_NAME:et9x00 = "ET9X00"

RCTYPE:et5x00 = "7"
RCTYPE:et6x00 = "7"
RCTYPE:et9x00 = "5"

RCNAME:et5x00 = "et6x00"
RCNAME:et6x00 = "et6x00"
RCNAME:et9x00 = "et9x00"

RCHARDWARE = "V2"

# Broken bootloader can only flash around 100 MB
FLASHSIZE = "96"

PREFERRED_VERSION_linux-etxx00 = "3.8.7"

OEM_ARCH = "${MACHINEBUILD}"

SOC_FAMILY = "bcm7413"

UBI_VOLNAME = "rootfs"
MKUBIFS_ARGS = "-m 2048 -e 126976 -c 4096"
UBINIZE_ARGS = "-m 2048 -p 128KiB"

MACHINE_FEATURES += "ubimb chkrootmb emmc skins1080 feature2 blindscan-tbs blindscan-dvbs boxmodel HDMI YUV smallflash oem-info"
MACHINE_FEATURES:append:et5x00 = " nolcd NO_SCART_SWITCH"
MACHINE_FEATURES:append:et6x00 = " textlcd SCART NO_SCART_SWITCH"
MACHINE_FEATURES:append:et9x00 = " textlcd ci fanctrl SCART"

require conf/machine/include/etxx00.inc
```
