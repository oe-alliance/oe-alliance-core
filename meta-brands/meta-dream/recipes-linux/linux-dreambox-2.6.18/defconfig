## meta-brands/meta-edision/conf/machine/osninopro.conf
```bitbake
#@TYPE: Machine
#@NAME: Edision OSNINO
#@DESCRIPTION: Machine configuration for the Edision OSNINO

MACHINE_NAME = "OS nino pro"
RCNAME = "edision2"

FLASHSIZE = "512"

PREFERRED_VERSION_linux-edision = "4.8.17"

SOC_FAMILY = "bcm73625"

UBI_VOLNAME = "rootfs"
MKUBIFS_ARGS = "-m 2048 -e 126976 -c 4096 -F"
UBINIZE_ARGS = "-m 2048 -p 128KiB"

### 8723BS wireless/bluetooth ###
KERNEL_MODULE_AUTOLOAD += "r8723bs"
KERNEL_MODULE_AUTOLOAD += "8723ds"
KERNEL_MODULE_AUTOLOAD += "hci_uart"

MACHINE_ESSENTIAL_EXTRA_RRECOMMENDS += " \
    kernel-module-hci-uart \
    "

MACHINE_EXTRA_RRECOMMENDS += " \
    rtk-hciattach \
    linux-firmware-8723bs \
    linux-firmware-8723ds \
    "

DVBMEDIASINK_CONFIG = "--with-wma --with-wmv --with-pcm --with-dts --with-eac3 --with-h265 --with-vb6 --with-vb8 --with-spark"

require conf/machine/include/edision.inc

MACHINE_FEATURES += "videoenhancement skins1080 7segment dvb-c inibt blindscan-dvbs blindscan-dvbc"
```

## meta-brands/meta-entwopia/conf/layer.conf
```bitbake
# We have a conf and classes directory, append to BBPATH
BBPATH .= ":${LAYERDIR}"

# We have a recipes directory, add to BBFILES
BBFILES += "${LAYERDIR}/recipes-*/*.bb ${LAYERDIR}/recipes-*/*.bbappend \
            ${LAYERDIR}/recipes-*/*/*.bb ${LAYERDIR}/recipes-*/*/*.bbappend"

BBFILE_COLLECTIONS += "entwopia-layer"
BBFILE_PATTERN_entwopia-layer := "^${LAYERDIR}/"
BBFILE_PRIORITY_entwopia-layer = "7"

OEA-META-VENDOR-BASE := '${@os.path.normpath("${LAYERDIR}/../")}'
```

## meta-brands/meta-entwopia/conf/machine/ch625dt.conf
```bitbake
#@TYPE: Machine
#@NAME: ENTWOPIA ch625dt
#@DESCRIPTION: Machine configuration for the ENTWOPIA ch625dt

SOC_FAMILY = "bcm73625"

MACHINE_FEATURES += " ci videoenhancement 7segment textlcd linuxwifi"

PREFERRED_VERSION_linux-entwopia = "4.10.6"
PREFERRED_VERSION_linux-libc-headers = "4.10"

require conf/machine/include/entwopia-oem.inc

MACHINE_KERNEL_PR = "r0"

DVBSKYPROVIDER = "kernel"
```

## meta-brands/meta-entwopia/conf/machine/ch625lc.conf
```bitbake
#@TYPE: Machine
#@NAME: ENTWOPIA CH625LC
#@DESCRIPTION: Machine configuration for the ENTWOPIA ch625lc

SOC_FAMILY = "bcm73625"

MACHINE_FEATURES += " ci videoenhancement 7segment linuxwifi AV_JACK"

PREFERRED_VERSION_linux-entwopia = "4.10.6"

require conf/machine/include/entwopia-oem.inc

MACHINE_KERNEL_PR = "r0"

DVBSKYPROVIDER = "kernel"
```

## meta-brands/meta-entwopia/conf/machine/ch62lc.conf
```bitbake
#@TYPE: Machine
#@NAME: ENTWOPIA ch62lc
#@DESCRIPTION: Machine configuration for the ENTWOPIA ch62lc

SOC_FAMILY = "bcm7362"

MACHINE_FEATURES += " videoenhancement AV_JACK smallflash singlecore"

PREFERRED_VERSION_linux-entwopia = "3.14.2"

require conf/machine/include/entwopia-oem.inc

MACHINE_KERNEL_PR = "r0"
```

## meta-brands/meta-entwopia/conf/machine/ew7356.conf
```bitbake
#@TYPE: Machine
#@NAME: ENTWOPIA EW7358
#@DESCRIPTION: Machine configuration for the ENTWOPIA EW7356

SOC_FAMILY = "bcm7356"

MACHINE_FEATURES += "textlcd videoenhancement multitranscoding RCA YUV smallflash"

PREFERRED_VERSION_linux-entwopia = "3.14.2"
GCCVERSION:ew7356 = "10.%"

require conf/machine/include/entwopia-oem.inc

MACHINE_KERNEL_PR = "r0"
```

## meta-brands/meta-entwopia/conf/machine/ew7362.conf
```bitbake
#@TYPE: Machine
#@NAME: ENTWOPIA EW7362
#@DESCRIPTION: Machine configuration for the ENTWOPIA EW7362

SOC_FAMILY = "bcm7362"

MACHINE_FEATURES += " ci videoenhancement 7segment smallflash singlecore"

PREFERRED_VERSION_linux-entwopia = "3.14.2"

require conf/machine/include/entwopia-oem.inc
```

## meta-brands/meta-entwopia/conf/machine/include/entwopia-oem.inc
```bitbake
# We know about rtc
include conf/machine/include/build-extras.inc

BRAND_OEM = "entwopia"

MACHINE_NAME = "\
${@bb.utils.contains('MACHINEBUILD', 'enfinity', 'ENfinity' , '', d)}\
${@bb.utils.contains('MACHINEBUILD', 'marvel1', 'Marvel 1' , '', d)}\
${@bb.utils.contains('MACHINEBUILD', 'x2plus', 'enfinityX 2plus' , '', d)}\
${@bb.utils.contains('MACHINEBUILD', 'bre2ze', 'BRE2ZE' , '', d)}\
${@bb.utils.contains('MACHINEBUILD', 'evomini', 'ENfinity mini' , '', d)}\
${@bb.utils.contains('MACHINEBUILD', 'evominiplus', 'ENfinity mini+' , '', d)}\
${@bb.utils.contains('MACHINEBUILD', 'vipert2c', 'Viper T2/C' , '', d)}\
${@bb.utils.contains('MACHINEBUILD', 'vipercombo', 'Viper Combo' , '', d)}\
${@bb.utils.contains('MACHINEBUILD', 'vipercombohdd', 'Viper Combo HDD' , '', d)}\
${@bb.utils.contains('MACHINEBUILD', 'viperslim', 'Viper SLIM' , '', d)}\
"

MACHINE_BRAND = "\
${@bb.utils.contains('MACHINEBUILD', 'enfinity', 'EVO' , '', d)}\
${@bb.utils.contains('MACHINEBUILD', 'marvel1', 'VisionNet' , '', d)}\
${@bb.utils.contains('MACHINEBUILD', 'x2plus', 'EVO' , '', d)}\
${@bb.utils.contains('MACHINEBUILD', 'bre2ze', 'WWIO' , '', d)}\
${@bb.utils.contains('MACHINEBUILD', 'evomini', 'EVO' , '', d)}\
${@bb.utils.contains('MACHINEBUILD', 'evominiplus', 'EVO' , '', d)}\
${@bb.utils.contains('MACHINEBUILD', 'vipert2c', 'AMIKO' , '', d)}\
${@bb.utils.contains('MACHINEBUILD', 'vipercombo', 'AMIKO' , '', d)}\
${@bb.utils.contains('MACHINEBUILD', 'vipercombohdd', 'AMIKO' , '', d)}\
${@bb.utils.contains('MACHINEBUILD', 'viperslim', 'AMIKO' , '', d)}\
"

IMAGEDIR ?= "\
${@bb.utils.contains('MACHINEBUILD', 'enfinity', 'enfinity' , '', d)}\
${@bb.utils.contains('MACHINEBUILD', 'marvel1', 'marvel1' , '', d)}\
${@bb.utils.contains('MACHINEBUILD', 'x2plus', 'x2plus' , '', d)}\
${@bb.utils.contains('MACHINEBUILD', 'bre2ze', 'bre2ze' , '', d)}\
${@bb.utils.contains('MACHINEBUILD', 'evomini', 'mini' , '', d)}\
${@bb.utils.contains('MACHINEBUILD', 'evominiplus', 'miniplus' , '', d)}\
${@bb.utils.contains('MACHINEBUILD', 'vipert2c', 'vipert2c' , '', d)}\
${@bb.utils.contains('MACHINEBUILD', 'vipercombo', 'vipercombo' , '', d)}\
${@bb.utils.contains('MACHINEBUILD', 'vipercombohdd', 'vipercombohdd' , '', d)}\
${@bb.utils.contains('MACHINEBUILD', 'viperslim', 'viperslim' , '', d)}\
"

MTD_KERNEL ?= "\
${@bb.utils.contains('MACHINEBUILD', 'enfinity', 'mtd2' , '', d)}\
${@bb.utils.contains('MACHINEBUILD', 'marvel1', 'mtd2' , '', d)}\
${@bb.utils.contains('MACHINEBUILD', 'x2plus', 'mtd2' , '', d)}\
${@bb.utils.contains('MACHINEBUILD', 'bre2ze', 'mtd2' , '', d)}\
${@bb.utils.contains('MACHINEBUILD', 'evomini', 'mtd2' , '', d)}\
${@bb.utils.contains('MACHINEBUILD', 'evominiplus', 'mtd2' , '', d)}\
${@bb.utils.contains('MACHINEBUILD', 'vipert2c', 'mtd2' , '', d)}\
${@bb.utils.contains('MACHINEBUILD', 'vipercombo', 'mtd2' , '', d)}\
${@bb.utils.contains('MACHINEBUILD', 'vipercombohdd', 'mtd2' , '', d)}\
${@bb.utils.contains('MACHINEBUILD', 'viperslim', 'mtd2' , '', d)}\
"

MTD_ROOTFS ?= "\
${@bb.utils.contains('MACHINEBUILD', 'enfinity', 'mtd0' , '', d)}\
${@bb.utils.contains('MACHINEBUILD', 'marvel1', 'mtd0' , '', d)}\
${@bb.utils.contains('MACHINEBUILD', 'x2plus', 'mtd0' , '', d)}\
${@bb.utils.contains('MACHINEBUILD', 'bre2ze', 'mtd0' , '', d)}\
${@bb.utils.contains('MACHINEBUILD', 'evomini', 'mtd0' , '', d)}\
${@bb.utils.contains('MACHINEBUILD', 'evominiplus', 'mtd0' , '', d)}\
${@bb.utils.contains('MACHINEBUILD', 'vipert2c', 'mtd0' , '', d)}\
${@bb.utils.contains('MACHINEBUILD', 'vipercombo', 'mtd0' , '', d)}\
${@bb.utils.contains('MACHINEBUILD', 'vipercombohdd', 'mtd0' , '', d)}\
${@bb.utils.contains('MACHINEBUILD', 'viperslim', 'mtd0' , '', d)}\
"

KERNEL_FILE = "kernel.bin"
ROOTFS_FILE = "rootfs.bin"

MACHINE_ESSENTIAL_EXTRA_RDEPENDS = "\
    entwopia-dvb-modules-${MACHINE} \
    "

DVBPROVIDER = "kernel"

MACHINE_ESSENTIAL_EXTRA_RRECOMMENDS = "\
    kernel-module-cdfs \
    "

MACHINE_EXTRA_RRECOMMENDS = " \
    gstreamer1.0-plugin-dvbmediasink \
    "

include conf/machine/include/autoload-filesystems.inc

DVBMEDIASINK_CONFIG = "--with-wma --with-wmv --with-pcm --with-dts --with-eac3 \
    ${@bb.utils.contains('MACHINE', 'ch625lc', '--with-h265 --with-vb6 --with-vb8 --with-spark' , '', d)} \
    ${@bb.utils.contains('MACHINE', 'yh625tc', '--with-h265 --with-vb6 --with-vb8 --with-spark' , '', d)} \
    ${@bb.utils.contains('MACHINE', 'yh625dt', '--with-h265 --with-vb6 --with-vb8 --with-spark' , '', d)} \
    ${@bb.utils.contains('MACHINE', 'ch625dt', '--with-h265 --with-vb6 --with-vb8 --with-spark' , '', d)} \
    ${@bb.utils.contains('MACHINE', 'yh73625', '--with-h265 --with-vb6 --with-vb8 --with-spark' , '', d)} \
"

TARGET_ARCH = "mipsel"
DEFAULTTUNE = "mips32el"

GLIBC_EXTRA_OECONF = "--with-tls --with-__thread"

PREFERRED_PROVIDER_virtual/kernel = "linux-entwopia"

KERNEL_IMAGETYPE = "vmlinux"
KERNEL_OUTPUT = "${KERNEL_IMAGETYPE}"
KERNEL_CONSOLE = "ttyS0,115200n8"

IMAGE_FSTYPES ?= "ubi"

UBI_VOLNAME = "rootfs"
MKUBIFS_ARGS = "-m 2048 -e 126976 -c 4096"
UBINIZE_ARGS = "-m 2048 -p 128KiB"

FORCE ?= "no"

IMAGE_CMD_ubi_prepend = " \
    rm -rf ${IMAGE_ROOTFS}/boot/*; \
    rm -rf ${IMAGE_ROOTFS}/tmp/*; \
    "

IMAGE_CMD_ubi_append = "\
    mkdir -p ${DEPLOY_DIR_IMAGE}/${IMAGEDIR}; \
    ${@bb.utils.contains("MACHINE_FEATURES", "bootsplash", "cp ${DEPLOY_DIR_IMAGE}/${BOOTLOGO_FILENAME} ${DEPLOY_DIR_IMAGE}/${IMAGEDIR}/${BOOTLOGO_FILENAME};" , "", d)} \
    mv ${IMGDEPLOYDIR}/${IMAGE_NAME}.rootfs.ubi ${DEPLOY_DIR_IMAGE}/${IMAGEDIR}/rootfs.bin; \
    gzip -9c ${DEPLOY_DIR_IMAGE}/vmlinux-${MACHINE}.bin > ${DEPLOY_DIR_IMAGE}/${IMAGEDIR}/kernel.bin; \
    echo ${IMAGE_VER_STRING} > ${DEPLOY_DIR_IMAGE}/${IMAGEDIR}/imageversion; \
    if [ "${FORCE}" = "yes" ]; then \
        echo "rename this file to 'noforce' to force an update with confirmation" > ${DEPLOY_DIR_IMAGE}/${IMAGEDIR}/force; \
    else \
        echo "rename this file to 'force' to force an update without confirmation" > ${DEPLOY_DIR_IMAGE}/${IMAGEDIR}/noforce; \
    fi; \
    cd ${DEPLOY_DIR_IMAGE}; \
    zip ${IMAGE_NAME}_usb.zip ${IMAGEDIR}/*; \
    rm -f ${DEPLOY_DIR_IMAGE}/*.ubi; \
    rm -f ${DEPLOY_DIR_IMAGE}/*.ubifs; \
    rm -f ${DEPLOY_DIR_IMAGE}/*.manifest; \
    rm -f ${DEPLOY_DIR_IMAGE}/.ubifs; \
    rm -f ${DEPLOY_DIR_IMAGE}/.manifest; \
    rm -Rf ${IMAGEDIR}; \
    "


MACHINE_FEATURES += "3dtv alsa hdmicec switchoff bootsplash omb skins1080 feature1 feature2 blindscan-tbs "

BOOTLOGO_FILENAME = "splash.bin"

require conf/machine/include/tune-mips32.inc
require conf/machine/include/soc-family.inc

OEM_ARCH = "${MACHINEBUILD}"

# Add "MACHINEBUILD" override for recipes
MACHINEOVERRIDES =. "${@['', '${MACHINEBUILD}:']['${MACHINEBUILD}' != '']}"
```

## meta-brands/meta-entwopia/conf/machine/yh625dt.conf
```bitbake
#@TYPE: Machine
#@NAME: ENTWOPIA yh625dt
#@DESCRIPTION: Machine configuration for the ENTWOPIA yh625dt

SOC_FAMILY = "bcm73625"

MACHINE_FEATURES += " videoenhancement 7segment textlcd linuxwifi"

PREFERRED_VERSION_linux-entwopia = "4.10.6"
PREFERRED_VERSION_linux-libc-headers = "4.10"

require conf/machine/include/entwopia-oem.inc

MACHINE_KERNEL_PR = "r0"

DVBSKYPROVIDER = "kernel"
```

## meta-brands/meta-entwopia/conf/machine/yh625tc.conf
```bitbake
#@TYPE: Machine
#@NAME: ENTWOPIA yh625tc
#@DESCRIPTION: Machine configuration for the ENTWOPIA yh625tc

SOC_FAMILY = "bcm73625"

MACHINE_FEATURES += " videoenhancement linuxwifi dvb-c dvbc-only AV_JACK"

PREFERRED_VERSION_linux-entwopia = "4.10.6"

require conf/machine/include/entwopia-oem.inc

MACHINE_KERNEL_PR = "r0"

DVBSKYPROVIDER = "kernel"

FORCE = "yes"
```
