## meta-brands/meta-ebox/conf/layer.conf
```bitbake
# We have a conf and classes directory, append to BBPATH
BBPATH .= ":${LAYERDIR}"

# We have a recipes directory, add to BBFILES
BBFILES += "${LAYERDIR}/recipes-*/*.bb ${LAYERDIR}/recipes-*/*.bbappend \
            ${LAYERDIR}/recipes-*/*/*.bb ${LAYERDIR}/recipes-*/*/*.bbappend"

BBFILE_COLLECTIONS += "ebox-layer"
BBFILE_PATTERN_ebox-layer := "^${LAYERDIR}/"
BBFILE_PRIORITY_ebox-layer = "7"

OEA-META-VENDOR-BASE := '${@os.path.normpath("${LAYERDIR}/../")}'
```

## meta-brands/meta-ebox/conf/machine/ebox5000.conf
```bitbake
require conf/machine/include/ebox-oem.inc

SOC_FAMILY = "bcm7403"

MACHINE_FEATURES += "textlcd"
```

## meta-brands/meta-ebox/conf/machine/ebox5100.conf
```bitbake
require conf/machine/include/ebox-oem.inc

CHIPSET = "bcm7403"

MACHINE_FEATURES += "textlcd"
```

## meta-brands/meta-ebox/conf/machine/ebox7358.conf
```bitbake
require conf/machine/include/ebox-oem.inc

SOC_FAMILY = "bcm7358"

MACHINE_FEATURES += " videoenhancement"
```

## meta-brands/meta-ebox/conf/machine/eboxlumi.conf
```bitbake
require conf/machine/include/ebox-oem.inc

SOC_FAMILY = "bcm7403"

GLIBCVERSION = "2.22"
GCCVERSION = "4.9%"
```

## meta-brands/meta-ebox/conf/machine/include/ebox-oem.inc
```bitbake
# We know about rtc
include conf/machine/include/build-extras.inc

BRAND_OEM = "ebox"
MACHINE_OEM = "ebox"
KERNEL_FILE = "kernel_cfe_auto.bin"
ROOTFS_FILE = "root_cfe_auto.bin"

MACHINE_NAME = "\
${@bb.utils.contains('MACHINEBUILD', 'mixosf5', 'F5' , '', d)}\
${@bb.utils.contains('MACHINEBUILD', 'mixosf5mini', 'F5 mini' , '', d)}\
${@bb.utils.contains('MACHINEBUILD', 'mixosf7', 'F7' , '', d)}\
${@bb.utils.contains('MACHINEBUILD', 'mixoslumi', 'Lumi' , '', d)}\
${@bb.utils.contains('MACHINEBUILD', 'gi9196m', '9196m' , '', d)}\
${@bb.utils.contains('MACHINEBUILD', 'gi9196lite', '9196 Lite' , '', d)}\
"

MACHINE_BRAND = "\
${@bb.utils.contains('MACHINEBUILD', 'mixosf5', 'MixOS' , '', d)}\
${@bb.utils.contains('MACHINEBUILD', 'mixosf5mini', 'MixOS' , '', d)}\
${@bb.utils.contains('MACHINEBUILD', 'mixosf7', 'MixOS' , '', d)}\
${@bb.utils.contains('MACHINEBUILD', 'mixoslumi', 'MixOS' , '', d)}\
${@bb.utils.contains('MACHINEBUILD', 'gi9196m', 'Galaxy Innovations' , '', d)}\
${@bb.utils.contains('MACHINEBUILD', 'gi9196lite', 'Galaxy Innovations' , '', d)}\
"

IMAGEDIR ?= "\
${@bb.utils.contains('MACHINEBUILD', 'mixosf5', 'ebox/7403' , '', d)}\
${@bb.utils.contains('MACHINEBUILD', 'mixosf5mini', 'ebox/7403' , '', d)}\
${@bb.utils.contains('MACHINEBUILD', 'mixosf7', 'ebox/7358' , '', d)}\
${@bb.utils.contains('MACHINEBUILD', 'mixoslumi', 'ebox/7403' , '', d)}\
${@bb.utils.contains('MACHINEBUILD', 'gi9196m', 'ebox/7403' , '', d)}\
${@bb.utils.contains('MACHINEBUILD', 'gi9196lite', 'ebox/7403' , '', d)}\
"

MTD_KERNEL = "\
${@bb.utils.contains('MACHINEBUILD', 'mixosf5', 'mtd1' , '', d)}\
${@bb.utils.contains('MACHINEBUILD', 'mixosf5mini', 'mtd1' , '', d)}\
${@bb.utils.contains('MACHINEBUILD', 'mixosf7', 'mtd7' , '', d)}\
${@bb.utils.contains('MACHINEBUILD', 'mixoslumi', 'mtd1' , '', d)}\
${@bb.utils.contains('MACHINEBUILD', 'gi9196m', 'mtd1' , '', d)}\
${@bb.utils.contains('MACHINEBUILD', 'gi9196lite', 'mtd1' , '', d)}\
"

MTD_ROOTFS = "\
${@bb.utils.contains('MACHINEBUILD', 'mixosf5', 'mtd2' , '', d)}\
${@bb.utils.contains('MACHINEBUILD', 'mixosf5mini', 'mtd2' , '', d)}\
${@bb.utils.contains('MACHINEBUILD', 'mixosf7', 'mtd6' , '', d)}\
${@bb.utils.contains('MACHINEBUILD', 'mixoslumi', 'mtd2' , '', d)}\
${@bb.utils.contains('MACHINEBUILD', 'gi9196m', 'mtd2' , '', d)}\
${@bb.utils.contains('MACHINEBUILD', 'gi9196lite', 'mtd2' , '', d)}\
"

MACHINE_ESSENTIAL_EXTRA_RDEPENDS = "\
    ebox-dvb-modules-${MACHINE} \
    ebox-shutdown \
    "
    
MACHINE_EXTRA_RRECOMMENDS = " \
    gstreamer1.0-plugin-dvbmediasink \
    "

include conf/machine/include/autoload-filesystems.inc

TARGET_ARCH = "mipsel"
DEFAULTTUNE = "mips32el"

GLIBC_EXTRA_OECONF = "--with-tls --with-__thread"
DVBMEDIASINK_CONFIG = "--with-wma --with-wmv --with-pcm --with-dts"

PREFERRED_PROVIDER_virtual/kernel = "linux-ebox"
PREFERRED_VERSION_linux-ebox = "3.12.4"
PREFERRED_VERSION_linux-libc-headers = "3.12.4"

GCCVERSION = "5.4%"

KERNEL_IMAGETYPE = "vmlinux"
KERNEL_OUTPUT = "${KERNEL_IMAGETYPE}"
KERNEL_CONSOLE = "null"

IMAGE_FSTYPES ?= "ubi"

UBI_VOLNAME = "rootfs"
MKUBIFS_ARGS = "-m 2048 -e 126976 -c 1024 -F"
UBINIZE_ARGS = "-m 2048 -p 128KiB"

IMAGE_CMD_ubi_prepend = " \
    rm -rf ${IMAGE_ROOTFS}/boot/*; \
    rm -rf ${IMAGE_ROOTFS}/tmp/*; \
    "

IMAGE_CMD_ubi_append = "\
    mkdir -p ${DEPLOY_DIR_IMAGE}/${IMAGEDIR}; \
    mv ${IMGDEPLOYDIR}/${IMAGE_NAME}.rootfs.ubi ${DEPLOY_DIR_IMAGE}/${IMAGEDIR}/root_cfe_auto.bin; \
    gzip -9c ${DEPLOY_DIR_IMAGE}/vmlinux-${MACHINE}.bin > ${DEPLOY_DIR_IMAGE}/${IMAGEDIR}/kernel_cfe_auto.bin; \
    echo ${IMAGE_VER_STRING} > ${DEPLOY_DIR_IMAGE}/${IMAGEDIR}/imageversion; \
    cd ${DEPLOY_DIR_IMAGE}; \
    zip ${IMAGE_NAME}_usb.zip ${IMAGEDIR}/*; \
    rm -f ${DEPLOY_DIR_IMAGE}/*.ubi; \
    rm -f ${DEPLOY_DIR_IMAGE}/*.ubifs; \
    rm -f ${DEPLOY_DIR_IMAGE}/*.manifest; \
    rm -f ${DEPLOY_DIR_IMAGE}/.ubifs; \
    rm -f ${DEPLOY_DIR_IMAGE}/.manifest; \
    rm -Rf ${IMAGEDIR}; \
    "

MACHINE_FEATURES += "alsa dvbapi5 usbhost switchoff wifi 3dtv hdmicec boxmodel singlecore omb feature1 feature2 blindscan-tbs"

require conf/machine/include/tune-mips32.inc
require conf/machine/include/soc-family.inc

OEM_ARCH = "${MACHINEBUILD}"

# Add "MACHINEBUILD" override for recipes
MACHINEOVERRIDES =. "${@['', '${MACHINEBUILD}:']['${MACHINEBUILD}' != '']}"
```

## meta-brands/meta-edision/conf/layer.conf
```bitbake
# We have a conf and classes directory, append to BBPATH
BBPATH .= ":${LAYERDIR}"

# We have a recipes directory, add to BBFILES
BBFILES += "${LAYERDIR}/recipes-*/*.bb ${LAYERDIR}/recipes-*/*.bbappend \
            ${LAYERDIR}/recipes-*/*/*.bb ${LAYERDIR}/recipes-*/*/*.bbappend"

BBFILE_COLLECTIONS += "edision-layer"
BBFILE_PATTERN_edision-layer := "^${LAYERDIR}/"
BBFILE_PRIORITY_edision-layer = "7"

LAYERSERIES_COMPAT_edision-layer = "sumo"

OEA-META-EDISION-BASE := '${@os.path.normpath("${LAYERDIR}/")}'
```

## meta-brands/meta-edision/conf/machine/include/edision-arm.inc
```bitbake
PACKAGECONFIG_GL_pn-qtbase = "gles2 eglfs linuxfb"
PACKAGECONFIG_FB_pn-qtbase = " "

PREFERRED_VERSION_linux-edision = "5.9"

# eMMC has 8 GB in total, but one image gets only 2 GB of that (Partitioned eMMC)
FLASHSIZE = "2048"

DVBMEDIASINK_CONFIG = "--with-wma --with-wmv --with-pcm --with-dts=no --with-dtsdownmix --with-eac3 --with-h265 --with-vb9"

# We know about rtc
include conf/machine/include/build-extras.inc

BRAND_OEM = "edision"
MACHINE_BRAND = "Edision"
IMAGEDIR = "${MACHINE}"

MACHINE_ESSENTIAL_EXTRA_RDEPENDS += "\
    edision-dvb-modules-${MACHINE} \
    resizerootfs \
    "

DVBPROVIDER = "kernel"
DVBSKYPROVIDER = "kernel"

MACHINE_ESSENTIAL_EXTRA_RRECOMMENDS += "\
    kernel-module-cdfs \
    "

MACHINE_EXTRA_RRECOMMENDS += " \
    gstreamer1.0-plugin-dvbmediasink \
    ${@bb.utils.contains('MACHINE_FEATURES', 'swap', 'edision-swapcreate', '',d)} \
    gstreamer1.0-libav \
    "

include conf/machine/include/autoload-filesystems.inc

PREFERRED_PROVIDER_virtual/kernel = "linux-edision"
PREFERRED_PROVIDER_virtual/blindscan-dvbs = "edision-blindscan-utils-${MACHINE}"
PREFERRED_PROVIDER_virtual/blindscan-dvbc = "edision-blindscan-utils-${MACHINE}"

KERNEL_CONSOLE = "ttyS0,115200n8"

IMAGE_CLASSES += "osmio4k-emmcimg"
IMAGE_FSTYPES ?= "emmcimg"
IMAGE_OVERHEAD_FACTOR = "1.0"

IMAGEDIRRECOVERY ?= "${MACHINE}-recovery"

IMAGE_CMD_emmcimg_append = "\
    mkdir -p ${DEPLOY_DIR_IMAGE}/${IMAGEDIRRECOVERY}/${IMAGEDIR}; \
    cp ${DEPLOY_DIR_IMAGE}/splash.bin ${DEPLOY_DIR_IMAGE}/${IMAGEDIRRECOVERY}/${IMAGEDIR}/splash.bin; \
    mv ${DEPLOY_DIR_IMAGE}/${IMAGE_NAME}.rootfs.emmc ${DEPLOY_DIR_IMAGE}/${IMAGEDIRRECOVERY}/${IMAGEDIR}/emmc.img; \
    echo "***** ACHTUNG *****" >${DEPLOY_DIR_IMAGE}/${IMAGEDIRRECOVERY}/${IMAGEDIR}/recovery_${MACHINEBUILD}_lies.mich; \
    echo "Das RECOVERY wird nur benötigt für Neuinstallation der ${MACHINE}" >>${DEPLOY_DIR_IMAGE}/${IMAGEDIRRECOVERY}/${IMAGEDIR}/recovery_${MACHINEBUILD}_lies.mich; \
    echo "Das ${IMAGE_NAME}_recovery_emmc.zip löscht alle Images auch die Multiboot Images" >>${DEPLOY_DIR_IMAGE}/${IMAGEDIRRECOVERY}/${IMAGEDIR}/recovery_${MACHINEBUILD}_lies.mich; \
    echo "***** ATTENTION *****" >${DEPLOY_DIR_IMAGE}/${IMAGEDIRRECOVERY}/${IMAGEDIR}/recovery_${MACHINEBUILD}_READ.ME; \
    echo "The RECOVERY is only required for new installation of the ${MACHINE}" >>${DEPLOY_DIR_IMAGE}/${IMAGEDIRRECOVERY}/${IMAGEDIR}/recovery_${MACHINEBUILD}_READ.ME; \
    echo "The ${IMAGE_NAME}_recovery_emmc.zip deletes all images including the multiboot images" >>${DEPLOY_DIR_IMAGE}/${IMAGEDIRRECOVERY}/${IMAGEDIR}/recovery_${MACHINEBUILD}_READ.ME; \
    echo ${IMAGE_VER_STRING} > ${DEPLOY_DIR_IMAGE}/${IMAGEDIRRECOVERY}/${IMAGEDIR}/imageversion; \
    echo "rename this file to 'force' to force an update without confirmation" > ${DEPLOY_DIR_IMAGE}/${IMAGEDIRRECOVERY}/${IMAGEDIR}/noforce; \
    cd ${DEPLOY_DIR_IMAGE}/${IMAGEDIRRECOVERY} ; \
    zip -r ../${IMAGE_NAME}_recovery_emmc.zip *; \
    rm -Rf ${DEPLOY_DIR_IMAGE}/${IMAGEDIRRECOVERY}; \
    mkdir -p ${DEPLOY_DIR_IMAGE}/${IMAGEDIR}; \
    cd ${IMAGE_ROOTFS}; \
    tar -cvf ${DEPLOY_DIR_IMAGE}/rootfs.tar -C ${IMAGE_ROOTFS} .; \
    mv ${DEPLOY_DIR_IMAGE}/rootfs.tar ${DEPLOY_DIR_IMAGE}/${IMAGEDIR}/rootfs.tar; \
    bzip2 ${DEPLOY_DIR_IMAGE}/${IMAGEDIR}/rootfs.tar; \
    cp ${DEPLOY_DIR_IMAGE}/zImage ${DEPLOY_DIR_IMAGE}/${IMAGEDIR}/${KERNEL_FILE}; \
    echo ${IMAGE_VER_STRING} > ${DEPLOY_DIR_IMAGE}/${IMAGEDIR}/imageversion; \
    echo "FlashOnline Image flash from E2" >> ${DEPLOY_DIR_IMAGE}/${IMAGEDIR}/imageversion; \
    cd ${DEPLOY_DIR_IMAGE}; \
    zip ${IMAGE_NAME}_usb.zip ${IMAGEDIR}/*; \
    rm -f ${DEPLOY_DIR_IMAGE}/*.ext4; \
    rm -f ${DEPLOY_DIR_IMAGE}/*.manifest; \
    rm -f ${DEPLOY_DIR_IMAGE}/.ext4; \
    rm -f ${DEPLOY_DIR_IMAGE}/.manifest; \
    rm -Rf ${IMAGEDIR}; \
    "

MACHINE_FEATURES += "alsa 3dtv switchoff hdmicec bootsplash omb blindscan-tbs linuxwifi linux4extra wifiusbmodule mmc emmc v3d-eglfs"

BOOTLOGO_FILENAME = "splash.bin"

TARGET_ARCH = "arm"
DEFAULTTUNE = "cortexa15hf-neon-vfpv4"
require conf/machine/include/tune-cortexa15.inc
require conf/machine/include/soc-family.inc
require conf/machine/box-hardware.inc

BBMASK = "meta-vuplus/recipes-graphics/"
BBMASK += "meta-fulan/recipes-graphics/"
BBMASK += "meta-vuplus/recipes-webkit/"
```

## meta-brands/meta-edision/conf/machine/include/edision.inc
```bitbake
# We know about rtc
include conf/machine/include/build-extras.inc

BRAND_OEM = "edision"
MACHINE_BRAND = "Edision"

IMAGEDIR = "${MACHINE}"

MTD_KERNEL = "mtd2"
MTD_ROOTFS = "mtd0"
KERNEL_FILE = "kernel.bin"
ROOTFS_FILE = "rootfs.bin"

MACHINE_ESSENTIAL_EXTRA_RDEPENDS += "\
    edision-dvb-modules-${MACHINE} \
    "

DVBPROVIDER = "kernel"
DVBSKYPROVIDER = "kernel"

MACHINE_ESSENTIAL_EXTRA_RRECOMMENDS += "\
    kernel-module-cdfs \
    "

MACHINE_EXTRA_RRECOMMENDS += " \
    gstreamer1.0-plugin-dvbmediasink \
    "

include conf/machine/include/autoload-filesystems.inc

TARGET_ARCH = "mipsel"
DEFAULTTUNE = "mips32el"

PREFERRED_PROVIDER_virtual/kernel = "linux-edision"

PREFERRED_PROVIDER_virtual/blindscan-dvbs = "edision-blindscan-utils-${MACHINE}"
PREFERRED_PROVIDER_virtual/blindscan-dvbc = "edision-blindscan-utils-${MACHINE}"

KERNEL_IMAGETYPE = "vmlinux"
KERNEL_OUTPUT = "${KERNEL_IMAGETYPE}"
KERNEL_CONSOLE = "ttyS0,115200n8"

IMAGE_FSTYPES ?= "ubi"

IMAGE_CMD:ubifs:prepend = " \
	mkdir -p ${IMAGE_ROOTFS}/usr/lib; \
	if [ "${PACKAGE_LIST}" = "1" ]; then \
        cp ${IMAGE_MANIFEST} ${IMAGE_ROOTFS}/usr/lib/package.lst; \
    fi; \
    rm -rf ${IMAGE_ROOTFS}/boot/*; \
    rm -rf ${IMAGE_ROOTFS}/tmp/*; \
    "

IMAGE_CMD:ubi:append = "\
    mkdir -p ${DEPLOY_DIR_IMAGE}/${IMAGEDIR}; \
    cp ${DEPLOY_DIR_IMAGE}/splash.bin ${DEPLOY_DIR_IMAGE}/${IMAGEDIR}/splash.bin; \
    mv ${IMGDEPLOYDIR}/${IMAGE_NAME}.ubi ${DEPLOY_DIR_IMAGE}/${IMAGEDIR}/${ROOTFS_FILE}; \
    gzip -9c ${DEPLOY_DIR_IMAGE}/vmlinux-${MACHINE}.bin > ${DEPLOY_DIR_IMAGE}/${IMAGEDIR}/${KERNEL_FILE}; \
    echo ${IMAGE_VER_STRING} > ${DEPLOY_DIR_IMAGE}/${IMAGEDIR}/imageversion; \
    echo "rename this file to 'force' to force an update without confirmation" > ${DEPLOY_DIR_IMAGE}/${IMAGEDIR}/noforce; \
    cd ${DEPLOY_DIR_IMAGE}; \
    zip ${IMAGE_NAME}_usb.zip ${IMAGEDIR}/*; \
    rm -f ${DEPLOY_DIR_IMAGE}/*.ubi; \
    rm -f ${DEPLOY_DIR_IMAGE}/*.ubifs; \
    rm -f ${DEPLOY_DIR_IMAGE}/*.manifest; \
    rm -f ${DEPLOY_DIR_IMAGE}/.ubifs; \
    rm -f ${DEPLOY_DIR_IMAGE}/.manifest; \
    rm -Rf ${IMAGEDIR}; \
    "

MACHINE_FEATURES += "alsa 3dtv switchoff hdmicec bootsplash omb blindscan-tbs linuxwifi boxmodel feature1 feature2 HDMI"

BOOTLOGO_FILENAME = "splash.bin"

require conf/machine/include/mips/tune-mips32.inc
require conf/machine/include/soc-family.inc
require conf/machine/box-hardware.inc
```

## meta-brands/meta-edision/conf/machine/osmini4k.conf
```bitbake
#@TYPE: Machine
#@NAME: Edision OSMINI4K
#@DESCRIPTION: Machine configuration for the Edision OSMINI4K

MACHINE_NAME = "OS mini 4k"

SOC_FAMILY = "bcm72604"

MTD_BOOTFS = "mmcblk1p1"
MTD_BLACK  = "mmcblk1"

MTD_KERNEL = "mmcblk1p2"
MTD_ROOTFS = "mmcblk1p3"
KERNEL_FILE = "kernel.bin"
ROOTFS_FILE = "rootfs.tar.bz2"

MACHINE_FEATURES += "swap hbbtv-browser-webkit videoenhancement skins1080 7segment blindscan-tbs blindscan-dvbs mountboot HDMI kodi19 wifi-direct"

PREFERRED_PROVIDER_virtual/egl = "edision-libv3d"
PREFERRED_PROVIDER_virtual/libgles2 = "edision-libv3d"
PREFERRED_PROVIDER_virtual/kodi = "stb-kodi-${MACHINE}"

require conf/machine/include/edision-arm.inc

# gstreamer1.0-plugins-good bbappend in meta-qt5.14 layer is not meson compatible and causes build crash
BBMASK += "meta-oe/recipes-qt/ meta-qt5.14/recipes-multimedia/gstreamer/"
```

## meta-brands/meta-edision/conf/machine/osmio4k.conf
```bitbake
#@TYPE: Machine
#@NAME: Edision OSMIO4K
#@DESCRIPTION: Machine configuration for the Edision OSMIO4K

MACHINE_NAME = "OS mio 4k"

SOC_FAMILY = "bcm72604"

MTD_BOOTFS = "mmcblk1p1"
MTD_BLACK  = "mmcblk1"

MTD_KERNEL = "mmcblk1p2"
MTD_ROOTFS = "mmcblk1p3"
KERNEL_FILE = "kernel.bin"
ROOTFS_FILE = "rootfs.tar.bz2"

MACHINE_FEATURES += "hbbtv-browser-webkit videoenhancement skins1080 7segment dvb-c inibt blindscan-tbs blindscan-dvbs blindscan-dvbc mountboot HDMI kodi wifi-direct"

PREFERRED_PROVIDER_virtual/egl = "libv3d-${MACHINE}"
PREFERRED_PROVIDER_virtual/libgles2 = "libv3d-${MACHINE}"
PREFERRED_PROVIDER_virtual/kodi = "stb-kodi-${MACHINE}"

require conf/machine/include/edision-arm.inc
```

## meta-brands/meta-edision/conf/machine/osmio4kplus.conf
```bitbake
#@TYPE: Machine
#@NAME: Edision OSMIO4K Plus
#@DESCRIPTION: Machine configuration for the Edision OSMIO4K Plus

MACHINE_NAME = "OS mio 4k plus"

SOC_FAMILY = "bcm72604"

MTD_BOOTFS = "mmcblk1p1"
MTD_BLACK  = "mmcblk1"

MTD_KERNEL = "mmcblk1p2"
MTD_ROOTFS = "mmcblk1p3"
KERNEL_FILE = "kernel.bin"
ROOTFS_FILE = "rootfs.tar.bz2"

MACHINE_FEATURES += "swap hbbtv-browser-webkit videoenhancement skins1080 bwlcd128 dvb-c inibt blindscan-tbs blindscan-dvbs blindscan-dvbc mountboot HDMI kodi19 wifi-direct"

PREFERRED_PROVIDER_virtual/egl = "edision-libv3d"
PREFERRED_PROVIDER_virtual/libgles2 = "edision-libv3d"
PREFERRED_PROVIDER_virtual/kodi = "stb-kodi-${MACHINE}"

KERNEL_MODULE_AUTOLOAD += "hci_uart"
KERNEL_MODULE_AUTOLOAD += "wlan"

MACHINE_ESSENTIAL_EXTRA_RRECOMMENDS += " \
    kernel-module-btqca \
    kernel-module-hci-uart \
    "

require conf/machine/include/edision-arm.inc
```
