## meta-oe/conf/distro/odinsupport.conf
```bitbake
#@TYPE: Distribution
#@NAME: odin-support
#@DESCRIPTION: Embedded Linux Distribution Configuration for STB's

OE_TERMINAL ?= "auto"
DISTRO_FEATURES_BACKFILL_CONSIDERED += "pulseaudio"

DISTRO_NAME ?= "odin-support"
DISTRO_VERSION = "2.2"
DISTRO_TYPE ?= "release"
BUILD_VERSION = "0"

# default Enigma2 skin.
E2DEFAULTSKIN = "enigma2-plugin-skins-odin-hd-metrixlite"

ENIGMA2_URI ?= "git://github.com/settopbox-support/openPL-gui.git;protocol=git"
ENIGMA2_PLUGINS_URI ?= "git://github.com/oe-alliance/enigma2-plugins.git;protocol=git"
ENIGMA2_SKINS_URI ?= "git://github.com/OpenViX/enigma2-skins.git;protocol=git"

IPKG_VARIANT = "opkg"

FEED_NAME ?= "${DISTRO_NAME}-${DISTRO_VERSION}"
DISTRO_FEED_URI ?= "http://feed.odin-support.com/${DISTRO_VERSION}"
DISTRO_FEED_PREFIX ?= "${DISTRO_NAME}"

IMAGE_VERSION = "${DISTRO_VERSION}"
IMAGE_NAME = "${DISTRO_NAME}-${IMAGE_VERSION}.${MACHINEBUILD}-${DATE}"
IMAGE_ROOTFS = "${TMPDIR}/rootfs/${MACHINEBUILD}"
IMAGE_LINK_NAME = ""
CACHE ?= "${TMPDIR}/cache/"
DEPLOY_DIR ?= "${TMPDIR}/deploy/${MACHINEBUILD}"
DEPLOY_DIR_IMAGE = "${DEPLOY_DIR}/images/${MACHINE}"

# for compatibility with rm_old_work.bbclass
WORKDIR = "${TMPDIR}/work/${MULTIMACH_TARGET_SYS}/${PN}/${PF}"

#USER_CLASSES += "image-prelink"
# SANITY_REQUIRED_UTILITIES = "patch diffstat texi2html makeinfo svn bzip2 tar gzip gawk chrpath wget cpio sshpass"
# INHERIT += "buildhistory recipe_sanity testlab"
# BUILDHISTORY_COMMIT = "1"

require conf/distro/include/unstable-versions.inc

VIRTUAL-RUNTIME_dev_manager = "busybox-mdev"
VIRTUAL-RUNTIME_login_manager = "busybox"
VIRTUAL-RUNTIME_init_manager = "sysvinit"
VIRTUAL-RUNTIME_initscripts = "initscripts"

PREFERRED_PROVIDERS += "virtual/${TARGET_PREFIX}gcc-initial:gcc-cross-initial"
PREFERRED_PROVIDERS += "virtual/${TARGET_PREFIX}gcc-intermediate:gcc-cross-intermediate"
PREFERRED_PROVIDERS += "virtual/${TARGET_PREFIX}gcc:gcc-cross"
PREFERRED_PROVIDERS += "virtual/${TARGET_PREFIX}g++:gcc-cross"

LICENSE_FLAGS_WHITELIST = "commercial_gst-plugins-ugly commercial_lame commercial_libmad commercial_mpeg2dec"
COMMERCIAL_AUDIO_PLUGINS ?= "gst-plugins-ugly-mad gst-plugins-ugly-mpegaudioparse"
COMMERCIAL_VIDEO_PLUGINS ?= "gst-plugins-ugly-mpeg2dec gst-plugins-ugly-mpegstream gst-plugins-bad-mpegvideoparse"

# OE optimization defaults to -O2 which makes for much larger binaries.
# Override here to use -Os instead, resulting in smaller images.
FULL_OPTIMIZATION = "-Os -pipe ${DEBUG_FLAGS}"
# build some core libs with better compiler optimization for better performance
O3_OPT = "-O3 -pipe ${DEBUG_FLAGS}"
FULL_OPTIMIZATION_pn-flac = "${O3_OPT}"
FULL_OPTIMIZATION_pn-jpeg = "${O3_OPT}"
FULL_OPTIMIZATION_pn-lame = "${O3_OPT}"
FULL_OPTIMIZATION_pn-liba52 = "${O3_OPT}"
FULL_OPTIMIZATION_pn-libdca = "${O3_OPT}"
FULL_OPTIMIZATION_pn-libgcrypt = "${O3_OPT}"
FULL_OPTIMIZATION_pn-libmad = "${O3_OPT}"
FULL_OPTIMIZATION_pn-libogg = "${O3_OPT}"
FULL_OPTIMIZATION_pn-libpng = "${O3_OPT}"
FULL_OPTIMIZATION_pn-libsamplerate = "${O3_OPT}"
FULL_OPTIMIZATION_pn-libvorbis = "${O3_OPT}"
FULL_OPTIMIZATION_pn-tremor = "${O3_OPT}"
FULL_OPTIMIZATION_pn-zlib = "${O3_OPT}"

PYTHON_BASEVERSION ?= "2.7"
PREFERRED_VERSION_python ?= "2.7.3"
PREFERRED_VERSION_python-native ?= "2.7.3"

# Force the older version of liberation-fonts until we fix the fontforge issue
PREFERRED_VERSION_liberation-fonts ?= "1.04"

PREFERRED_VERSION_udev ?= "182"

PREFERRED_VERSION_netatalk ?= "2.2.3"

DISTRO_FEATURES ?= "x11 alsa argp bluetooth ext2 irda largefile pcmcia wifi wifi-extra xattr nfs appletalk smbfs zeroconf pci ${DISTRO_FEATURES_LIBC} pam"

QA_LOG = "1"
QA_LOGFILE = "${TMPDIR}/qa.log"

OEINCLUDELOGS ?= "yes"
KERNEL_CONSOLE ?= "ttyS0,115200n8"

BB_GENERATE_MIRROR_TARBALLS ??= "0"

NO32LIBS ??= "1"

# Missing checksums should raise an error
BB_STRICT_CHECKSUM = "0"

TCLIBC = "eglibc"
TCLIBCAPPEND = ""

# Drop unused PACKAGE_EXTRA_ARCHS
PACKAGE_EXTRA_ARCHS = "${TUNE_PKGARCH}"

# add support for extra feeds
PACKAGE_ARCHS += " 3rdparty ${MACHINE}_3rdparty private"

LICENSE_FLAGS_WHITELIST = "commercial_gst-plugins-ugly commercial_lame commercial_libmad commercial_mpeg2dec commercial_ffmpeg commercial_libav commercial_x264"
COMMERCIAL_AUDIO_PLUGINS ?= "gst-plugins-ugly-mad gst-plugins-ugly-mpegaudioparse"
COMMERCIAL_VIDEO_PLUGINS ?= "gst-plugins-ugly-mpeg2dec gst-plugins-ugly-mpegstream gst-plugins-bad-mpegvideoparse"
```

## meta-oe/conf/distro/opendroid.conf
```bitbake
#@TYPE: Distribution
#@NAME: OpenDroid
#@DESCRIPTION: Embedded Linux Distribution Configuration for STB's

DISTRO_FEATURES_BACKFILL_CONSIDERED += "pulseaudio"

OE_TERMINAL ?= "auto"
DISTRO_NAME ?= "opendroid"
DISPLAY_DISTRO  ?= "openDroid"
DISTRO_VERSION ?= "7.5"
DISTRO_TYPE ?= "release"
BUILD_VERSION = "${DATE}"
BUILD_VERSION[vardepsexclude] += "DATE"
BB_HASH_IGNORE_MISMATCH = "1"
DEFAULT_TIMEZONE = "Europe/Rome"
#STATIC_FEED = "1"
#STATIC_ARCH = "static-${MACHINE} static-${TUNE_PKGARCH}"
#SMALLBOXWIZARD = "1"
KBUILD_BUILD_USER = "openDroid"
KBUILD_BUILD_HOST = "droidsat.org"
MAINTAINER = "openDroid"
HOMEPAGE = "https:\\droidsat.org"

# default Enigma2 skin.
E2DEFAULTSKIN = "enigma2-plugin-skins-glamouraurafhd-opd"

ENIGMA2_URI ?= "git://github.com/opendroid-Team/enigma2.git;protocol=https;branch=7.3"

IPKG_VARIANT = "opkg"

FEED_NAME ?= "${DISTRO_NAME}-${DISTRO_VERSION}"
DISTRO_FEED_URI ?= "https://opendroid.org/feeds/7.5/"
#STATIC_DISTRO_FEED_URI ?= "https://opendroid.org/feeds/7.5/"
DISTRO_FEED_PREFIX ?= "opendroid"
IMAGE_VERSION = "${DISTRO_VERSION}"
IMAGE_NAME = "${DISTRO_NAME}-${IMAGE_VERSION}-${MACHINEBUILD}-${DATE}"
IMAGE_NAME[vardepsexclude] += "DATE"
IMAGE_ROOTFS = "${TMPDIR}/rootfs/${MACHINE}"
IMAGE_LINK_NAME = ""
CACHE ?= "${TMPDIR}/cache/${LIBC}/${MACHINE}"
DEPLOY_DIR ?= "${TMPDIR}/deploy/${LIBC}"
DEPLOY_DIR_IMAGE = "${DEPLOY_DIR}/images/${MACHINE}"

require conf/distro/include/unstable-versions.inc
require conf/distro/include/update-section.inc

VIRTUAL-RUNTIME_dev_manager = "busybox-mdev"
VIRTUAL-RUNTIME_login_manager = "busybox"
VIRTUAL-RUNTIME_init_manager = "sysvinit"
VIRTUAL-RUNTIME_initscripts = "initscripts"

# OE optimization defaults to -O2 which makes for much larger binaries.
# Override here to use -Os instead, resulting in smaller images.
FULL_OPTIMIZATION = "-Os ${DEBUG_LEVELFLAG}"
# build some core libs with better compiler optimization for better performance
O3_OPT = "-O3 ${DEBUG_LEVELFLAG}"
FULL_OPTIMIZATION:pn-flac = "${O3_OPT}"
FULL_OPTIMIZATION:pn-jpeg = "${O3_OPT}"
FULL_OPTIMIZATION:pn-lame = "${O3_OPT}"
FULL_OPTIMIZATION:pn-liba52 = "${O3_OPT}"
FULL_OPTIMIZATION:pn-libdca = "${O3_OPT}"
FULL_OPTIMIZATION:pn-libgcrypt = "${O3_OPT}"
FULL_OPTIMIZATION:pn-libmad = "${O3_OPT}"
FULL_OPTIMIZATION:pn-libogg = "${O3_OPT}"
FULL_OPTIMIZATION:pn-libpng = "${O3_OPT}"
FULL_OPTIMIZATION:pn-libsamplerate = "${O3_OPT}"
FULL_OPTIMIZATION:pn-libvorbis = "${O3_OPT}"
FULL_OPTIMIZATION:pn-tremor = "${O3_OPT}"
FULL_OPTIMIZATION:pn-zlib = "${O3_OPT}"


PREFERRED_VERSION_netatalk ?= "2.2.3"

DISTRO_FEATURES = "${DISTRO_FEATURES_EXTRA} acl bluez5 directfb gtk-directfb pulseaudio alsa argp bluetooth ext2 ipv4 ipv6 irda ldconfig mplt pcmcia wifi wifi-extra xattr nfs smbfs zeroconf pci pam \
                    ${@bb.utils.contains('TARGET_ARCH', 'aarch64', '' , 'ld-is-gold', d)} gobject-introspection-data"

QA_LOG = "1"
QA_LOGFILE = "${TMPDIR}/qa.log"

OEINCLUDELOGS ?= "yes"
KERNEL_CONSOLE ?= "ttyS0,115200n8"

BB_GENERATE_MIRROR_TARBALLS ??= "0"

NO32LIBS ??= "1"

# Missing checksums should raise an error
BB_STRICT_CHECKSUM = "0"

# Drop unused PACKAGE_EXTRA_ARCHS
PACKAGE_EXTRA_ARCHS = "${TUNE_PKGARCH} ${OEM_ARCH} ${STATIC_ARCH}"

# add support for extra feeds
PACKAGE_ARCHS += " 3rdparty ${MACHINE}_3rdparty private"

LICENSE_FLAGS_ACCEPTED = "commercial"
COMMERCIAL_AUDIO_PLUGINS ?= "gstreamer1.0-plugins-ugly-mad"
COMMERCIAL_VIDEO_PLUGINS ?= "gstreamer1.0-plugins-ugly-mpeg2dec"

INHERIT += "rm-pycache"

BBMASK += "meta-oe/recipes-distros/openvix/softcams"
```

## meta-oe/conf/distro/openeight.conf
```bitbake
#@TYPE: Distribution
#@NAME: OpenEight
#@DESCRIPTION: Embedded Linux Distribution Configuration for STB's

DISTRO_FEATURES_BACKFILL_CONSIDERED += "pulseaudio gobject-introspection-data"

OE_TERMINAL ?= "auto"
DISTRO_NAME ?= "openeight"
DISTRO_VERSION = "6.8"
DISTRO_TYPE ?= "release"
BUILD_VERSION = "1"
BB_HASH_IGNORE_MISMATCH = "1"
DEFAULT_TIMEZONE = "Europe/Berlin"

# default Enigma2 skin.
E2DEFAULTSKIN = "enigma2-plugin-skins-smartlitesd"

ENIGMA2_URI ?= "git://github.com/Openeight/enigma2.git;protocol=https"
ENIGMA2_SKINS_URI ?= "git://github.com/OpenViX/enigma2-skins.git;protocol=https"


IPKG_VARIANT = "opkg"

FEED_NAME ?= "${DISTRO_NAME}-${DISTRO_VERSION}"
DISTRO_FEED_URI ?= "http://feed.openeight.de/${DISTRO_VERSION}/${MACHINE}"
DISTRO_FEED_PREFIX ?= "openeight"
IMAGE_VERSION = "${DISTRO_VERSION}"
IMAGE_NAME = "${DISTRO_NAME}-${IMAGE_VERSION}-${MACHINEBUILD}-${DATE}"
IMAGE_NAME[vardepsexclude] += "DATE"
IMAGE_ROOTFS = "${TMPDIR}/rootfs/${MACHINE}"
IMAGE_LINK_NAME = ""
CACHE ?= "${TMPDIR}/cache/${LIBC}/${MACHINE}"
DEPLOY_DIR ?= "${TMPDIR}/deploy/${LIBC}"
DEPLOY_DIR_IMAGE = "${DEPLOY_DIR}/images/${MACHINE}"

require conf/distro/include/unstable-versions.inc

VIRTUAL-RUNTIME_dev_manager = "busybox-mdev"
VIRTUAL-RUNTIME_login_manager = "busybox"
VIRTUAL-RUNTIME_init_manager = "sysvinit"
VIRTUAL-RUNTIME_initscripts = "initscripts"

PREFERRED_PROVIDERS += "virtual/${TARGET_PREFIX}gcc-initial:gcc-cross-initial"
PREFERRED_PROVIDERS += "virtual/${TARGET_PREFIX}gcc-intermediate:gcc-cross-intermediate"
PREFERRED_PROVIDERS += "virtual/${TARGET_PREFIX}gcc:gcc-cross"
PREFERRED_PROVIDERS += "virtual/${TARGET_PREFIX}g++:gcc-cross"

# OE optimization defaults to -O2 which makes for much larger binaries.
# Override here to use -Os instead, resulting in smaller images.
FULL_OPTIMIZATION = "-Os -pipe ${DEBUG_FLAGS}"
# build some core libs with better compiler optimization for better performance
O3_OPT = "-O3 -pipe ${DEBUG_FLAGS}"
FULL_OPTIMIZATION_pn-flac = "${O3_OPT}"
FULL_OPTIMIZATION_pn-jpeg = "${O3_OPT}"
FULL_OPTIMIZATION_pn-lame = "${O3_OPT}"
FULL_OPTIMIZATION_pn-liba52 = "${O3_OPT}"
FULL_OPTIMIZATION_pn-libdca = "${O3_OPT}"
FULL_OPTIMIZATION_pn-libgcrypt = "${O3_OPT}"
FULL_OPTIMIZATION_pn-libmad = "${O3_OPT}"
FULL_OPTIMIZATION_pn-libogg = "${O3_OPT}"
FULL_OPTIMIZATION_pn-libpng = "${O3_OPT}"
FULL_OPTIMIZATION_pn-libsamplerate = "${O3_OPT}"
FULL_OPTIMIZATION_pn-libvorbis = "${O3_OPT}"
FULL_OPTIMIZATION_pn-tremor = "${O3_OPT}"
FULL_OPTIMIZATION_pn-zlib = "${O3_OPT}"

PYTHON_BASEVERSION ?= "2.7"
PREFERRED_VERSION_python ?= "2.7.18"
PREFERRED_VERSION_python-native ?= "2.7.18"

PREFERRED_VERSION_netatalk ?= "2.2.3"

DISTRO_FEATURES = "${DISTRO_FEATURES_EXTRA} bluez5 directfb gtk-directfb pulseaudio pli alsa argp bluetooth ext2 ipv4 ipv6 irda largefile pcmcia wifi wifi-extra xattr nfs smbfs zeroconf pci pam"

QA_LOG = "1"
QA_LOGFILE = "${TMPDIR}/qa.log"

OEINCLUDELOGS ?= "yes"
KERNEL_CONSOLE ?= "ttyS0,115200n8"

BB_GENERATE_MIRROR_TARBALLS ??= "0"

NO32LIBS ??= "1"

# Missing checksums should raise an error
BB_STRICT_CHECKSUM = "0"

TCLIBCAPPEND = ""

# Drop unused PACKAGE_EXTRA_ARCHS
PACKAGE_EXTRA_ARCHS = "${TUNE_PKGARCH} ${OEM_ARCH}"

# add support for 3rd party feeds
PACKAGE_ARCHS += " 3rdparty ${MACHINE}_3rdparty"

LICENSE_FLAGS_WHITELIST = "commercial"
COMMERCIAL_AUDIO_PLUGINS ?= "gstreamer1.0-plugins-ugly-mad"
COMMERCIAL_VIDEO_PLUGINS ?= "gstreamer1.0-plugins-ugly-mpeg2dec"
```

## meta-oe/conf/distro/openhdf.conf
```bitbake
#@TYPE: Distribution
#@NAME: OpenHDF
#@DESCRIPTION: Embedded Linux Distribution Configuration for STB's
require conf/distro/include/openhdf.inc

OE_TERMINAL ?= "auto"
DISTRO_NAME ?= "openhdf"
DISPLAY_DISTRO  ?= "openHDF"
DISTRO_VERSION = "7.2"
DISTRO_TYPE ?= "release"
BUILD_VERSION ?= "0"
BUILD_VERSION[vardepsexclude] += "DATE"
BB_HASH_IGNORE_MISMATCH = "1"
DEFAULT_TIMEZONE = "Europe/Berlin"
#STATIC_FEED = "1"
#SMALLBOXWIZARD = "1"

# default Enigma2 skin.
E2DEFAULTSKIN = "enigma2-plugin-skins-xionhdf"

ENIGMA2_URI ?= "${@bb.utils.contains("DISTRO_TYPE", "release", "git://github.com/openhdf/enigma2.git;protocol=https;branch=7.2" , "git://github.com/openhdf/enigma2.git;protocol=https;branch=7.2", d)}"

IPKG_VARIANT = "opkg"

FEED_NAME ?= "${DISTRO_NAME}-${DISTRO_VERSION}"
DISTRO_FEED_URI ?= "https://feed.hdfreaks.cc/V${DISTRO_VERSION}/${MACHINE}"
STATIC_DISTRO_FEED_URI ?= "https://feed.hdfreaks.cc/V${DISTRO_VERSION}/${MACHINE}"
DISTRO_FEED_PREFIX ?= "openhdf"

IMAGE_VERSION = "${DISTRO_VERSION}"
IMAGE_NAME = "${DISTRO_NAME}-${IMAGE_VERSION}-${MACHINEBUILD}-${BUILD_VERSION}-${DATE}"
IMAGE_NAME[vardepsexclude] += "DATE"
IMAGE_VER_STRING = "${DISTRO_NAME}-${IMAGE_VERSION}-${MACHINEBUILD}-${BUILD_VERSION}-${DATE}"
IMAGE_ROOTFS = "${TMPDIR}/rootfs/${MACHINE}"
IMAGE_LINK_NAME = ""
CACHE ?= "${TMPDIR}/cache/${LIBC}/${MACHINE}"
DEPLOY_DIR ?= "${TMPDIR}/deploy/${LIBC}"
DEPLOY_DIR_IMAGE = "${DEPLOY_DIR}/images/${MACHINE}"

#USER_CLASSES += "image-prelink"
# SANITY_REQUIRED_UTILITIES = "patch diffstat texi2html makeinfo svn bzip2 tar gzip gawk chrpath wget cpio sshpass"
# INHERIT += "buildhistory recipe_sanity testlab"
# BUILDHISTORY_COMMIT = "1"

require conf/distro/include/unstable-versions.inc

VIRTUAL-RUNTIME_dev_manager = "busybox-mdev"
VIRTUAL-RUNTIME_login_manager = "busybox"
VIRTUAL-RUNTIME_init_manager = "sysvinit"
VIRTUAL-RUNTIME_initscripts = "initscripts"

# OE optimization defaults to -O2 which makes for much larger binaries.
# Override here to use -Os instead, resulting in smaller images.
FULL_OPTIMIZATION = "-Os -pipe ${DEBUG_FLAGS}"
# build some core libs with better compiler optimization for better performance
O3_OPT = "-O3 -pipe ${DEBUG_FLAGS}"
FULL_OPTIMIZATION:pn-flac = "${O3_OPT}"
FULL_OPTIMIZATION:pn-jpeg = "${O3_OPT}"
FULL_OPTIMIZATION:pn-lame = "${O3_OPT}"
FULL_OPTIMIZATION:pn-liba52 = "${O3_OPT}"
FULL_OPTIMIZATION:pn-libdca = "${O3_OPT}"
FULL_OPTIMIZATION:pn-libgcrypt = "${O3_OPT}"
FULL_OPTIMIZATION:pn-libmad = "${O3_OPT}"
FULL_OPTIMIZATION:pn-libogg = "${O3_OPT}"
FULL_OPTIMIZATION:pn-libpng = "${O3_OPT}"
FULL_OPTIMIZATION:pn-libsamplerate = "${O3_OPT}"
FULL_OPTIMIZATION:pn-libvorbis = "${O3_OPT}"
FULL_OPTIMIZATION:pn-tremor = "${O3_OPT}"
FULL_OPTIMIZATION:pn-zlib = "${O3_OPT}"

# Use upx to compress some binaries for boxes with up to this flash-size (Must be a power of 2 larger or equal 64):
COMPRESS_UPTO = "256"

PREFERRED_VERSION_netatalk ?= "2.2.3"

DISTRO_FEATURES = "${DISTRO_FEATURES_EXTRA} acl bluez5 directfb gtk-directfb pulseaudio alsa argp bluetooth ext2 ipv4 ipv6 irda largefile ldconfig mplt pcmcia wifi wifi-extra xattr nfs smbfs zeroconf pci pam no-autobouquetsmaker tuxtxtfhd"

QA_LOG = "1"
QA_LOGFILE = "${TMPDIR}/qa.log"

OEINCLUDELOGS ?= "yes"
KERNEL_CONSOLE ?= "ttyS0,115200n8"

BB_GENERATE_MIRROR_TARBALLS ??= "0"

NO32LIBS ??= "1"

# Missing checksums should raise an error
BB_STRICT_CHECKSUM = "0"

TCLIBCAPPEND = ""

# Drop unused PACKAGE_EXTRA_ARCHS
PACKAGE_EXTRA_ARCHS = "${TUNE_PKGARCH} ${OEM_ARCH} ${STATIC_ARCH}"

# add support for extra feeds
PACKAGE_ARCHS += " 3rdparty ${MACHINE}_3rdparty private"

LICENSE_FLAGS_ACCEPTED = "commercial"
COMMERCIAL_AUDIO_PLUGINS ?= "gstreamer1.0-plugins-ugly-mad"
COMMERCIAL_VIDEO_PLUGINS ?= "gstreamer1.0-plugins-ugly-mpeg2dec"

INHERIT += "rm-pycache"
```
