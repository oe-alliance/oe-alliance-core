## meta-oe/conf/distro/opennfr.conf
```bitbake
#@TYPE: Distribution
#@NAME: OpenNFR
#@DESCRIPTION: Embedded Linux Distribution Configuration for STB's

DISTRO_FEATURES_BACKFILL_CONSIDERED += "pulseaudio gobject-introspection-data"

OE_TERMINAL ?= "auto"
DISTRO_NAME ?= "opennfr"
DISTRO_VERSION = "6.3"
DISTRO_TYPE ?= "Release"
BUILD_VERSION = "1"
BB_HASH_IGNORE_MISMATCH = "1"

# default Enigma2 skin.
E2DEFAULTSKIN = "enigma2-plugin-opennfrskins-smokedefault-hd"

ENIGMA2_URI ?= "git://github.com/carlo0815/openNFR-gui2.git;protocol=git;branch=nextp3"

ENIGMA2_PLUGINS_URI ?= "git://github.com/oe-alliance/enigma2-plugins.git;protocol=git;branch=master"

ENIGMA2_SKINS_URI ?= "git://github.com/OpenViX/enigma2-skins.git;protocol=git"

IPKG_VARIANT = "opkg"

FEED_NAME ?= "${DISTRO_NAME}-${DISTRO_VERSION}"
DISTRO_FEED_URI ?= "http://dev.nachtfalke.biz/nfr/feeds/${DISTRO_VERSION}"
DISTRO_FEED_PREFIX ?= "opennfr"

IMAGE_VERSION = "${DISTRO_VERSION}"
IMAGE_NAME = "${DISTRO_NAME}-${IMAGE_VERSION}-${MACHINEBUILD}-${DATE}"
IMAGE_NAME[vardepsexclude] += "DATE"
IMAGE_ROOTFS = "${TMPDIR}/rootfs/${MACHINE}"
IMAGE_LINK_NAME = ""
CACHE ?= "${TMPDIR}/cache/${LIBC}/${MACHINE}"
DEPLOY_DIR ?= "${TMPDIR}/deploy/${LIBC}"
DEPLOY_DIR_IMAGE = "${DEPLOY_DIR}/images/${MACHINE}"

#USER_CLASSES += "image-prelink"
# SANITY_REQUIRED_UTILITIES = "patch diffstat texi2html makeinfo svn bzip2 tar gzip gawk chrpath wget cpio sshpass"
# INHERIT += "buildhistory recipe_sanity testlab"
# BUILDHISTORY_COMMIT = "1"

require conf/distro/include/unstable-versions.inc

VIRTUAL-RUNTIME_dev_manager = "busybox-mdev"
VIRTUAL-RUNTIME_login_manager = "busybox"
VIRTUAL-RUNTIME_init_manager = "sysvinit"
VIRTUAL-RUNTIME_initscripts = "initscripts"

PREFERRED_PROVIDERS += "virtual/${TARGET_PREFIX}gcc-initial:gcc-cross-initial"
PREFERRED_PROVIDERS += "virtual/${TARGET_PREFIX}gcc-intermediate:gcc-cross-intermediate"
PREFERRED_PROVIDERS += "virtual/${TARGET_PREFIX}gcc:gcc-cross"
PREFERRED_PROVIDERS += "virtual/${TARGET_PREFIX}g++:gcc-cross"

# OE optimization defaults to -O2 which makes for much larger binaries.
# Override here to use -Os instead, resulting in smaller images.
FULL_OPTIMIZATION = "-Os -pipe ${DEBUG_FLAGS}"
# build some core libs with better compiler optimization for better performance
O3_OPT = "-O3 -pipe ${DEBUG_FLAGS}"
FULL_OPTIMIZATION_pn-flac = "${O3_OPT}"
FULL_OPTIMIZATION_pn-jpeg = "${O3_OPT}"
FULL_OPTIMIZATION_pn-lame = "${O3_OPT}"
FULL_OPTIMIZATION_pn-liba52 = "${O3_OPT}"
FULL_OPTIMIZATION_pn-libdca = "${O3_OPT}"
FULL_OPTIMIZATION_pn-libgcrypt = "${O3_OPT}"
FULL_OPTIMIZATION_pn-libmad = "${O3_OPT}"
FULL_OPTIMIZATION_pn-libogg = "${O3_OPT}"
FULL_OPTIMIZATION_pn-libpng = "${O3_OPT}"
FULL_OPTIMIZATION_pn-libsamplerate = "${O3_OPT}"
FULL_OPTIMIZATION_pn-libvorbis = "${O3_OPT}"
FULL_OPTIMIZATION_pn-tremor = "${O3_OPT}"
FULL_OPTIMIZATION_pn-zlib = "${O3_OPT}"

PYTHON_BASEVERSION ?= "2.7"
PREFERRED_VERSION_python ?= "2.7.15"
PREFERRED_VERSION_python-native ?= "2.7.15"

# Force the older version of liberation-fonts until we fix the fontforge issue
PREFERRED_VERSION_liberation-fonts ?= "1.04"

PREFERRED_VERSION_netatalk ?= "2.2.3"

DISTRO_FEATURES ?= "bluez5 directfb gtk-directfb pulseaudio mplt alsa argp bluetooth ext2 irda largefile pcmcia wifi wifi-extra xattr nfs smbfs zeroconf pci ${DISTRO_FEATURES_LIBC} pam tuxtxtfhd"

QA_LOG = "1"
QA_LOGFILE = "${TMPDIR}/qa.log"

OEINCLUDELOGS ?= "yes"
KERNEL_CONSOLE ?= "ttyS0,115200n8"

BB_GENERATE_MIRROR_TARBALLS ??= "0"

NO32LIBS ??= "1"

# Missing checksums should raise an error
BB_STRICT_CHECKSUM = "0"

TCLIBCAPPEND = ""

# Drop unused PACKAGE_EXTRA_ARCHS
PACKAGE_EXTRA_ARCHS = "${TUNE_PKGARCH} ${OEM_ARCH}"

# add support for extra feeds
PACKAGE_ARCHS += " 3rdparty ${MACHINE}_3rdparty private"

LICENSE_FLAGS_WHITELIST = "commercial_gst-plugins-ugly commercial_lame commercial_libmad commercial_mpeg2dec commercial_ffmpeg commercial_libav commercial_x264 commercial_gstreamer1.0-libav commercial_gstreamer1.0-plugins-ugly commercial_mpg123 commercial_faad2 commercial_faac commercial_lib32-faac commercial_lib32-faad2"
COMMERCIAL_AUDIO_PLUGINS ?= "gst-plugins-ugly-mad gst-plugins-ugly-mpegaudioparse gstreamer1.0-plugins-ugly-mad"
COMMERCIAL_VIDEO_PLUGINS ?= "gst-plugins-ugly-mpeg2dec gst-plugins-ugly-mpegstream gst-plugins-bad-mpegvideoparse gstreamer1.0-plugins-ugly-mpeg2dec"
```

## meta-oe/conf/distro/openvision.conf
```bitbake
#@TYPE: Distribution
#@NAME: Open Vision
#@DESCRIPTION: Embedded Linux Distribution Configuration for STB's

DISTRO_FEATURES_BACKFILL_CONSIDERED += "pulseaudio gobject-introspection-data"

OE_TERMINAL ?= "auto"
DISTRO_NAME = "openvision"
DISPLAY_DISTRO  = "Open Vision"
DISTRO_VERSION = "12.1"
DISTRO_TYPE ?= "release"
BUILD_VERSION = "${DATE}"
BUILD_VERSION[vardepsexclude] += "DATE"
BB_HASH_IGNORE_MISMATCH = "1"
DEFAULT_TIMEZONE = "Europe/London"

# default Enigma2 skin.
#E2DEFAULTSKIN = "enigma2-plugin-skins-smartlitesd"

ENIGMA2_URI = "${@bb.utils.contains("TARGET_ARCH", "sh4", "git://github.com/OpenVisionE2/enigma2-openvision-sh4.git;protocol=https;branch=develop", "git://github.com/OpenVisionE2/enigma2-openvision.git;protocol=https;branch=develop", d)}"

IPKG_VARIANT = "opkg"

FEED_NAME ?= "${DISTRO_NAME}-${DISTRO_VERSION}"
DISTRO_FEED_URI = "https://feeds.openvision.tech/${DISTRO_VERSION}/Vision/${MACHINE}"
DISTRO_FEED_PREFIX ?= "openvision"

IMAGE_VERSION = "unofficial"

IMAGE_NAME = "${DISTRO_NAME}-${IMAGE_VERSION}-${MACHINEBUILD}-${DATE}"
IMAGE_NAME[vardepsexclude] += "DATE"
IMAGE_ROOTFS = "${TMPDIR}/rootfs/${MACHINE}"
IMAGE_LINK_NAME = ""
CACHE ?= "${TMPDIR}/cache/${LIBC}/${MACHINE}"
DEPLOY_DIR ?= "${TMPDIR}/deploy/${LIBC}"
DEPLOY_DIR_IMAGE = "${DEPLOY_DIR}/images/${MACHINE}"

#USER_CLASSES += "image-prelink"
# SANITY_REQUIRED_UTILITIES = "patch diffstat texi2html makeinfo svn bzip2 tar gzip gawk chrpath wget cpio sshpass"
# INHERIT += "buildhistory recipe_sanity testlab"
# BUILDHISTORY_COMMIT = "1"

require conf/distro/include/unstable-versions.inc

VIRTUAL-RUNTIME_dev_manager = "busybox-mdev"
VIRTUAL-RUNTIME_login_manager = "busybox"
VIRTUAL-RUNTIME_init_manager = "sysvinit"
VIRTUAL-RUNTIME_initscripts = "initscripts"

# OE optimization defaults to -O2 which makes for much larger binaries.
# Override here to use -Os instead, resulting in smaller images.
FULL_OPTIMIZATION = "-Os -pipe ${DEBUG_FLAGS}"
# build some core libs with better compiler optimization for better performance
O3_OPT = "-O3 -pipe ${DEBUG_FLAGS}"
FULL_OPTIMIZATION:pn-flac = "${O3_OPT}"
FULL_OPTIMIZATION:pn-jpeg = "${O3_OPT}"
FULL_OPTIMIZATION:pn-lame = "${O3_OPT}"
FULL_OPTIMIZATION:pn-liba52 = "${O3_OPT}"
FULL_OPTIMIZATION:pn-libdca = "${O3_OPT}"
FULL_OPTIMIZATION:pn-libgcrypt = "${O3_OPT}"
FULL_OPTIMIZATION:pn-libmad = "${O3_OPT}"
FULL_OPTIMIZATION:pn-libogg = "${O3_OPT}"
FULL_OPTIMIZATION:pn-libpng = "${O3_OPT}"
FULL_OPTIMIZATION:pn-libsamplerate = "${O3_OPT}"
FULL_OPTIMIZATION:pn-libvorbis = "${O3_OPT}"
FULL_OPTIMIZATION:pn-tremor = "${O3_OPT}"
FULL_OPTIMIZATION:pn-zlib = "${O3_OPT}"

# Use upx to compress some binaries for boxes with up to this flash-size (Must be a power of 2 larger or equal 64):
COMPRESS_UPTO = "128"

PREFERRED_VERSION_netatalk ?= "2.2.3"

DISTRO_FEATURES = "${DISTRO_FEATURES_EXTRA} bluez5 directfb gtk-directfb pulseaudio alsa argp bluetooth ext2 ipv4 ipv6 irda largefile ldconfig mplt pcmcia wifi wifi-extra xattr nfs smbfs zeroconf pci pam tuxtxtfhd \
                ${@bb.utils.contains("DEFAULTTUNE", "sh4", " ", "ld-is-gold", d)}"

QA_LOG = "1"
QA_LOGFILE = "${TMPDIR}/qa.log"

OEINCLUDELOGS ?= "yes"
KERNEL_CONSOLE ?= "ttyS0,115200n8"

BB_GENERATE_MIRROR_TARBALLS ??= "0"

NO32LIBS ??= "1"

# Missing checksums should raise an error
BB_STRICT_CHECKSUM = "0"

TCLIBCAPPEND = ""

# Drop unused PACKAGE_EXTRA_ARCHS
PACKAGE_EXTRA_ARCHS = "${TUNE_PKGARCH} ${OEM_ARCH}"

# add support for extra feeds
PACKAGE_ARCHS += " 3rdparty ${MACHINE}_3rdparty private"

LICENSE_FLAGS_ACCEPTED = "commercial"
COMMERCIAL_AUDIO_PLUGINS ?= "gstreamer1.0-plugins-ugly-mad"
COMMERCIAL_VIDEO_PLUGINS ?= "gstreamer1.0-plugins-ugly-mpeg2dec"

INHERIT += "rm-pycache"
```

## meta-oe/conf/distro/openvix.conf
```bitbake
#@TYPE: Distribution
#@NAME: OpenVix
#@DESCRIPTION: Embedded Linux Distribution Configuration for STB's

DISTRO_FEATURES_BACKFILL_CONSIDERED += "pulseaudio"

DISTRO_NAME ?= "openvix"
DISPLAY_DISTRO  ?= "OpenViX"
DISTRO_VERSION = "6.6"
BUILD_VERSION = "009"
DEVELOPER_BUILD_VERSION = "005"
BB_HASH_IGNORE_MISMATCH = "1"
DEFAULT_TIMEZONE = "Europe/London"
STATIC_FEED = "1"
STATIC_ARCH = "static-${MACHINE} static-${TUNE_PKGARCH}"
SMALLBOXWIZARD = "1"
MAINTAINER = "OpenViX"
HOMEPAGE = "https://www.world-of-satellite.com"

# default Enigma2 skin.
E2DEFAULTSKIN = "${@bb.utils.contains("MACHINE_FEATURES", "skins1080", "enigma2-plugin-skins-openvix-simple-ten-eighty" , "enigma2-plugin-skins-openvix-vix-night-hd", d)}"

ENIGMA2_URI ?= "${@bb.utils.contains("DISTRO_TYPE", "release", "git://github.com/OpenViX/enigma2.git;protocol=https;branch=Release" , "git://github.com/OpenViX/enigma2.git;protocol=https;branch=Developer", d)}"
ENIGMA2_SKINS_URI ?= "git://github.com/OpenViX/enigma2-skins.git;protocol=https;branch=master"

IPKG_VARIANT = "opkg"

FEED_NAME ?= "${DISTRO_NAME}-${DISTRO_VERSION}"
DISTRO_FEED_URI ?= "${@bb.utils.contains("DISTRO_TYPE", "release", "http://www.openvix.co.uk/feeds/${DISTRO_NAME}/${DISTRO_TYPE}/${DISTRO_VERSION}/${MACHINE}" , "http://openvixdev.satellites-xml.org/feeds/${DISTRO_NAME}/${DISTRO_TYPE}/${DISTRO_VERSION}/${MACHINE}", d)}"
STATIC_DISTRO_FEED_URI ?= "http://www.openvix.co.uk/feeds/${DISTRO_NAME}-static/${DISTRO_VERSION}"

DISTRO_FEED_PREFIX ?= "${DISTRO_NAME}"

IMAGE_VERSION = "${DISTRO_VERSION}"
IMAGE_BUILD = "${@bb.utils.contains("DISTRO_TYPE", "release", "${BUILD_VERSION}" , "${BUILD_VERSION}.${DEVELOPER_BUILD_VERSION}", d)}"
IMAGE_NAME = "${@bb.utils.contains("DISTRO_TYPE", "release", "${DISTRO_NAME}-${IMAGE_VERSION}.${BUILD_VERSION}.${DISTRO_TYPE}-${MACHINEBUILD}", "${DISTRO_NAME}-${IMAGE_VERSION}.${BUILD_VERSION}.${DEVELOPER_BUILD_VERSION}.${DISTRO_TYPE}-${MACHINEBUILD}", d)}"
IMAGE_VER_STRING = "${DISTRO_NAME}-${IMAGE_VERSION}.${BUILD_VERSION}.${DISTRO_TYPE}-${MACHINEBUILD}"
IMAGE_ROOTFS = "${TMPDIR}/rootfs"
IMAGE_LINK_NAME = ""
DEPLOY_DIR ?= "${TMPDIR}/deploy"

# for compatibility with rm_old_work.bbclass
WORKDIR = "${TMPDIR}/work/${MULTIMACH_TARGET_SYS}/${PN}/${PF}"

#USER_CLASSES += "image-prelink"
# SANITY_REQUIRED_UTILITIES = "patch diffstat texi2html makeinfo svn bzip2 tar gzip gawk chrpath wget cpio sshpass"
# INHERIT += "buildhistory recipe_sanity testlab"
# BUILDHISTORY_COMMIT = "1"

require conf/distro/include/unstable-versions.inc

VIRTUAL-RUNTIME_dev_manager = "busybox-mdev"
VIRTUAL-RUNTIME_login_manager = "busybox"
VIRTUAL-RUNTIME_init_manager = "sysvinit"
VIRTUAL-RUNTIME_initscripts = "initscripts"

# OE optimization defaults to -O2 which makes for much larger binaries.
# Override here to use -Os instead, resulting in smaller images.
FULL_OPTIMIZATION = "-Os -pipe ${DEBUG_FLAGS}"
# build some core libs with better compiler optimization for better performance
O3_OPT = "-O3 -pipe ${DEBUG_FLAGS}"
FULL_OPTIMIZATION:pn-flac = "${O3_OPT}"
FULL_OPTIMIZATION:pn-jpeg = "${O3_OPT}"
FULL_OPTIMIZATION:pn-lame = "${O3_OPT}"
FULL_OPTIMIZATION:pn-liba52 = "${O3_OPT}"
FULL_OPTIMIZATION:pn-libdca = "${O3_OPT}"
FULL_OPTIMIZATION:pn-libgcrypt = "${O3_OPT}"
FULL_OPTIMIZATION:pn-libmad = "${O3_OPT}"
FULL_OPTIMIZATION:pn-libogg = "${O3_OPT}"
FULL_OPTIMIZATION:pn-libpng = "${O3_OPT}"
FULL_OPTIMIZATION:pn-libsamplerate = "${O3_OPT}"
FULL_OPTIMIZATION:pn-libvorbis = "${O3_OPT}"
FULL_OPTIMIZATION:pn-tremor = "${O3_OPT}"
FULL_OPTIMIZATION:pn-zlib = "${O3_OPT}"

PREFERRED_PROVIDER_virtual/cron = "busybox"
PREFERRED_RPROVIDER_virtual/cron = "busybox"

PREFERRED_VERSION_netatalk ?= "2.2.3"

DISTRO_FEATURES = "${DISTRO_FEATURES_EXTRA} acl alsa argp bluetooth bluez5 directfb ext2 gtk-directfb ipv4 ipv6 irda largefile ldconfig libsigc2 mplt nfs pam pci pcmcia pulseaudio smbfs wifi wifi-extra xattr zeroconf \
                    ${@bb.utils.contains('TARGET_ARCH', 'aarch64', '' , 'ld-is-gold', d)} gobject-introspection-data"

QA_LOG = "1"
QA_LOGFILE = "${TMPDIR}/qa.log"

OEINCLUDELOGS ?= "yes"
KERNEL_CONSOLE ?= "ttyS0,115200n8"

BB_GENERATE_MIRROR_TARBALLS ??= "0"

NO32LIBS ??= "1"

# Missing checksums should raise an error
BB_STRICT_CHECKSUM = "0"

TCLIBCAPPEND = ""

# Drop unused PACKAGE_EXTRA_ARCHS
PACKAGE_EXTRA_ARCHS = "${TUNE_PKGARCH} ${OEM_ARCH} ${STATIC_ARCH}"

# add support for extra feeds
PACKAGE_ARCHS += " 3rdparty ${MACHINE}_3rdparty private"

LICENSE_FLAGS_ACCEPTED = "commercial"
COMMERCIAL_AUDIO_PLUGINS ?= "gstreamer1.0-plugins-ugly-mad"
COMMERCIAL_VIDEO_PLUGINS ?= "gstreamer1.0-plugins-ugly-mpeg2dec"

INHERIT += "rm-pycache"
```
