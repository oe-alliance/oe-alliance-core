## meta-oe/conf/distro/openxta.conf
```bitbake
#@TYPE: Distribution
#@NAME: OpenXTA
#@DESCRIPTION: Embedded Linux Distribution Configuration for STB's

OE_TERMINAL ?= "auto"
DISTRO_NAME ?= "openxta"
DISTRO_VERSION = "4.0"
DISTRO_TYPE ?= "release"
BUILD_VERSION = "1"

# default Enigma2 skin.
E2DEFAULTSKIN = "enigma2-plugin-skins-xta2"

ENIGMA2_URI ?= "git://github.com/XTAv2/Enigma2.git;protocol=git"
ENIGMA2_PLUGINS_URI ?= "git://github.com/oe-alliance/enigma2-plugins.git;protocol=git"
ENIGMA2_SKINS_URI ?= "git://github.com/OpenViX/enigma2-skins.git;protocol=git"


IPKG_VARIANT = "opkg"

FEED_NAME ?= "${DISTRO_NAME}-${DISTRO_VERSION}"
DISTRO_FEED_URI ?= "http://feed.openxta.com/${DISTRO_VERSION}/${MACHINE}"
DISTRO_FEED_PREFIX ?= "openxta"
IMAGE_VERSION = "${DISTRO_VERSION}"
IMAGE_NAME = "${DISTRO_NAME}-${IMAGE_VERSION}-${MACHINEBUILD}-${DATE}"
IMAGE_ROOTFS = "${TMPDIR}/rootfs/${MACHINE}"
IMAGE_LINK_NAME = ""
CACHE ?= "${TMPDIR}/cache/${LIBC}/${MACHINE}"
DEPLOY_DIR ?= "${TMPDIR}/deploy/${LIBC}"
DEPLOY_DIR_IMAGE = "${DEPLOY_DIR}/images/${MACHINE}"

require conf/distro/include/unstable-versions.inc

VIRTUAL-RUNTIME_dev_manager = "busybox-mdev"
VIRTUAL-RUNTIME_login_manager = "busybox"
VIRTUAL-RUNTIME_init_manager = "sysvinit"
VIRTUAL-RUNTIME_initscripts = "initscripts"

PREFERRED_PROVIDER_enigma2-plugin-skins-technihd = "openxta-technihd"

PREFERRED_PROVIDERS += "virtual/${TARGET_PREFIX}gcc-initial:gcc-cross-initial"
PREFERRED_PROVIDERS += "virtual/${TARGET_PREFIX}gcc-intermediate:gcc-cross-intermediate"
PREFERRED_PROVIDERS += "virtual/${TARGET_PREFIX}gcc:gcc-cross"
PREFERRED_PROVIDERS += "virtual/${TARGET_PREFIX}g++:gcc-cross"

LICENSE_FLAGS_WHITELIST = "commercial_gst-plugins-ugly commercial_lame commercial_libmad commercial_mpeg2dec"
COMMERCIAL_AUDIO_PLUGINS ?= "gst-plugins-ugly-mad gst-plugins-ugly-mpegaudioparse"
COMMERCIAL_VIDEO_PLUGINS ?= "gst-plugins-ugly-mpeg2dec gst-plugins-ugly-mpegstream gst-plugins-bad-mpegvideoparse"

# OE optimization defaults to -O2 which makes for much larger binaries.
# Override here to use -Os instead, resulting in smaller images.
FULL_OPTIMIZATION = "-Os -pipe ${DEBUG_FLAGS}"
# build some core libs with better compiler optimization for better performance
O3_OPT = "-O3 -pipe ${DEBUG_FLAGS}"
FULL_OPTIMIZATION_pn-flac = "${O3_OPT}"
FULL_OPTIMIZATION_pn-jpeg = "${O3_OPT}"
FULL_OPTIMIZATION_pn-lame = "${O3_OPT}"
FULL_OPTIMIZATION_pn-liba52 = "${O3_OPT}"
FULL_OPTIMIZATION_pn-libdca = "${O3_OPT}"
FULL_OPTIMIZATION_pn-libgcrypt = "${O3_OPT}"
FULL_OPTIMIZATION_pn-libmad = "${O3_OPT}"
FULL_OPTIMIZATION_pn-libogg = "${O3_OPT}"
FULL_OPTIMIZATION_pn-libpng = "${O3_OPT}"
FULL_OPTIMIZATION_pn-libsamplerate = "${O3_OPT}"
FULL_OPTIMIZATION_pn-libvorbis = "${O3_OPT}"
FULL_OPTIMIZATION_pn-tremor = "${O3_OPT}"
FULL_OPTIMIZATION_pn-zlib = "${O3_OPT}"

PYTHON_BASEVERSION ?= "2.7"
PREFERRED_VERSION_python ?= "2.7.3"
PREFERRED_VERSION_python-native ?= "2.7.3"

# Force the older version of liberation-fonts until we fix the fontforge issue
PREFERRED_VERSION_liberation-fonts ?= "1.04"

PREFERRED_VERSION_udev ?= "182"

PREFERRED_VERSION_wpa-supplicant ?= "0.7.3"

PREFERRED_VERSION_netatalk ?= "2.2.3"

DISTRO_FEATURES ?= "pli x11 alsa argp bluetooth ext2 irda largefile pcmcia wifi wifi-extra xattr nfs appletalk smbfs zeroconf pci ${DISTRO_FEATURES_LIBC} pam"

QA_LOG = "1"
QA_LOGFILE = "${TMPDIR}/qa.log"

OEINCLUDELOGS ?= "yes"
KERNEL_CONSOLE ?= "ttyS0,115200n8"

BB_GENERATE_MIRROR_TARBALLS ??= "0"

NO32LIBS ??= "1"

# Missing checksums should raise an error
BB_STRICT_CHECKSUM = "0"

TCLIBC = "eglibc"
TCLIBCAPPEND = ""

# Drop unused PACKAGE_EXTRA_ARCHS
PACKAGE_EXTRA_ARCHS = "${TUNE_PKGARCH}"

# add support for 3rd party feeds
PACKAGE_ARCHS += " 3rdparty ${MACHINE}_3rdparty"

LICENSE_FLAGS_WHITELIST = "commercial_gst-plugins-ugly commercial_lame commercial_libmad commercial_mpeg2dec commercial_ffmpeg commercial_libav commercial_x264"
COMMERCIAL_AUDIO_PLUGINS ?= "gst-plugins-ugly-mad gst-plugins-ugly-mpegaudioparse"
COMMERCIAL_VIDEO_PLUGINS ?= "gst-plugins-ugly-mpeg2dec gst-plugins-ugly-mpegstream gst-plugins-bad-mpegvideoparse"
```

## meta-oe/conf/distro/teamblue.conf
```bitbake
#@TYPE: Distribution
#@NAME: teamBlue
#@DESCRIPTION: Embedded Linux Distribution Configuration for STB's

DISTRO_FEATURES_BACKFILL_CONSIDERED += "pulseaudio gobject-introspection-data"

OE_TERMINAL ?= "auto"
DISTRO_NAME ?= "teamblue"
DISPLAY_DISTRO  ?= "Teamblue"
DISTRO_VERSION = "7.0"
BUILD_VERSION = "000"
DEVELOPER_BUILD_VERSION = "001"
DISTRO_TYPE ?= "release"
BUILD_VERSION = "0"
BB_HASH_IGNORE_MISMATCH = "1"
DEFAULT_TIMEZONE = "Europe/Berlin"
#STATIC_FEED = "1"

##disable root account per default user must set a password after first login to use telnet,ftp,ssh
#ROOT_ACCOUT ?= "disable"
#INHERIT += "extrausers"
#EXTRA_USERS_PARAMS = "${@bb.utils.contains("ROOT_ACCOUT", "disable", "usermod -p ! root" , "", d)}"

# default Enigma2 skin.
E2DEFAULTSKIN = "enigma2-plugin-skins-pax-v2"

ENIGMA2_URI ?= "${@bb.utils.contains("DISTRO_TYPE", "release", "git://github.com/teamblue-e2/enigma2.git;protocol=https;branch=${DISTRO_VERSION}" , "git://github.com/teamblue-e2/enigma2.git;protocol=https;branch=python3-old", d)}"

ENIGMA2_SKINS_URI ?= "git://github.com/OpenViX/enigma2-skins.git;protocol=https;branch=master"

IPKG_VARIANT = "opkg"

FEED_NAME ?= "${DISTRO_NAME}-${DISTRO_VERSION}"
DISTRO_FEED_URI ?= "${@bb.utils.contains("DISTRO_TYPE", "release", "https://feed.teamblue.tech/${DISTRO_VERSION}-release/${MACHINE}" , "https://feed.teamblue.tech/${DISTRO_VERSION}-${DISTRO_TYPE}/${MACHINE}", d)}"
STATIC_DISTRO_FEED_URI ?= "https://feed.teamblue.tech/${DISTRO_VERSION}-release/${MACHINE}"

DISTRO_FEED_PREFIX ?= "teamblue"

IMAGE_VERSION = "${DISTRO_VERSION}"

IMAGE_NAME = "${DISTRO_NAME}-${IMAGE_VERSION}-${MACHINEBUILD}-${DATE}"
IMAGE_NAME[vardepsexclude] += "DATE"
IMAGE_ROOTFS = "${TMPDIR}/rootfs/${MACHINE}"
IMAGE_LINK_NAME = ""
CACHE ?= "${TMPDIR}/cache/${LIBC}/${MACHINE}"
DEPLOY_DIR ?= "${TMPDIR}/deploy/${LIBC}"
DEPLOY_DIR_IMAGE = "${DEPLOY_DIR}/images/${MACHINE}"

#USER_CLASSES += "image-prelink"
# SANITY_REQUIRED_UTILITIES = "patch diffstat texi2html makeinfo svn bzip2 tar gzip gawk chrpath wget cpio sshpass"
# INHERIT += "buildhistory recipe_sanity testlab"
# BUILDHISTORY_COMMIT = "1"

require conf/distro/include/unstable-versions.inc

VIRTUAL-RUNTIME_dev_manager = "busybox-mdev"
VIRTUAL-RUNTIME_login_manager = "busybox"
VIRTUAL-RUNTIME_init_manager = "sysvinit"
VIRTUAL-RUNTIME_initscripts = "initscripts"

# OE optimization defaults to -O2 which makes for much larger binaries.
# Override here to use -Os instead, resulting in smaller images.
FULL_OPTIMIZATION = "-Os -pipe ${DEBUG_FLAGS}"
# build some core libs with better compiler optimization for better performance
O3_OPT = "-O3 -pipe ${DEBUG_FLAGS}"
FULL_OPTIMIZATION:pn-flac = "${O3_OPT}"
FULL_OPTIMIZATION:pn-jpeg = "${O3_OPT}"
FULL_OPTIMIZATION:pn-lame = "${O3_OPT}"
FULL_OPTIMIZATION:pn-liba52 = "${O3_OPT}"
FULL_OPTIMIZATION:pn-libdca = "${O3_OPT}"
FULL_OPTIMIZATION:pn-libgcrypt = "${O3_OPT}"
FULL_OPTIMIZATION:pn-libmad = "${O3_OPT}"
FULL_OPTIMIZATION:pn-libogg = "${O3_OPT}"
FULL_OPTIMIZATION:pn-libpng = "${O3_OPT}"
FULL_OPTIMIZATION:pn-libsamplerate = "${O3_OPT}"
FULL_OPTIMIZATION:pn-libvorbis = "${O3_OPT}"
FULL_OPTIMIZATION:pn-tremor = "${O3_OPT}"
FULL_OPTIMIZATION:pn-zlib = "${O3_OPT}"

# Use upx to compress some binaries for boxes with up to this flash-size (Must be a power of 2 larger or equal 64):
COMPRESS_UPTO = "256"

PREFERRED_VERSION_netatalk ?= "2.2.3"

DISTRO_FEATURES = "${DISTRO_FEATURES_EXTRA} bluez5 directfb gtk-directfb pulseaudio pli alsa argp bluetooth ext2 ipv4 ipv6 irda largefile ldconfig mplt pcmcia wifi wifi-extra xattr nfs smbfs zeroconf pci pam \
                   no-autobouquetsmaker audioeffect tuxtxtfhd \
                   "

QA_LOG = "1"
QA_LOGFILE = "${TMPDIR}/qa.log"

OEINCLUDELOGS ?= "yes"
KERNEL_CONSOLE ?= "ttyS0,115200n8"

BB_GENERATE_MIRROR_TARBALLS ??= "0"

NO32LIBS ??= "1"

# Missing checksums should raise an error
BB_STRICT_CHECKSUM = "0"

TCLIBCAPPEND = ""

# Drop unused PACKAGE_EXTRA_ARCHS
PACKAGE_EXTRA_ARCHS = "${TUNE_PKGARCH} ${OEM_ARCH} ${STATIC_ARCH}"

# add support for extra feeds
PACKAGE_ARCHS += " 3rdparty ${MACHINE}_3rdparty private"

LICENSE_FLAGS_ACCEPTED = "commercial"
COMMERCIAL_AUDIO_PLUGINS ?= "gstreamer1.0-plugins-ugly-mad"
COMMERCIAL_VIDEO_PLUGINS ?= "gstreamer1.0-plugins-ugly-mpeg2dec"

INHERIT += "rm-pycache"
```

## meta-oe/conf/layer.conf
```bitbake
# We have a conf and classes directory, append to BBPATH
BBPATH .= ":${LAYERDIR}"

# We have a recipes directory, add to BBFILES
BBFILES += "${LAYERDIR}/recipes-*/*/*.bb ${LAYERDIR}/recipes-*/*/*.bbappend \
            ${LAYERDIR}/recipes-*/*/*/*.bb ${LAYERDIR}/recipes-*/*/*/*.bbappend"

BBFILE_COLLECTIONS += "oe-alliance-layer"
BBFILE_PATTERN_oe-alliance-layer := "^${LAYERDIR}/"
BBFILE_PRIORITY_oe-alliance-layer = "7"

LAYERSERIES_COMPAT_oe-alliance-layer = "langdale"

OE-ALLIANCE_BASE := '${@os.path.normpath("${LAYERDIR}/../")}'
OEA-META-OE-BASE := '${@os.path.normpath("${LAYERDIR}/")}'

IMAGE_VER_STRING ?= '${DISTRO_NAME}-${IMAGE_VERSION}-${MACHINEBUILD}-${DATE}'
IMAGE_VER_STRING[vardepsexclude] += "DATE"
OE_VER ?= 'OE-Alliance 5.2'
GST_VERSION ?= "1.0"
DEVELOPER_BUILD_VERSION ?= "001"
IMAGE_BUILD ?= "${DISTRO_VERSION}.${BUILD_VERSION}"
GCCVERSION = "12.%"
OEM_ARCH ?= ""
PYTHON_PN ?= "python3"
STATIC_FEED ?= "0"
STATIC_ARCH ?= ""

HOSTTOOLS += "base64 curl java python python2 python2.7 sshpass svn unzip whoami zip"

DEFAULT_TIMEZONE ?= "GMT"

PACKAGECONFIG:pn-glmark2 = ""
PACKAGECONFIG:pn-cogl-1.0 = "egl-null gles2"
EXTRA_OECONF:append:pn-cogl-1.0 = " --disable-introspection"

MIRRORS += "\
ftp://.*/.*    http://openvix.co.uk/feeds_extras/sources-mirror/ \n \
http://.*/.*   http://openvix.co.uk/feeds_extras/sources-mirror/ \n \
https://.*/.*  http://openvix.co.uk/feeds_extras/sources-mirror/ \n \
ftp://.*/.*    https://source.mynonpublic.com/ \n \
http://.*/.*   https://source.mynonpublic.com/ \n \
https://.*/.*  https://source.mynonpublic.com/ \n \
ftp://.*/.*    http://code.vuplus.com/download/mirror/ \n \
http://.*/.*   http://code.vuplus.com/download/mirror/ \n \
https://.*/.*  http://code.vuplus.com/download/mirror/ \n \
ftp://.*/.*    http://autobuilder.yoctoproject.org/sources/ \n \
http://.*/.*   http://autobuilder.yoctoproject.org/sources/ \n \
https://.*/.*  http://autobuilder.yoctoproject.org/sources/ \n \
"

PREMIRRORS ?= "\
bzr://.*/.*   http://openvix.co.uk/feeds_extras/sources-mirror/ \n \
cvs://.*/.*   http://openvix.co.uk/feeds_extras/sources-mirror/ \n \
git://.*/.*   http://openvix.co.uk/feeds_extras/sources-mirror/ \n \
hg://.*/.*    http://openvix.co.uk/feeds_extras/sources-mirror/ \n \
osc://.*/.*   http://openvix.co.uk/feeds_extras/sources-mirror/ \n \
p4://.*/.*    http://openvix.co.uk/feeds_extras/sources-mirror/ \n \
svn://.*/.*   http://openvix.co.uk/feeds_extras/sources-mirror/ \n \
bzr://.*/.*   https://source.mynonpublic.com/ \n \
cvs://.*/.*   https://source.mynonpublic.com/ \n \
git://.*/.*   https://source.mynonpublic.com/ \n \
hg://.*/.*    https://source.mynonpublic.com/ \n \
osc://.*/.*   https://source.mynonpublic.com/ \n \
p4://.*/.*    https://source.mynonpublic.com/ \n \
svn://.*/.*   https://source.mynonpublic.com/ \n \
bzr://.*/.*   http://code.vuplus.com/download/mirror/ \n \
cvs://.*/.*   http://code.vuplus.com/download/mirror/ \n \
git://.*/.*   http://code.vuplus.com/download/mirror/ \n \
hg://.*/.*    http://code.vuplus.com/download/mirror/ \n \
osc://.*/.*   http://code.vuplus.com/download/mirror/ \n \
p4://.*/.*    http://code.vuplus.com/download/mirror/ \n \
svn://.*/.*   http://code.vuplus.com/download/mirror/ \n \
bzr://.*/.*   http://autobuilder.yoctoproject.org/sources/ \n \
cvs://.*/.*   http://autobuilder.yoctoproject.org/sources/ \n \
git://.*/.*   http://autobuilder.yoctoproject.org/sources/ \n \
hg://.*/.*    http://autobuilder.yoctoproject.org/sources/ \n \
osc://.*/.*   http://autobuilder.yoctoproject.org/sources/ \n \
p4://.*/.*    http://autobuilder.yoctoproject.org/sources/ \n \
svn://.*/.*   http://autobuilder.yoctoproject.org/sources/ \n \
"

OE_TERMINAL ?= "screen"
FETCHCOMMAND_wget = "/usr/bin/env wget -T 10 -t 5 -nv --passive-ftp --no-check-certificate -P ${DL_DIR} '${URI}'"

PLISVNURL ?= "svn://svn.code.sf.net/p/openpli/code"
PLISVNBRANCH ?= "trunk"

ENIGMA2_PLUGINS_URI ?= "git://github.com/oe-alliance/enigma2-plugins.git;protocol=https;branch=master"
OEA_PLUGINS_URI ?= "git://github.com/oe-alliance/oe-alliance-plugins.git;protocol=https;branch=master"

PREFERRED_PROVIDER_enigma2-skindefault ?= "enigma2-skindefault-master"
PREFERRED_PROVIDER_font-valis-enigma ?= "font-valis-enigma"
PREFERRED_PROVIDER_font-valis-hd ?= "font-valis-hd-enigma"
PREFERRED_PROVIDER_enigma2-plugin-systemplugins-blindscan ?= "enigma2-oe-alliance-plugins"
PREFERRED_PROVIDER_enigma2-plugin-systemplugins-remotecontrolcode ?= "enigma2-oe-alliance-plugins"
PREFERRED_PROVIDER_enigma2-plugin-systemplugins-fpgaupgrade ?= "enigma2-oe-alliance-plugins"
PREFERRED_PROVIDER_enigma2-plugin-systemplugins-firmwareupgrade ?= "enigma2-oe-alliance-plugins"
PREFERRED_PROVIDER_enigma2-plugin-systemplugins-vuplusevent ?= "enigma2-oe-alliance-plugins"
PREFERRED_PROVIDER_enigma2-plugin-extensions-hbbtv ?= "enigma2-oe-alliance-plugins"
PREFERRED_PROVIDER_enigma2-plugin-extensions-autotimer ?= "enigma2-oe-alliance-plugins"

PREFERRED_PROVIDER_jpeg ?= "jpeg"
PREFERRED_PROVIDER_jpeg-native ?= "jpeg-native"
PREFERRED_PROVIDER_ntp ?= "ntp"
PREFERRED_PROVIDER_gmp ?= "gmp"
PREFERRED_PROVIDER_mpfr ?= "mpfr"
PREFERRED_PROVIDER_libusb-compat ?= "libusb-compat"
PREFERRED_PROVIDER_directfb ?= "directfb"
PREFERRED_PROVIDER_initd-functions = "lsbinitscripts"
PREFERRED_PROVIDER_${PYTHON_PN}-pycrypto ?= "${PYTHON_PN}-pycryptodome"

PREFERRED_VERSION_wpa-supplicant ?= "2.10"
PREFERRED_VERSION_directfb:arm = "1.7.7"
PREFERRED_VERSION_directfb-native:arm = "1.7.7"
PREFERRED_VERSION_directfb:aarch64 = "1.7.7"
PREFERRED_VERSION_directfb-native:aarch64 = "1.7.7"
PREFERRED_VERSION_libsoup-2.4 = "2.62.3"
PREFERRED_VERSION_mtd-utils = "2.0.0"
PREFERRED_VERSION_libsdl2 ?= "2.0.14"
PREFERRED_VERSION_libsdl2:mipsel = "2.0.8"
PREFERRED_VERSION_libsdl2:mips = "2.0.8"
PREFERRED_VERSION_nfs-utils = "2.5.3"
PREFERRED_VERSION_usb-dvb-dvbsky = "141106"
PREFERRED_VERSION_python3-cryptography ?= "38.%"
PREFERRED_VERSION_python3-google-api-python-client ?= "2.%"
PREFERRED_VERSION_libdvdnav = "5.0.3"
PREFERRED_VERSION_libdvdread = "5.0.3"

# to Build Kodi 20 remove next line
#PREFERRED_VERSION_stb-kodi-${MACHINE} = "19.4-gitrAUTOINC+e12e66e019"
VIRTUAL-RUNTIME_base-utils-hwclock = " "

SIGGEN_EXCLUDERECIPES_ABISAFE += " \
  recovery \
"

# Use OpenSSL only
PACKAGECONFIG:pn-curl = "ipv6 ssl proxy zlib"
PACKAGECONFIG:pn-openldap = "openssl modules mdb ldap meta monitor null passwd shell proxycache dnssrv ipv6"

LICENSE_PATH += "${LAYERDIR}/licenses"

ROOT_HOME ??= "/home/root"
FLASHSIZE ?= "${@bb.utils.contains("MACHINE_FEATURES", "smallflash", "64", "256", d)}"

# Use upx to compress some binaries for boxes with up to this flash-size (Must be a power of 2 larger or equal 64):
COMPRESS_UPTO ?= "256"

# Dont include debug sources files in debug packages
PACKAGE_DEBUG_SPLIT_STYLE = "debug-without-src"

# Revert OE-core insane.bbclass change, where these warnings became errors
ERROR_QA:remove = "already-stripped installed-vs-shipped ldflags compile-host-path \
                    install-host-path pn-overrides unknown-configure-option \
                    useless-rpaths rpaths staticdev empty-dirs"
WARN_QA:append = "already-stripped installed-vs-shipped ldflags compile-host-path \
                    install-host-path pn-overrides unknown-configure-option \
                    useless-rpaths rpaths staticdev"

WARN_QA:remove = "buildpaths"
```
