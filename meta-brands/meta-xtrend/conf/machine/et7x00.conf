## meta-brands/meta-xtrend/conf/machine/et7x00.conf
```bitbake
#@TYPE: Machine
#@NAME: Xtrend et7x00
#@DESCRIPTION: Machine configuration for the Xtrend et7x00

MACHINE_NAME = "ET7x00"

RCTYPE = "16"
RCNAME = "et7x00"
RCHARDWARE = "V1"

# Broken bootloader can only flash around 100 MB
FLASHSIZE = "96"

PREFERRED_VERSION_linux-etxx00 = "4.4.8"

SOC_FAMILY = "bcm73625"

DVBSKYPROVIDER = "kernel"

UBI_VOLNAME = "rootfs"
MKUBIFS_ARGS = "-m 2048 -e 126976 -c 8192"
UBINIZE_ARGS = "-m 2048 -p 128KiB"

require conf/machine/include/etxx00.inc

MACHINE_FEATURES += "dvb-c ci textlcd videoenhancement blindscan-dvbc skins1080 feature2 blindscan-tbs blindscan-dvbs HDMI RCA oem-info singlecore"
```

## meta-brands/meta-xtrend/conf/machine/et8000.conf
```bitbake
#@TYPE: Machine
#@NAME: Xtrend et8000
#@DESCRIPTION: Machine configuration for the Xtrend et8000

MACHINE_NAME = "ET8000"

PREFERRED_VERSION_linux-etxx00 = "4.10.6"
PREFERRED_VERSION_linux-libc-headers = "4.10"

SOC_FAMILY = "bcm7241"

DVBSKYPROVIDER = "kernel"

UBI_VOLNAME = "rootfs"
MKUBIFS_ARGS = "-m 2048 -e 126976 -c 8192"
UBINIZE_ARGS = "-m 2048 -p 128KiB"

require conf/machine/include/etxx00.inc

MACHINE_FEATURES += "dvb-c ci fanctrl textlcd videoenhancement blindscan-dvbc skins1080 blindscan-tbs linuxwifi boxmodel"
```

## meta-brands/meta-xtrend/conf/machine/et8500.conf
```bitbake
#@TYPE: Machine
#@NAME: Xtrend et8500
#@DESCRIPTION: Machine configuration for the Xtrend et8500

MACHINE_NAME = "ET8500"

RCTYPE = "16"
RCNAME = "et8000"
RCHARDWARE = "V1"

# Broken bootloader can only flash around 100 MB
FLASHSIZE = "96"

PREFERRED_VERSION_linux-etxx00 = "4.4.8"

SOC_FAMILY = "bcm7241"

DVBSKYPROVIDER = "kernel"

UBI_VOLNAME = "rootfs"
MKUBIFS_ARGS = "-m 2048 -e 126976 -c 8192"
UBINIZE_ARGS = "-m 2048 -p 128KiB"

require conf/machine/include/etxx00.inc

MACHINE_FEATURES += "colorlcd720 dvb-c ci fanctrl videoenhancement blindscan-dvbc skins1080 feature2 blindscan-tbs RCA HDMI"
```

## meta-brands/meta-xtrend/conf/machine/et9x00.conf
```bitbake
#@TYPE: Machine
#@NAME: Xtrend et9x00
#@DESCRIPTION: Machine configuration for the Xtrend et9x00

MACHINE_NAME = "ET9X00"

RCTYPE = "5"
RCNAME = "et9x00"
RCHARDWARE = "V2"

# Broken bootloader can only flash around 100 MB
FLASHSIZE = "96"

PREFERRED_VERSION_linux-etxx00 = "3.8.7"

SOC_FAMILY = "bcm7413"

UBI_VOLNAME = "rootfs"
MKUBIFS_ARGS = "-m 2048 -e 126976 -c 4096"
UBINIZE_ARGS = "-m 2048 -p 128KiB"

require conf/machine/include/etxx00.inc

MACHINE_FEATURES += "ci fanctrl textlcd skins1080 feature2 blindscan-tbs blindscan-dvbs boxmodel SCART HDMI YUV smallflash oem-info"
```

## meta-brands/meta-xtrend/conf/machine/include/etxx00-oem.inc
```bitbake
PACKAGECONFIG_GL_pn-qtbase = "gles2 eglfs linuxfb"
PACKAGECONFIG_FB_pn-qtbase = " "
# We know about rtc
include conf/machine/include/build-extras.inc

BRAND_OEM = "xtrend"

MACHINE_NAME = "\
${@bb.utils.contains('MACHINEBUILD', 'gi11000', 'ET11000' , '', d)}\
${@bb.utils.contains('MACHINEBUILD', 'viper4k51', 'VIPER4K51' , '', d)}\
${@bb.utils.contains('MACHINEBUILD', 'beyonwizu4', 'U4' , '', d)}\
"

MACHINE_BRAND = "\
${@bb.utils.contains('MACHINEBUILD', 'gi11000', 'Galaxy Innovations' , '', d)}\
${@bb.utils.contains('MACHINEBUILD', 'viper4k51', 'AMIKO' , '', d)}\
${@bb.utils.contains('MACHINEBUILD', 'beyonwizu4', 'Beyonwiz' , '', d)}\
"

IMAGEDIR ?= "\
${@bb.utils.contains('MACHINEBUILD', 'gi11000', 'et1x000' , '', d)}\
${@bb.utils.contains('MACHINEBUILD', 'viper4k51', 'et1x000' , '', d)}\
${@bb.utils.contains('MACHINEBUILD', 'beyonwizu4', 'beyonwiz/u4' , '', d)}\
"

MACHINE_DRIVER = "\
${@bb.utils.contains('MACHINEBUILD', 'gi11000', 'et1x000' , '', d)}\
${@bb.utils.contains('MACHINEBUILD', 'viper4k51', 'et1x000' , '', d)}\
${@bb.utils.contains('MACHINEBUILD', 'beyonwizu4', 'beyonwizu4' , '', d)}\
"

MTD_ROOTFS = "mmcblk0p4"
MTD_KERNEL = "mmcblk0p3"
KERNEL_FILE = "kernel.bin"
ROOTFS_FILE = "rootfs.tar.bz2"

IMAGEDIR ?= "${MACHINE}"

MACHINE_ESSENTIAL_EXTRA_RDEPENDS += "\
    et-dvb-modules-${MACHINE_DRIVER} \
    et-initrd-${MACHINE} \
    "

DVBPROVIDER = "kernel"
DVBSKYPROVIDER = "kernel"

MACHINE_ESSENTIAL_EXTRA_RRECOMMENDS += "\
    kernel-module-cdfs \
	${@bb.utils.contains('MACHINE_FEATURES', 'v3d', 'et-v3ddriver-${MACHINE}', '',d)} \
	${@bb.utils.contains('MACHINE_FEATURES', 'v3d', 'platform-util-${MACHINE}', '',d)} \
	${@bb.utils.contains('MACHINE_FEATURES', 'kodi19', 'mkswapdev-${MACHINE}', '',d)} \
    "

MACHINE_EXTRA_RRECOMMENDS += " \
    gstreamer1.0-plugin-dvbmediasink \
    gstreamer1.0-libav \
    "

include conf/machine/include/autoload-filesystems.inc

DVBMEDIASINK_CONFIG = "--with-wma --with-wmv --with-pcm --with-dtsdownmix --with-eac3 --with-h265 --with-vb6 --with-vb8 --with-vb9 --with-spark"

TARGET_ARCH = "arm"
DEFAULTTUNE = "cortexa15hf-neon-vfpv4"
IMAGE_FSTYPES =+ "tar.bz2"

PREFERRED_PROVIDER_virtual/kernel = "linux-etxx00"

PREFERRED_PROVIDER_virtual/blindscan-dvbs = "et-blindscan-utils-${MACHINE}"
PREFERRED_PROVIDER_virtual/blindscan-dvbc = "et-blindscan-utils-${MACHINE}"

PREFERRED_PROVIDER_virtual/egl = "et-v3ddriver-${MACHINE}"
PREFERRED_PROVIDER_virtual/libgles2 = "et-v3ddriver-${MACHINE}"
PREFERRED_PROVIDER_virtual/kodi = "stb-kodi-${MACHINE}"

MACHINE_FEATURES += "alsa 3dtv switchoff hdmicec omb  \
    ${@bb.utils.contains('MACHINEBUILD', 'beyonwizu4', 'dvbc-only' , 'blindscan-tbs', d)} \
"

BOOTLOGO_FILENAME = "splash.bin"

require conf/machine/include/tune-cortexa15.inc
require conf/machine/include/soc-family.inc
require conf/machine/box-hardware.inc

OEM_ARCH = "${MACHINEBUILD}"

# Add "MACHINEBUILD" override for recipes
MACHINEOVERRIDES =. "${@['', '${MACHINEBUILD}:']['${MACHINEBUILD}' != '']}"
```

## meta-brands/meta-xtrend/conf/machine/include/etxx00.inc
```bitbake
# We know about rtc
include conf/machine/include/build-extras.inc

BRAND_OEM = "xtrend"
MACHINE_BRAND = "Xtrend"

MTD_KERNEL = "mtd1"
MTD_ROOTFS = "mtd2"
KERNEL_FILE = "kernel.bin"
ROOTFS_FILE = "rootfs.bin"

MACHINE_ESSENTIAL_EXTRA_RDEPENDS += "\
    et-dvb-modules-${MACHINE} \
    "

DVBPROVIDER = "kernel"

MACHINE_ESSENTIAL_EXTRA_RRECOMMENDS += "\
    kernel-module-cdfs \
    "

MACHINE_EXTRA_RRECOMMENDS += " \
    gstreamer1.0-plugin-dvbmediasink \
    ${@bb.utils.contains('MACHINE_FEATURES', 'v3d-nxpl', 'xtrend-v3ddriver-${MACHINE}' , '', d)} \
    ${@bb.utils.contains('MACHINE_FEATURES', 'oem-info', 'oem-info', '',d)} \
    "

include conf/machine/include/autoload-filesystems.inc

DVBMEDIASINK_CONFIG = "--with-wma --with-wmv --with-pcm --with-dts --with-eac3 --with-max-pcmrate-48K \
    ${@bb.utils.contains('MACHINE', 'et8500', '--with-vb6 --with-vb8 --with-spark' , '', d)} \
    ${@bb.utils.contains('MACHINE', 'et7x00', '--with-vb6 --with-vb8 --with-spark --with-h265' , '', d)} \
"

TARGET_ARCH = "mipsel"
DEFAULTTUNE = "mips32el"

PREFERRED_PROVIDER_virtual/egl ?= "xtrend-v3ddriver-${MACHINE}" 
PREFERRED_PROVIDER_virtual/libgles1 ?= "xtrend-v3ddriver-${MACHINE}"
PREFERRED_PROVIDER_virtual/libgles2 ?= "xtrend-v3ddriver-${MACHINE}"
PREFERRED_PROVIDER_virtual/libgbm ?= "xtrend-v3ddriver-${MACHINE}"
PREFERRED_PROVIDER_virtual/libgl ?= "mesa"
PREFERRED_PROVIDER_virtual/mesa ?= "mesa"

PREFERRED_PROVIDER_virtual/kernel = "linux-etxx00"
PREFERRED_PROVIDER_virtual/blindscan-dvbs = "et-blindscan-dvbs-utils"
PREFERRED_PROVIDER_virtual/blindscan-dvbc = "et-blindscan-dvbc-utils-${MACHINE}"
PREFERRED_PROVIDER_virtual/kodi = "stb-kodi-${MACHINE}"

KERNEL_IMAGETYPE = "vmlinux"
KERNEL_OUTPUT = "${KERNEL_IMAGETYPE}"
KERNEL_CONSOLE = "ttyS0,115200n8"

IMAGE_FSTYPES ?= "ubi"

IMAGEDIR ?= "${MACHINE}"

IMAGE_CMD:ubifs:prepend = " \
	mkdir -p ${IMAGE_ROOTFS}/usr/lib; \
	if [ "${PACKAGE_LIST}" = "1" ]; then \
        cp ${IMAGE_MANIFEST} ${IMAGE_ROOTFS}/usr/lib/package.lst; \
    fi; \
    rm -rf ${IMAGE_ROOTFS}/boot/*; \
    rm -rf ${IMAGE_ROOTFS}/tmp/*; \
    "

IMAGE_CMD:ubi:append = "\
    mkdir -p ${DEPLOY_DIR_IMAGE}/${IMAGEDIR}; \
    ${@bb.utils.contains("MACHINE_FEATURES", "bootsplash", "cp ${DEPLOY_DIR_IMAGE}/${BOOTLOGO_FILENAME} ${DEPLOY_DIR_IMAGE}/${IMAGEDIR}/${BOOTLOGO_FILENAME};" , "", d)} \
    mv ${IMGDEPLOYDIR}/${IMAGE_NAME}.ubi ${DEPLOY_DIR_IMAGE}/${IMAGEDIR}/${ROOTFS_FILE}; \
    gzip -9c ${DEPLOY_DIR_IMAGE}/vmlinux-${MACHINE}.bin > ${DEPLOY_DIR_IMAGE}/${IMAGEDIR}/${KERNEL_FILE}; \
    echo ${IMAGE_VER_STRING} > ${DEPLOY_DIR_IMAGE}/${IMAGEDIR}/imageversion; \
    echo "rename this file to 'force' to force an update without confirmation" > ${DEPLOY_DIR_IMAGE}/${IMAGEDIR}/noforce; \
    cd ${DEPLOY_DIR_IMAGE}; \
    zip ${IMAGE_NAME}_usb.zip ${IMAGEDIR}/*; \
    rm -f ${DEPLOY_DIR_IMAGE}/*.ubi; \
    rm -f ${DEPLOY_DIR_IMAGE}/*.ubifs; \
    rm -f ${DEPLOY_DIR_IMAGE}/*.manifest; \
    rm -f ${DEPLOY_DIR_IMAGE}/.ubifs; \
    rm -f ${DEPLOY_DIR_IMAGE}/.manifest; \
    rm -Rf ${IMAGEDIR}; \
    "

MACHINE_FEATURES += "3dtv alsa hdmicec switchoff bootsplash omb feature1"

BOOTLOGO_FILENAME = "splash.bin"

require conf/machine/include/mips/tune-mips32.inc
require conf/machine/include/soc-family.inc
require conf/machine/box-hardware.inc

EXTRA_IMAGEDEPENDS += " \
    enigma2-plugin-systemplugins-remotecontrolcode \
    "

MACHINE_EXTRA_RDEPENDS_${PN} = " \
    enigma2-plugin-systemplugins-remotecontrolcode \
    "

# Add "MACHINEBUILD" override for recipes
MACHINEOVERRIDES =. "${@['', '${MACHINEBUILD}:']['${MACHINEBUILD}' != '']}"
```

## meta-oe/conf/distro/include/openhdf.inc
```bitbake
BUILD_VERSION = "1"
BUILDCFG_VARS += "ENIGMA2_URI PKGDATA_DIR MACHINEBUILD BUILD_VERSION DEPLOY_DIR_IPK"
```

## meta-oe/conf/distro/include/unstable-versions.inc
```bitbake
# git
SRCREV:pn-enigma2-plugin-skins-magic ?= "${AUTOREV}"
SRCREV:pn-aio-grab ?= "${AUTOREV}"
SRCREV:pn-ambx ?= "${AUTOREV}"
SRCREV:pn-${PYTHON_PN}-pyambx ?= "${AUTOREV}"
SRCREV:pn-enigma2-plugin-extensions-ambx ?= "${AUTOREV}"
SRCREV:pn-enigma2-pliplugins ?= "${AUTOREV}"
SRCREV:pn-enigma2-plugin-extensions-epgimport ?= "${AUTOREV}"
SRCREV:pn-enigma2-plugin-skins-pli-hd ?= "${AUTOREV}"
SRCREV:pn-enigma2-plugin-skins-pli-scale-hd ?= "${AUTOREV}"
SRCREV:pn-enigma2-plugins ?= "${AUTOREV}"
SRCREV:pn-enigma2-skins ?= "${AUTOREV}"
SRCREV:pn-hotplug-e2-helper ?= "${AUTOREV}"
SRCREV:pn-libdreamdvd ?= "${AUTOREV}"
SRCREV:pn-usbtunerhelper ?= "${AUTOREV}"
SRCREV:pn-libtuxtxt ?= "${AUTOREV}"
SRCREV:pn-tuxtxt-enigma2 ?= "${AUTOREV}"
SRCREV:pn-hamsterdb ?= "${AUTOREV}"
SRCREV:pn-gstreamer1.0-plugin-subsink ?= "${AUTOREV}"
SRCREV:pn-gstreamer1.0-plugin-dvbmediasink ?= "${AUTOREV}"

HENKSAT_GITREV ?= "${AUTOREV}"
SRCREV:pn-enigma2-plugin-settings-henksat-19e ?= "${HENKSAT_GITREV}"
SRCREV:pn-enigma2-plugin-settings-henksat-23e ?= "${HENKSAT_GITREV}"
SRCREV:pn-enigma2-plugin-settings-henksat-13e-19e ?= "${HENKSAT_GITREV}"
SRCREV:pn-enigma2-plugin-settings-henksat-19e-23e ?= "${HENKSAT_GITREV}"
SRCREV:pn-enigma2-plugin-settings-henksat-19e-23e-28e ?= "${HENKSAT_GITREV}"
SRCREV:pn-enigma2-plugin-settings-henksat-13e-19e-23e-28e ?= "${HENKSAT_GITREV}"
SRCREV:pn-enigma2-plugin-settings-henksat-wavefrontier ?= "${HENKSAT_GITREV}"
SRCREV:pn-enigma2-plugin-settings-henksat-rotating ?= "${HENKSAT_GITREV}"
SRCREV:pn-enigma2-plugin-settings-henksat-13e-19e-23e-28e-4.8e-0.8w ?= "${HENKSAT_GITREV}"
SRCREV:pn-enigma2-plugin-settings-henksat-13e-19e-23e-28e-42e-7e ?= "${HENKSAT_GITREV}"
SRCREV:pn-enigma2-plugin-settings-henksat-ziggo ?= "${HENKSAT_GITREV}"

HANS_GITREV ?= "${AUTOREV}"
SRCREV:pn-enigma2-plugin-settings-hans-19e-23e ?= "${HANS_GITREV}"
SRCREV:pn-enigma2-plugin-settings-hans-19e-23e-28e ?= "${HANS_GITREV}"
SRCREV:pn-enigma2-plugin-settings-hans-9e-13e-19e-23e-28e ?= "${HANS_GITREV}"
SRCREV:pn-enigma2-plugin-settings-hans-9e-13e-19e-23e-28e-rotating ?= "${HANS_GITREV}"

# svn
SRCREV:pn-tuxbox-common ?= "${AUTOREV}"
SRCREV:pn-dvbsnoop ?= "${AUTOREV}"
SRCREV:pn-tuxterm ?= "${AUTOREV}"
SRCREV:pn-enigma2-plugin-extensions-tuxcom ?= "${AUTOREV}"
SRCREV:pn-enigma2-plugin-extensions-tuxterm ?= "${AUTOREV}"
SRCREV:pn-oscam-experimental ?= "7365"
SRCREV:pn-oscam-unstable = "6089"
SRCREV:pn-oscam-util-list-smargo = "7363"

RYTECSETTINGS_SRCDATE ?= "20120614"
SRCDATE_enigma2-plugin-settings-rytec-13e19e23e28e ?= "${RYTECSETTINGS_SRCDATE}"
SRCDATE_enigma2-plugin-settings-rytec-motor ?= "${RYTECSETTINGS_SRCDATE}"
```

## meta-oe/conf/distro/include/update-section.inc
```bitbake
SECTION:pn-libcroco = "x11/libs"
SECTION:pn-cifs-utils = "universe/otherosfs"
SECTION:pn-hostapd = "base"
SECTION:pn-shadow-securetty = "base/shell"
SECTION:pn-sg3-utils = "console/utils"
SECTION:pn-sysbench = "console/utils"
SECTION:pn-libatomic-ops = "libs"
SECTION:pn-mtools = "console/utils"
SECTION:pn-autofs = "console/utils"
SECTION:pn-cronie = "console/utils"
SECTION:pn-protobuf = "libs"
SECTION:pn-parted = "console/utils"
SECTION:pn-parted-locale  = "console/utils"
SECTION:pn-ca-certificates = "libs/network"
SECTION:pn-shadow-base = "console/utils"
SECTION:pn-shadow-locale = "console/utils"
SECTION:pn-shadow = "console/utils"
SECTION:pn-nmap-db = "console/utils"
SECTION:pn-nmap = "console/utils"
SECTION:pn-tcl = "libs"
SECTION:pn-libtcl8.6-0 = "libs"
SECTION:pn-miniupnpd = "network"
SECTION:pn-python3-pycairo = "devel/python"
```
