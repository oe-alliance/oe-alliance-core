## meta-brands/meta-dinobot/conf/machine/include/dinobot-ubi.inc
```bitbake
KERNEL_FILE = "uImage"
ROOTFS_FILE = "rootfs.bin"

IMAGE_FSTYPES += "ubi"
UBI_VOLNAME = "rootfs"
MKUBIFS_ARGS = "-F -m 2048 -e 126976 -c 3840"
UBINIZE_ARGS = "-m 2048 -p 128KiB"

IMAGE_CMD:ubifs:prepend = " \
	mkdir -p ${IMAGE_ROOTFS}/usr/lib; \
	if [ "${PACKAGE_LIST}" = "1" ]; then \
        cp ${IMAGE_MANIFEST} ${IMAGE_ROOTFS}/usr/lib/package.lst; \
    fi; \
    "

IMAGE_CMD:ubi:append = " \
    mkdir -p ${DEPLOY_DIR_IMAGE}/${MACHINE}/${IMAGEDIR}; \
    mv ${IMGDEPLOYDIR}/${IMAGE_NAME}${IMAGE_NAME_SUFFIX}.ubi ${DEPLOY_DIR_IMAGE}/${MACHINE}/${IMAGEDIR}/${ROOTFS_FILE}; \
    cp ${DEPLOY_DIR_IMAGE}/uImage ${DEPLOY_DIR_IMAGE}/${MACHINE}/${IMAGEDIR}/${KERNEL_FILE}; \
    echo "${IMAGEVERSION}" > ${DEPLOY_DIR_IMAGE}/${MACHINE}/${IMAGEDIR}/imageversion; \
    echo "rename this file to 'force' to force an update without confirmation" > ${DEPLOY_DIR_IMAGE}/${MACHINE}/${IMAGEDIR}/noforce; \
    cd ${DEPLOY_DIR_IMAGE}/${MACHINE}; \
    zip -r ../${IMAGE_NAME}_usb.zip *; \
    rm -f ${DEPLOY_DIR_IMAGE}/*.ubi; \
    rm -f ${DEPLOY_DIR_IMAGE}/*.ubifs; \
    rm -f ${DEPLOY_DIR_IMAGE}/*.manifest; \
    rm -f ${DEPLOY_DIR_IMAGE}/.ubifs; \
    rm -f ${DEPLOY_DIR_IMAGE}/.manifest; \
    cd ..; \
    rm -Rf ${DEPLOY_DIR_IMAGE}/${MACHINE}; \
    "

require conf/machine/include/dinobot-oem.inc
```

## meta-brands/meta-dinobot/conf/machine/u41.conf
```bitbake
#@TYPE: Machine
#@NAME: u41
#@DESCRIPTION: Machine configuration for the u41

EXTRA_OECONF:append:pn-enigma2 = " --with-lcddev=/dev/null --with-alphablendingacceleration=always"

SOC_FAMILY = "hisi3716mv410"

SDCARD = "no"
HAVE_GLES = ""

MACHINE_FEATURES += " hiaccel RCA blindscan-dvbs textlcd no-opengl"

KERNEL_MODULE_AUTOLOAD += "8192eu"

VER = "-nochip"

require conf/machine/include/dinobot-cortexa9.inc
require conf/machine/include/dinobot-ubi.inc
```

## meta-brands/meta-dinobot/conf/machine/u42.conf
```bitbake
#@TYPE: Machine
#@NAME: u42
#@DESCRIPTION: Machine configuration for the u42

EXTRA_OECONF_append_pn-enigma2 = "--with-lcddev=/dev/null --with-alphablendingacceleration=always"

SOC_FAMILY = "hisi3716mv410"

GCCVERSION = "8.%"

SDCARD = "no"
HAVE_GLES = ""
PACKAGECONFIG_GL_pn-qtbase = "no-opengl linuxfb"

MACHINE_FEATURES += " hiaccel RCA blindscan-dvbs"

KERNEL_MODULE_AUTOLOAD += "8192eu"

VER = "-nochip"

require conf/machine/include/dinobot-cortexa9.inc
require conf/machine/include/dinobot-ubi.inc
```

## meta-brands/meta-dinobot/conf/machine/u43.conf
```bitbake
#@TYPE: Machine
#@NAME: u43
#@DESCRIPTION: Machine configuration for the u43

EXTRA_OECONF:append:pn-enigma2 = " --with-lcddev=/dev/null --with-alphablendingacceleration=always"

SOC_FAMILY = "hisi3716mv410"

SDCARD = "no"
HAVE_GLES = ""

MACHINE_FEATURES += " hiaccel RCA dvb-c dvbc-only 7segment noopengl"

KERNEL_MODULE_AUTOLOAD += "8192eu"

VER = "-nochip"

require conf/machine/include/dinobot-cortexa9.inc
require conf/machine/include/dinobot-ubi.inc
```

## meta-brands/meta-dinobot/conf/machine/u45.conf
```bitbake
#@TYPE: Machine
#@NAME: u43
#@DESCRIPTION: Machine configuration for the u45

EXTRA_OECONF:append:pn-enigma2 = "--with-lcddev=/dev/null --with-alphablendingacceleration=always"

SOC_FAMILY = "hisi3716mv410"

SDCARD = "no"
HAVE_GLES = ""

MACHINE_FEATURES += " hiaccel RCA blindscan-dvbs 7segment noopengl"

KERNEL_MODULE_AUTOLOAD += "8192eu"

VER = "-nochip"

require conf/machine/include/dinobot-cortexa9.inc
require conf/machine/include/dinobot-ubi.inc
```

## meta-brands/meta-dinobot/conf/machine/u5.conf
```bitbake
#@TYPE: Machine
#@NAME: u5
#@DESCRIPTION: Machine configuration for the u5

EXTRA_OECONF:append:pn-enigma2 = " --with-lcddev=/dev/null --with-alphablendingacceleration=always"

SOC_FAMILY = "hisi3798mv200"

SDCARD = "yes"

MACHINE_FEATURES += " multitranscoding hiaccel RCA blindscan-dvbs kodi22 7segment skins1080"

KERNEL_MODULE_AUTOLOAD += "8192eu"

VER = "-chiper"

require conf/machine/include/dinobot-cortexa15.inc
require conf/machine/include/dinobot-emmc.inc
```

## meta-brands/meta-dinobot/conf/machine/u53.conf
```bitbake
#@TYPE: Machine
#@NAME: u5pvr
#@DESCRIPTION: Machine configuration for the u53

EXTRA_OECONF_append_pn-enigma2 = "--with-lcddev=/dev/null --with-alphablendingacceleration=always"

SOC_FAMILY = "hisi3798cv200"

SDCARD = "no"

MACHINE_FEATURES += " multitranscoding hiaccel 7segment blindscan-dvbs skins1080"

KERNEL_MODULE_AUTOLOAD += "88x2bu"

VER = "-chiper"

require conf/machine/include/dinobot-cortexa15.inc
require conf/machine/include/dinobot-emmc.inc
```

## meta-brands/meta-dinobot/conf/machine/u532.conf
```bitbake
#@TYPE: Machine
#@NAME: u532
#@DESCRIPTION: Machine configuration for the u532

EXTRA_OECONF_append_pn-enigma2 = "--with-lcddev=/dev/null --with-alphablendingacceleration=always"

SOC_FAMILY = "hisi3798cv200"

SDCARD = "no"

MACHINE_FEATURES += " multitranscoding hiaccel 7segment skins1080"

VER = "-chiper"

require conf/machine/include/dinobot-cortexa15.inc
require conf/machine/include/dinobot-emmc.inc
```

## meta-brands/meta-dinobot/conf/machine/u54.conf
```bitbake
#@TYPE: Machine
#@NAME: u54
#@DESCRIPTION: Machine configuration for the u54

EXTRA_OECONF:append:pn-enigma2 = " --with-lcddev=/dev/null --with-alphablendingacceleration=always"

SOC_FAMILY = "hisi3798mv200"

SDCARD = "no"

MACHINE_FEATURES += " multitranscoding hiaccel RCA blindscan-dvbs kodi21 7segment skins1080"

KERNEL_MODULE_AUTOLOAD += "8192eu"
KERNEL_MODULE_AUTOLOAD += "cfg80211"
KERNEL_MODULE_AUTOLOAD += "rtl8723bu"

VER = "-chiper"

require conf/machine/include/dinobot-cortexa15.inc
require conf/machine/include/dinobot-emmc.inc
```
