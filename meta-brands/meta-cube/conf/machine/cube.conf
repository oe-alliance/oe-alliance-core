## meta-brands/meta-cube/conf/machine/cube.conf
```bitbake
# magic value to avoid flashing an image which was intended to run on different hardware
CREATEIMAGE_MAGIC = "0x00109500"

include conf/machine/include/cube-oem.inc

BBMASK = "meta-vuplus/recipes-graphics/"
BBMASK .= "meta-vuplus/recipes-webkit/"
```

## meta-brands/meta-cube/conf/machine/include/cube-oem.inc
```bitbake
# We know about rtc
include conf/machine/include/build-extras.inc

BRAND_OEM = "cube"

MACHINE_NAME = "\
${@bb.utils.contains('MACHINEBUILD', 'dcube', 'R2' , '', d)}\
${@bb.utils.contains('MACHINEBUILD', 'ultima', 'Ultima' , '', d)}\
${@bb.utils.contains('MACHINEBUILD', 'mkcube', 'Cube' , '', d)}\
"

MACHINE_BRAND = "\
${@bb.utils.contains('MACHINEBUILD', 'dcube', 'D-Cube' , '', d)}\
${@bb.utils.contains('MACHINEBUILD', 'ultima', 'Stratos' , '', d)}\
${@bb.utils.contains('MACHINEBUILD', 'mkcube', 'MK-Digital' , '', d)}\
"

IMAGEDIR = "\
${@bb.utils.contains('MACHINEBUILD', 'dcube', 'flash-image-256' , '', d)}\
${@bb.utils.contains('MACHINEBUILD', 'ultima', 'flash-image-256' , '', d)}\
${@bb.utils.contains('MACHINEBUILD', 'mkcube', 'flash-image-256' , '', d)}\
"

MACHINE_ESSENTIAL_EXTRA_RDEPENDS = "\
    e2bmc-dvb-modules-${MACHINE} \
    "

DVBPROVIDER = "kernel"

MACHINE_EXTRA_RRECOMMENDS = " \
    gstreamer1.0-plugin-dvbmediasink \
    "

include conf/machine/include/autoload-filesystems.inc

DVBMEDIASINK_CONFIG = "--with-wma --with-wmv --with-pcm --with-dtsdownmix --with-eac3"

# image name, used for multi boot selection
MULTIBOOT_IMAGE_NAME ?= "${IMAGE_BASENAME}"

# a rootfs size of 192MB should be sufficient (can be overridden by an image)
ROOTFS_SIZE ?= "C000000"

UBI_VOLNAME = "rootfs"

# image name in the zipfile, can be overridden by an image
ZIPFILE_IMAGE_NAME ?= "firmware.img"

do_image_imgzip256[depends] = "createimage-${MACHINE}-native:do_populate_sysroot mtd-utils-native:do_populate_sysroot"
do_image_imgzip1024[depends] = "createimage-${MACHINE}-native:do_populate_sysroot mtd-utils-native:do_populate_sysroot"

IMAGE_CMD_imgzip256 = " \
    mkfs.ubifs -r ${IMAGE_ROOTFS} -o ${DEPLOY_DIR_IMAGE}/${IMAGE_NAME}.rootfs_256.ubifs -m 2048 -e 126976 -c 4096; \
    mkdir -p ${DEPLOY_DIR_IMAGE}/${IMAGEDIR}; \
    createimage_${MACHINE} 126976 ${MULTIBOOT_IMAGE_NAME} kernel ${DEPLOY_DIR_IMAGE}/zImage-${MACHINE}.bin 0 0 rootfs ${DEPLOY_DIR_IMAGE}/${IMAGE_NAME}.rootfs_256.ubifs ${ROOTFS_SIZE} 1 > ${DEPLOY_DIR_IMAGE}/${IMAGEDIR}/${ZIPFILE_IMAGE_NAME}; \
    cd ${DEPLOY_DIR_IMAGE}; \
    zip ${IMAGE_NAME}-256MB.zip ${IMAGEDIR}/*; \
    rm -Rf ${IMAGEDIR}; \
    "

IMAGE_CMD_imgzip1024 = " \
    mkfs.ubifs -r ${IMAGE_ROOTFS} -o ${DEPLOY_DIR_IMAGE}/${IMAGE_NAME}.rootfs_1024.ubifs -m 4096 -e 253952 -c 4096; \
    mkdir -p ${DEPLOY_DIR_IMAGE}/flash-image-1024; \
    createimage_${MACHINE} 253952 ${MULTIBOOT_IMAGE_NAME} kernel ${DEPLOY_DIR_IMAGE}/zImage-${MACHINE}.bin 0 0 rootfs ${DEPLOY_DIR_IMAGE}/${IMAGE_NAME}.rootfs_1024.ubifs ${ROOTFS_SIZE} 1 > ${DEPLOY_DIR_IMAGE}/flash-image-1024/${ZIPFILE_IMAGE_NAME}; \
    cd ${DEPLOY_DIR_IMAGE}; \
    zip ${IMAGE_NAME}-1024MB.zip flash-image-1024/*; \
    rm -Rf flash-image-1024; \
    "

IMAGE_DEVICE_TABLES = ""

PREFERRED_VERSION_wpa-supplicant = "0.5.8"
PREFERRED_VERSION_rtl8192cu = "3.3.0"
PREFERRED_VERSION_nfs-utils ?= "1.2.8"

PREFERRED_PROVIDER_virtual/kernel = "linux-cube"
PREFERRED_PROVIDER_virtual/egl = "opengl"

PREFERRED_VERSION_linux-cube = "2.6.34"
PREFERRED_VERSION_linux-libc-headers = "3.1"
OLDEST_KERNEL = "2.6.34"
GLIBCVERSION = "2.23"

GLIBC_EXTRA_OECONF = "--with-tls --with-__thread"

SOC_FAMILY = "pnx8471"
TARGET_ARCH = "arm"
TUNE_FEATURES = "cortexa9 vfp"
include conf/machine/include/tune-cortexa9.inc
require conf/machine/include/soc-family.inc
TUNE_CCARGS += "-mfpu=vfpv3-d16"

IMAGE_FSTYPES ?= "imgzip256"

MACHINE_FEATURES += "3dtv alsa hdmicec switchoff textlcd dvbapi5 usbhost wifiusblegacy legacykernel"

OEM_ARCH = "${MACHINEBUILD}"

# Add "MACHINEBUILD" override for recipes
MACHINEOVERRIDES =. "${@['', '${MACHINEBUILD}:']['${MACHINEBUILD}' != '']}"
```

## meta-brands/meta-dags/conf/layer.conf
```bitbake
# We have a conf and classes directory, append to BBPATH
BBPATH .= ":${LAYERDIR}"

# We have a recipes directory, add to BBFILES
BBFILES += "${LAYERDIR}/recipes-*/*.bb ${LAYERDIR}/recipes-*/*.bbappend \
            ${LAYERDIR}/recipes-*/*/*.bb ${LAYERDIR}/recipes-*/*/*.bbappend"

BBFILE_COLLECTIONS += "dags-layer"
BBFILE_PATTERN_dags-layer := "^${LAYERDIR}/"
BBFILE_PRIORITY_dags-layer = "7"

OEA-META-DAGS-BASE := '${@os.path.normpath("${LAYERDIR}/../")}'
```

## meta-brands/meta-dags/conf/machine/dags1.conf
```bitbake
MACHINE_ESSENTIAL_EXTRA_RDEPENDS = " \
    dags-dvb-modules-7335 \
	"

include conf/machine/include/dags-oem.inc

PREFERRED_VERSION_linux-dags = "3.9.7"
PREFERRED_VERSION_linux-libc-headers = "3.9.7"

MACHINE_KERNEL_PR = "r2"

CHIPSET = "bcm7335"
```

## meta-brands/meta-dags/conf/machine/dags73625.conf
```bitbake
include conf/machine/include/dags-mips.inc

PREFERRED_VERSION_linux-dags = "4.2.1"
PREFERRED_VERSION_linux-libc-headers = "4.2.1"

SOC_FAMILY = "bcm73625"

FLASHSIZE = "256"

MACHINE_FEATURES += " omb wifiusbmodule feature1 feature2 blindscan-tbs"
```

## meta-brands/meta-dags/conf/machine/dagsmv200.conf
```bitbake
#@TYPE: Machine
#@NAME: dagsmv200
#@DESCRIPTION: Machine configuration for the dagsmv200

EXTRA_OECONF:append:pn-enigma2 = " --with-lcddev=/dev/null --with-alphablendingacceleration=always --with-blitaccelerationthreshold=250  --with-fillaccelerationthreshold=190000 --with-subttxtabnormalptsdiffs=3600000"

MACHINE_FEATURES += "blindscan-dvbs dvb-c hisi alsa mali no-subssupport HDMI AV_JACK multitranscoding fastboot emmc mmc 7segment hbbtv-browser-webkit hisichromium kodi20"

SOC_FAMILY = "hisi3798mv200"

require conf/machine/include/dags-hisi.inc
```

## meta-brands/meta-dags/conf/machine/include/dags-arm.inc
```bitbake
include conf/machine/include/dags-oem.inc

PACKAGECONFIG_GL:pn-qtbase = "gles2 eglfs linuxfb"
PACKAGECONFIG_FB:pn-qtbase = " "

KERNEL_FILE = "oe_kernel.bin"
ROOTFS_FILE = "rootfs.tar.bz2"
MTD_BLACK  = "mmcblk0"

TARGET_ARCH = "arm"
DEFAULTTUNE = "cortexa15hf-neon-vfpv4"
IMAGE_FSTYPES =+ "tar.bz2"

require conf/machine/include/arm/armv7a/tune-cortexa15.inc

IMAGE_CMD:tar:prepend = "\
	mkdir -p ${IMAGE_ROOTFS}/usr/lib; \
	if [ "${PACKAGE_LIST}" = "1" ]; then \
        cp ${IMAGE_MANIFEST} ${IMAGE_ROOTFS}/usr/lib/package.lst; \
    fi; \
    mkdir -p ${DEPLOY_DIR_IMAGE}/${IMAGEDIR}; \
    ${@bb.utils.contains("MACHINE_FEATURES", "bootsplash", "cp ${DEPLOY_DIR_IMAGE}/${BOOTLOGO_FILENAME} ${DEPLOY_DIR_IMAGE}/${IMAGEDIR}/${BOOTLOGO_FILENAME};" , "", d)} \
    cp ${DEPLOY_DIR_IMAGE}/${MACHINEBUILD}_initrd_run.bin ${DEPLOY_DIR_IMAGE}/${IMAGEDIR}/initrd_run.bin; \
    cp ${DEPLOY_DIR_IMAGE}/zImage ${DEPLOY_DIR_IMAGE}/${IMAGEDIR}/${KERNEL_FILE}; \
    echo ${DISTRO_NAME}-${DISTRO_VERSION}.${BUILD_VERSION} > ${DEPLOY_DIR_IMAGE}/${IMAGEDIR}/imageversion; \
    cd ${IMAGE_ROOTFS}; \
    tar -cvf ${DEPLOY_DIR_IMAGE}/rootfs.tar -C ${IMAGE_ROOTFS} .; \
    mv ${DEPLOY_DIR_IMAGE}/rootfs.tar ${DEPLOY_DIR_IMAGE}/${IMAGEDIR}/rootfs.tar; \
    bzip2 ${DEPLOY_DIR_IMAGE}/${IMAGEDIR}/rootfs.tar; \
    cd ${DEPLOY_DIR_IMAGE}; \
    zip ${IMAGE_NAME}_usb.zip ${IMAGEDIR}/*; \
    rm -f ${DEPLOY_DIR_IMAGE}/*.rootfs.tar.bz2; \
    rm -f ${DEPLOY_DIR_IMAGE}/.tar.bz2; \
    rm -f ${DEPLOY_DIR_IMAGE}/*.manifest; \
    rm -f ${DEPLOY_DIR_IMAGE}/.manifest; \
    rm -Rf update; \
"

EXTRA_IMAGEDEPENDS = "\
    dags-initrd-cfe-${MACHINEBUILD}"

PREFERRED_PROVIDER_virtual/egl = "v3d-libgles-${MACHINE}" 
PREFERRED_PROVIDER_virtual/libgles2 = "v3d-libgles-${MACHINE}"
```

## meta-brands/meta-dags/conf/machine/include/dags-hisi.inc
```bitbake
include conf/machine/include/dags-oem.inc

DISTRO_FEATURES:remove = "x11 wayland"

PACKAGECONFIG_GL:pn-qtbase = " "
PACKAGECONFIG:append:pn-qtbase = " gles2 linuxfb"
KERNEL_FILE = "kernel.bin"
ROOTFS_FILE = "rootfs.tar.bz2"
APPLOADER_FILE = "apploader.bin"
MTD_BLACK  = "mmcblk0"

MTD_KERNEL = "mmcblk0p27"
MTD_ROOTFS = "mmcblk0p30"

MACHINE_ESSENTIAL_EXTRA_RDEPENDS += " \
	dags-reader-${SOC_FAMILY} \
	dags-libreader-${SOC_FAMILY} \
	dags-loadmodules-${SOC_FAMILY} \
	e2fsprogs-resize2fs \
	dags-libs-${SOC_FAMILY} \
	enigma2-plugin-drivers-network-usb-rtl8192eu \
	dags-bootoptions-${MACHINEBUILD} \
	dags-partitions-${MACHINEBUILD} \
	dags-buildimage \
	deepsleep-${SOC_FAMILY} \
	dags-blindscan-utils-${SOC_FAMILY} \
"

IMAGE_CLASSES += "dags-emmc_image"
IMAGE_FSTYPES += "dagsemmc"
IMAGE_ROOTFS_SIZE ?= "524288"

TARGET_ARCH = "arm"
DEFAULTTUNE = "cortexa15hf-neon-vfpv4"

PREFERRED_VERSION_linux-dags = "4.4.35"

PREFERRED_PROVIDER_virtual/kernel = "linux-dags"

PREFERRED_PROVIDER_virtual/egl = "dags-opengl-${SOC_FAMILY}"
PREFERRED_PROVIDER_virtual/libgles1 = "dags-opengl-${SOC_FAMILY}"
PREFERRED_PROVIDER_virtual/libgles2 = "dags-opengl-${SOC_FAMILY}"
PREFERRED_PROVIDER_virtual/libgbm ?= "dags-opengl-${SOC_FAMILY}"
PREFERRED_PROVIDER_virtual/libgl ?= "mesa"
PREFERRED_PROVIDER_virtual/mesa ?= "mesa"
PREFERRED_RPROVIDER_aio-grab = "dags-grab-${SOC_FAMILY}"

PREFERRED_PROVIDER_virtual/blindscan-dvbs = "dags-blindscan-utils-${SOC_FAMILY}"

require conf/machine/include/arm/armv7a/tune-cortexa15.inc

IMAGE_CMD:tar:prepend = "\
	mkdir -p ${IMAGE_ROOTFS}/usr/lib; \
	if [ "${PACKAGE_LIST}" = "1" ]; then \
        cp ${IMAGE_MANIFEST} ${IMAGE_ROOTFS}/usr/lib/package.lst; \
    fi; \
    "

IMAGE_CMD:dagsemmc:append = "\
    mkdir -p ${DEPLOY_DIR_IMAGE}/${IMAGEDIR}; \
    mkdir -p ${DEPLOY_DIR_IMAGE}/release/${IMAGEDIR}; \
    cp ${DEPLOY_DIR_IMAGE}/uImage ${DEPLOY_DIR_IMAGE}/${IMAGEDIR}/${KERNEL_FILE}; \
    cp ${DEPLOY_DIR_IMAGE}/${MACHINEBUILD}-${APPLOADER_FILE} ${DEPLOY_DIR_IMAGE}/${IMAGEDIR}/${APPLOADER_FILE}; \
    mv ${IMGDEPLOYDIR}/${IMAGE_NAME}_subrootfs.ext4 ${DEPLOY_DIR_IMAGE}/${IMAGEDIR}/rootfs.ext4; \
    echo ${IMAGE_VER_STRING} > ${DEPLOY_DIR_IMAGE}/${IMAGEDIR}/imageversion; \
    cd ${DEPLOY_DIR_IMAGE}; \
    zip ${IMAGE_NAME}_restore_mmc.zip ${IMAGEDIR}/*; \
    cd ${IMAGE_ROOTFS}; \
    tar -cvf ${DEPLOY_DIR_IMAGE}/rootfs.tar -C ${IMAGE_ROOTFS} .; \
    mv ${DEPLOY_DIR_IMAGE}/rootfs.tar ${DEPLOY_DIR_IMAGE}/${IMAGEDIR}/rootfs.tar; \
    cd ${DEPLOY_DIR_IMAGE}; \
    bzip2 ${DEPLOY_DIR_IMAGE}/${IMAGEDIR}/rootfs.tar; \
    zip -j ${IMAGE_NAME}_mmc.zip ${DEPLOY_DIR_IMAGE}/${IMAGEDIR}/imageversion ${DEPLOY_DIR_IMAGE}/${IMAGEDIR}/kernel.bin ${DEPLOY_DIR_IMAGE}/${IMAGEDIR}/rootfs.tar.bz2; \
    rm -f ${DEPLOY_DIR_IMAGE}/*.manifest; \
    rm -Rf ${DEPLOY_DIR_IMAGE}/rootfs; \
    rm -f ${DEPLOY_DIR_IMAGE}/.ext4; \
    rm -f ${DEPLOY_DIR_IMAGE}/.manifest; \
    rm -f -f ${DEPLOY_DIR_IMAGE}/*.json; \
    rm -Rf ${IMAGEDIR}; \
    rm -Rf release; \
    "

BBMASK = "meta-vuplus/recipes-graphics/"
BBMASK += "meta-vuplus/recipes-webkit/"
```

## meta-brands/meta-dags/conf/machine/include/dags-mips.inc
```bitbake
include conf/machine/include/dags-oem.inc

KERNEL_FILE = "oe_kernel.bin"
ROOTFS_FILE = "oe_rootfs.bin"

TARGET_ARCH = "mipsel"
DEFAULTTUNE = "mips32el"

KERNEL_IMAGETYPE = "vmlinux"
KERNEL_OUTPUT = "${KERNEL_IMAGETYPE}"
KERNEL_CONSOLE = "ttyS0,115200n8"

IMAGE_FSTYPES ?= "ubi"

UBI_VOLNAME = "rootfs"
MKUBIFS_ARGS = "-m 2048 -e 126976 -c 4096 -F"
UBINIZE_ARGS = "-m 2048 -p 128KiB"

IMAGE_CMD_ubi_prepend = " \
    rm -rf ${IMAGE_ROOTFS}/boot/*; \
    rm -rf ${IMAGE_ROOTFS}/tmp/*; \
    "

IMAGE_CMD_ubi_append = "\
    mkdir -p ${DEPLOY_DIR_IMAGE}/${IMAGEDIR}; \
    ${@bb.utils.contains("MACHINE_FEATURES", "bootsplash", "cp ${DEPLOY_DIR_IMAGE}/${BOOTLOGO_FILENAME} ${DEPLOY_DIR_IMAGE}/${IMAGEDIR}/${BOOTLOGO_FILENAME};" , "", d)} \
    ${@bb.utils.contains("MACHINE", "dags7356", "cp ${DEPLOY_DIR_IMAGE}/${SPLASH1_BMP} ${DEPLOY_DIR_IMAGE}/${IMAGEDIR}/splash1.bmp;" , "", d)} \
    ${@bb.utils.contains("MACHINE", "dags7356", "cp ${DEPLOY_DIR_IMAGE}/splash2.bmp ${DEPLOY_DIR_IMAGE}/${IMAGEDIR}/splash2.bmp;" , "", d)} \
    ${@bb.utils.contains("MACHINE", "dags7356", "cp ${DEPLOY_DIR_IMAGE}/splash3.bmp ${DEPLOY_DIR_IMAGE}/${IMAGEDIR}/splash3.bmp;" , "", d)} \
    ${@bb.utils.contains("MACHINE", "dags7362", "cp ${DEPLOY_DIR_IMAGE}/${SPLASH1_BMP} ${DEPLOY_DIR_IMAGE}/${IMAGEDIR}/splash1.bmp;" , "", d)} \
    ${@bb.utils.contains("MACHINE", "dags7362", "cp ${DEPLOY_DIR_IMAGE}/splash2.bmp ${DEPLOY_DIR_IMAGE}/${IMAGEDIR}/splash2.bmp;" , "", d)} \
    ${@bb.utils.contains("MACHINE", "dags7362", "cp ${DEPLOY_DIR_IMAGE}/splash3.bmp ${DEPLOY_DIR_IMAGE}/${IMAGEDIR}/splash3.bmp;" , "", d)} \
    ${@bb.utils.contains("MACHINE", "dags73625", "cp ${DEPLOY_DIR_IMAGE}/${SPLASH1_BMP} ${DEPLOY_DIR_IMAGE}/${IMAGEDIR}/splash1.bmp;" , "", d)} \
    ${@bb.utils.contains("MACHINE", "dags73625", "cp ${DEPLOY_DIR_IMAGE}/splash2.bmp ${DEPLOY_DIR_IMAGE}/${IMAGEDIR}/splash2.bmp;" , "", d)} \
    ${@bb.utils.contains("MACHINE", "dags73625", "cp ${DEPLOY_DIR_IMAGE}/splash3.bmp ${DEPLOY_DIR_IMAGE}/${IMAGEDIR}/splash3.bmp;" , "", d)} \
    mv ${IMGDEPLOYDIR}/${IMAGE_NAME}.rootfs.ubi ${DEPLOY_DIR_IMAGE}/${IMAGEDIR}/${ROOTFS_FILE}; \
    gzip -f -9c ${DEPLOY_DIR_IMAGE}/vmlinux-${MACHINE}.bin > ${DEPLOY_DIR_IMAGE}/${IMAGEDIR}/${KERNEL_FILE}; \
    echo ${IMAGE_VER_STRING} > ${DEPLOY_DIR_IMAGE}/${IMAGEDIR}/imageversion; \
    cd ${DEPLOY_DIR_IMAGE}; \
    zip ${IMAGE_NAME}_usb.zip ${IMAGEDIR}/*; \
    rm -f ${DEPLOY_DIR_IMAGE}/*.ubi; \
    rm -f ${DEPLOY_DIR_IMAGE}/*.ubifs; \
    rm -f ${DEPLOY_DIR_IMAGE}/*.manifest; \
    rm -f ${DEPLOY_DIR_IMAGE}/.ubifs; \
    rm -f ${DEPLOY_DIR_IMAGE}/.manifest; \
    rm -Rf update; \
    "

require conf/machine/include/tune-mips32.inc
```
