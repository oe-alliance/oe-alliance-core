## meta-brands/meta-xcore/conf/machine/include/xcore-arm.inc
```bitbake
TARGET_ARCH = "arm"
DEFAULTTUNE = "cortexa15hf-neon-vfpv4"
require conf/machine/include/tune-cortexa15.inc

KERNEL_IMAGETYPE = "zImage"
KERNEL_CONSOLE = "ttyS0,115200n8"

PREFERRED_VERSION_directfb = "1.7.7"

GLIBC_EXTRA_OECONF = "--with-tls --with-__thread"

require conf/machine/include/xcore-oem.inc
```

## meta-brands/meta-xcore/conf/machine/include/xcore-mipsel.inc
```bitbake
TARGET_ARCH = "mipsel"
DEFAULTTUNE = "mips32el"
require conf/machine/include/tune-mips32.inc

KERNEL_IMAGETYPE = "vmlinux.gz"
KERNEL_CONSOLE = "ttyS0,115200n8"

require conf/machine/include/xcore-oem.inc
```

## meta-brands/meta-xcore/conf/machine/include/xcore-oem.inc
```bitbake
# We know about rtc
include conf/machine/include/build-extras.inc

BRAND_OEM = "xcore"

MACHINE_NAME = "\
${@bb.utils.contains('MACHINEBUILD', 'spycat', 'SpyCat' , '', d)}\
${@bb.utils.contains('MACHINEBUILD', 'spycatmini', 'SpyCat mini' , '', d)}\
${@bb.utils.contains('MACHINEBUILD', 'spycatminiplus', 'SpyCat mini +' , '', d)}\
${@bb.utils.contains('MACHINEBUILD', 'spycat4k', 'SpyCat 4K' , '', d)}\
${@bb.utils.contains('MACHINEBUILD', 'spycat4kcombo', 'SpyCat 4K Combo' , '', d)}\
${@bb.utils.contains('MACHINEBUILD', 'spycat4kmini', 'SpyCat 4K mini' , '', d)}\
${@bb.utils.contains('MACHINEBUILD', 'vp7358ci', '7358ci' , '', d)}\
${@bb.utils.contains('MACHINEBUILD', 'bcm7358', '7358' , '', d)}\
${@bb.utils.contains('MACHINEBUILD', 'osmini', 'OS mini' , '', d)}\
${@bb.utils.contains('MACHINEBUILD', 'osminiplus', 'OS mini +' , '', d)}\
${@bb.utils.contains('MACHINEBUILD', 'osmega', 'OS mega' , '', d)}\
"

MACHINE_BRAND = "\
${@bb.utils.contains('MACHINEBUILD', 'spycat', 'SPYCAT' , '', d)}\
${@bb.utils.contains('MACHINEBUILD', 'spycatmini', 'SPYCAT' , '', d)}\
${@bb.utils.contains('MACHINEBUILD', 'spycatminiplus', 'SPYCAT' , '', d)}\
${@bb.utils.contains('MACHINEBUILD', 'spycat4k', 'SPYCAT' , '', d)}\
${@bb.utils.contains('MACHINEBUILD', 'spycat4kcombo', 'SPYCAT' , '', d)}\
${@bb.utils.contains('MACHINEBUILD', 'spycat4kmini', 'SPYCAT' , '', d)}\
${@bb.utils.contains('MACHINEBUILD', 'vp7358ci', 'Sample2' , '', d)}\
${@bb.utils.contains('MACHINEBUILD', 'bcm7358', 'Sample1' , '', d)}\
${@bb.utils.contains('MACHINEBUILD', 'osmini', 'Edision' , '', d)}\
${@bb.utils.contains('MACHINEBUILD', 'osminiplus', 'Edision' , '', d)}\
${@bb.utils.contains('MACHINEBUILD', 'osmega', 'Edision' , '', d)}\
"

IMAGEDIR ?= "\
${@bb.utils.contains('MACHINEBUILD', 'spycat', 'spycat' , '', d)}\
${@bb.utils.contains('MACHINEBUILD', 'spycatmini', 'spycatmini' , '', d)}\
${@bb.utils.contains('MACHINEBUILD', 'spycatminiplus', 'spycatminiplus' , '', d)}\
${@bb.utils.contains('MACHINEBUILD', 'spycat4k', 'spycat4k' , '', d)}\
${@bb.utils.contains('MACHINEBUILD', 'spycat4kcombo', 'spycat4k' , '', d)}\
${@bb.utils.contains('MACHINEBUILD', 'spycat4kmini', 'spycat4kmini' , '', d)}\
${@bb.utils.contains('MACHINEBUILD', 'vp7358ci', 'vp7358ci' , '', d)}\
${@bb.utils.contains('MACHINEBUILD', 'bcm7358', 'bcm7358' , '', d)}\
${@bb.utils.contains('MACHINEBUILD', 'osmini', 'osmini' , '', d)}\
${@bb.utils.contains('MACHINEBUILD', 'osminiplus', 'osminiplus' , '', d)}\
${@bb.utils.contains('MACHINEBUILD', 'osmega', 'osmega' , '', d)}\
"

MTD_KERNEL = "\
${@bb.utils.contains('MACHINEBUILD', 'spycat', 'mtd0' , '', d)}\
${@bb.utils.contains('MACHINEBUILD', 'spycatmini', 'mtd0' , '', d)}\
${@bb.utils.contains('MACHINEBUILD', 'spycatminiplus', 'mtd0' , '', d)}\
${@bb.utils.contains('MACHINEBUILD', 'spycat4k', 'mmcblk1p2' , '', d)}\
${@bb.utils.contains('MACHINEBUILD', 'spycat4kcombo', 'mmcblk1p2' , '', d)}\
${@bb.utils.contains('MACHINEBUILD', 'spycat4kmini', 'mtd0' , '', d)}\
${@bb.utils.contains('MACHINEBUILD', 'vp7358ci', 'mtd2' , '', d)}\
${@bb.utils.contains('MACHINEBUILD', 'bcm7358', 'mtd2' , '', d)}\
${@bb.utils.contains('MACHINEBUILD', 'osmini', 'mtd0' , '', d)}\
${@bb.utils.contains('MACHINEBUILD', 'osminiplus', 'mtd0' , '', d)}\
${@bb.utils.contains('MACHINEBUILD', 'osmega', 'mtd0' , '', d)}\
"

MTD_ROOTFS = "\
${@bb.utils.contains('MACHINEBUILD', 'spycat', 'mtd2' , '', d)}\
${@bb.utils.contains('MACHINEBUILD', 'spycatmini', 'mtd2' , '', d)}\
${@bb.utils.contains('MACHINEBUILD', 'spycatminiplus', 'mtd2' , '', d)}\
${@bb.utils.contains('MACHINEBUILD', 'spycat4k', 'mmcblk1p3' , '', d)}\
${@bb.utils.contains('MACHINEBUILD', 'spycat4kcombo', 'mmcblk1p3' , '', d)}\
${@bb.utils.contains('MACHINEBUILD', 'spycat4kmini', 'mtd2' , '', d)}\
${@bb.utils.contains('MACHINEBUILD', 'vp7358ci', 'mtd3' , '', d)}\
${@bb.utils.contains('MACHINEBUILD', 'bcm7358', 'mtd3' , '', d)}\
${@bb.utils.contains('MACHINEBUILD', 'osmini', 'mtd2' , '', d)}\
${@bb.utils.contains('MACHINEBUILD', 'osminiplus', 'mtd2' , '', d)}\
${@bb.utils.contains('MACHINEBUILD', 'osmega', 'mtd2' , '', d)}\
"

MACHINE_DRIVER = "\
${@bb.utils.contains('MACHINEBUILD', 'spycat', 'spycat' , '', d)}\
${@bb.utils.contains('MACHINEBUILD', 'spycatmini', 'spycatmini' , '', d)}\
${@bb.utils.contains('MACHINEBUILD', 'spycatminiplus', 'spycatminiplus' , '', d)}\
${@bb.utils.contains('MACHINEBUILD', 'spycat4k', 'spycat4k' , '', d)}\
${@bb.utils.contains('MACHINEBUILD', 'spycat4kcombo', 'spycat4kcombo' , '', d)}\
${@bb.utils.contains('MACHINEBUILD', 'spycat4kmini', 'spycat4kmini' , '', d)}\
${@bb.utils.contains('MACHINEBUILD', 'vp7358ci', 'vp7358ci' , '', d)}\
${@bb.utils.contains('MACHINEBUILD', 'bcm7358', 'bcm7358' , '', d)}\
${@bb.utils.contains('MACHINEBUILD', 'osmini', 'osmini' , '', d)}\
${@bb.utils.contains('MACHINEBUILD', 'osminiplus', 'osminiplus' , '', d)}\
${@bb.utils.contains('MACHINEBUILD', 'osmega', 'osmega' , '', d)}\
"

KERNEL_FILE = "\
${@bb.utils.contains('MACHINEBUILD', 'spycat', 'kernel.bin' , '', d)}\
${@bb.utils.contains('MACHINEBUILD', 'spycatmini', 'kernel.bin' , '', d)}\
${@bb.utils.contains('MACHINEBUILD', 'spycatminiplus', 'kernel.bin' , '', d)}\
${@bb.utils.contains('MACHINEBUILD', 'spycat4k', 'kernel.bin' , '', d)}\
${@bb.utils.contains('MACHINEBUILD', 'spycat4kcombo', 'kernel.bin' , '', d)}\
${@bb.utils.contains('MACHINEBUILD', 'spycat4kmini', 'kernel.bin' , '', d)}\
${@bb.utils.contains('MACHINEBUILD', 'vp7358ci', 'kernel.bin' , '', d)}\
${@bb.utils.contains('MACHINEBUILD', 'bcm7358', 'kernel.bin' , '', d)}\
${@bb.utils.contains('MACHINEBUILD', 'osmini', 'kernel.bin' , '', d)}\
${@bb.utils.contains('MACHINEBUILD', 'osminiplus', 'kernel.bin' , '', d)}\
${@bb.utils.contains('MACHINEBUILD', 'osmega', 'kernel.bin' , '', d)}\
"

ROOTFS_FILE  = "\
${@bb.utils.contains('MACHINEBUILD', 'spycat', 'rootfs.bin' , '', d)}\
${@bb.utils.contains('MACHINEBUILD', 'spycatmini', 'rootfs.bin' , '', d)}\
${@bb.utils.contains('MACHINEBUILD', 'spycatminiplus', 'rootfs.bin' , '', d)}\
${@bb.utils.contains('MACHINEBUILD', 'spycat4k', 'rootfs.tar.bz2' , '', d)}\
${@bb.utils.contains('MACHINEBUILD', 'spycat4kcombo', 'rootfs.tar.bz2' , '', d)}\
${@bb.utils.contains('MACHINEBUILD', 'spycat4kmini', 'rootfs.bin' , '', d)}\
${@bb.utils.contains('MACHINEBUILD', 'vp7358ci', 'rootfs.bin' , '', d)}\
${@bb.utils.contains('MACHINEBUILD', 'bcm7358', 'rootfs.bin' , '', d)}\
${@bb.utils.contains('MACHINEBUILD', 'osmini', 'rootfs.bin' , '', d)}\
${@bb.utils.contains('MACHINEBUILD', 'osminiplus', 'rootfs.bin' , '', d)}\
${@bb.utils.contains('MACHINEBUILD', 'osmega', 'rootfs.bin' , '', d)}\
"

MACHINE_ESSENTIAL_EXTRA_RDEPENDS = "\
    xcore-dvb-modules-${MACHINE_DRIVER} \
    "

DVBPROVIDER = "kernel"
DVBSKYPROVIDER = "kernel"

MACHINE_ESSENTIAL_EXTRA_RRECOMMENDS += " \
    kernel-module-cdfs \
    ${@bb.utils.contains('MACHINE_FEATURES', 'v3d', 'xcore-v3ddriver-${MACHINE}', '',d)} \
    ${@bb.utils.contains('MACHINE_FEATURES', 'swap', 'xcore-swapcreate', '',d)} \
    "

MACHINE_EXTRA_RRECOMMENDS += " \
    gstreamer1.0-plugin-dvbmediasink \
    gstreamer1.0-libav \
    "

include conf/machine/include/autoload-filesystems.inc

DVBMEDIASINK_CONFIG = "--with-wma --with-wmv --with-pcm --with-dts --with-eac3  \
    ${@bb.utils.contains('MACHINEBUILD', 'osminiplus', '--with-h265 --with-vb6 --with-vb8 --with-spark' , '', d)} \
    ${@bb.utils.contains('MACHINEBUILD', 'spycatminiplus', '--with-h265 --with-vb6 --with-vb8 --with-spark' , '', d)} \
    ${@bb.utils.contains('MACHINEBUILD', 'osmega', '--with-h265 --with-vb6 --with-vb8 --with-spark' , '', d)} \
    ${@bb.utils.contains('MACHINE', 'xc7439', '--with-h265 --with-vb6 --with-vb8 --with-vb9 --with-spark' , '', d)} \
"

PREFERRED_PROVIDER_virtual+blindscan-dvbs = "xcore-blindscan-utils"
PREFERRED_PROVIDER_virtual+blindscan-dvbc = "xcore-blindscan-utils"

PREFERRED_PROVIDER_virtual/kernel = "linux-xcore"
PREFERRED_PROVIDER_virtual/egl = "xcore-v3ddriver-${MACHINE}" 
PREFERRED_PROVIDER_virtual/libgles2 = "xcore-v3ddriver-${MACHINE}"
PREFERRED_PROVIDER_virtual/kodi = "stb-kodi-${MACHINE}"

MACHINE_FEATURES += "alsa 3dtv switchoff hdmicec bootsplash omb boxmodel"

BOOTLOGO_FILENAME = "splash.bin"

OEM_ARCH = "${MACHINEBUILD}"

# Add "MACHINEBUILD" override for recipes
MACHINEOVERRIDES =. "${@['', '${MACHINEBUILD}:']['${MACHINEBUILD}' != '']}"
```

## meta-brands/meta-xcore/conf/machine/xc7346.conf
```bitbake
#@TYPE: Machine
#@NAME: XCORE XC7346
#@DESCRIPTION: Machine configuration for the XCORE XC7346

SOC_FAMILY = "bcm73565"
require conf/machine/include/soc-family.inc

require conf/machine/include/xcore-mipsel.inc

MACHINE_FEATURES += "videoenhancement inibt blindscan-dvbs blindscan-dvbc directfb textlcd dvb-c skins1080 blindscan-tbs linuxwifi linux4extra ci v3d kodi19 feature1 feature2"

### 8723BS wireless/bluetooth ###
KERNEL_MODULE_AUTOLOAD += "r8723bs" 
KERNEL_MODULE_AUTOLOAD += "hci_uart" 

MACHINE_ESSENTIAL_EXTRA_RRECOMMENDS += " \
    kernel-module-hci-uart \
    "

MACHINE_EXTRA_RRECOMMENDS += " \
    firmware-rtl8723b \
    "

PREFERRED_VERSION_linux-xcore = "4.11"

IMAGE_FSTYPES ?= "ubi"

UBI_VOLNAME = "rootfs"
MKUBIFS_ARGS = "-m 2048 -e 126976 -c 4096 -F"
UBINIZE_ARGS = "-m 2048 -p 128KiB"

IMAGE_CMD_ubi_prepend = " \
    rm -rf ${IMAGE_ROOTFS}/boot/*; \
    rm -rf ${IMAGE_ROOTFS}/tmp/*; \
    "

IMAGE_CMD_ubi_append = "\
    mkdir -p ${DEPLOY_DIR_IMAGE}/${IMAGEDIR}; \
    cp ${DEPLOY_DIR_IMAGE}/splash.bin ${DEPLOY_DIR_IMAGE}/${IMAGEDIR}/splash.bin; \
    mv ${IMGDEPLOYDIR}/${IMAGE_NAME}.rootfs.ubi ${DEPLOY_DIR_IMAGE}/${IMAGEDIR}/${ROOTFS_FILE}; \
    cp ${DEPLOY_DIR_IMAGE}/${KERNEL_IMAGETYPE}-${MACHINE}.bin ${DEPLOY_DIR_IMAGE}/${IMAGEDIR}/${KERNEL_FILE}; \
    echo ${IMAGE_VER_STRING} > ${DEPLOY_DIR_IMAGE}/${IMAGEDIR}/imageversion; \
    echo "rename this file to 'force' to force an update without confirmation" > ${DEPLOY_DIR_IMAGE}/${IMAGEDIR}/noforce; \
    cd ${DEPLOY_DIR_IMAGE}; \
    zip ${IMAGE_NAME}_usb.zip ${IMAGEDIR}/*; \
    rm -f ${DEPLOY_DIR_IMAGE}/*.ubi; \
    rm -f ${DEPLOY_DIR_IMAGE}/*.ubifs; \
    rm -f ${DEPLOY_DIR_IMAGE}/*.manifest; \
    rm -f ${DEPLOY_DIR_IMAGE}/.ubifs; \
    rm -f ${DEPLOY_DIR_IMAGE}/.manifest; \
    rm -Rf ${IMAGEDIR}; \
    "
```

## meta-brands/meta-xcore/conf/machine/xc7358ci.conf
```bitbake
#@TYPE: Machine
#@NAME: XCORE 7358CI
#@DESCRIPTION: Machine configuration for the XCORE 7358CI

SOC_FAMILY = "bcm7358"
require conf/machine/include/soc-family.inc

PREFERRED_VERSION_linux-xcore = "4.0.2"
PREFERRED_VERSION_linux-libc-headers = "4.0"

require conf/machine/include/xcore-mipsel.inc

MACHINE_FEATURES += "ci textlcd videoenhancement blindscan-dvbs singlecore feature1 feature2 7segment"

IMAGE_FSTYPES ?= "ubi"

UBI_VOLNAME = "rootfs"
MKUBIFS_ARGS = "-m 2048 -e 126976 -c 4096"
UBINIZE_ARGS = "-m 2048 -p 128KiB"

IMAGE_CMD_ubi_prepend = " \
    rm -rf ${IMAGE_ROOTFS}/boot/*; \
    rm -rf ${IMAGE_ROOTFS}/tmp/*; \
    "

IMAGE_CMD_ubi_append = "\
    mkdir -p ${DEPLOY_DIR_IMAGE}/${IMAGEDIR}; \
    cp ${DEPLOY_DIR_IMAGE}/splash.bin ${DEPLOY_DIR_IMAGE}/${IMAGEDIR}/splash.bin; \
    mv ${IMGDEPLOYDIR}/${IMAGE_NAME}.rootfs.ubi ${DEPLOY_DIR_IMAGE}/${IMAGEDIR}/${ROOTFS_FILE}; \
    cp ${DEPLOY_DIR_IMAGE}/${KERNEL_IMAGETYPE}-${MACHINE}.bin ${DEPLOY_DIR_IMAGE}/${IMAGEDIR}/${KERNEL_FILE}; \
    FILESIZE=$(stat -c%s "${DEPLOY_DIR_IMAGE}/${IMAGEDIR}/${ROOTFS_FILE}"); \
    echo ${DISTRO_NAME}-${IMAGE_VERSION}-${MACHINE}-${DATE}_usb > ${DEPLOY_DIR_IMAGE}/${IMAGEDIR}/imageversion; \
    echo "#" > ${DEPLOY_DIR_IMAGE}/sysinit.txt; \
    echo "# DO NOT EDIT THIS FILE" >> ${DEPLOY_DIR_IMAGE}/sysinit.txt; \
    echo "#" >> ${DEPLOY_DIR_IMAGE}/sysinit.txt; \
    echo "flash -noheader -forceerase usbdisk0:${IMAGEDIR}/${KERNEL_FILE} nandflash0.kernel" >> ${DEPLOY_DIR_IMAGE}/sysinit.txt; \
    echo "&& flash -noheader -forceerase -size=${FILESIZE} usbdisk0:${IMAGEDIR}/${ROOTFS_FILE} nandflash0.rootfs" >> ${DEPLOY_DIR_IMAGE}/sysinit.txt; \
    echo "&& flash -noheader -forceerase usbdisk0:${IMAGEDIR}/splash.bin nandflash0.splash" >> ${DEPLOY_DIR_IMAGE}/sysinit.txt; \
    echo "&& setenv -p STARTUP \"boot -z -elf nandflash0.kernel: 'ubi.mtd=rootfs root=ubi0:rootfs rootfstype=ubifs console=ttyS0,115200'\"" >> ${DEPLOY_DIR_IMAGE}/sysinit.txt; \
    echo "# for one Flash Box Change setenv" >> ${DEPLOY_DIR_IMAGE}/sysinit.txt; \
    echo "#&& setenv -p STARTUP \"boot -z -elf flash0.kernel: 'ubi.mtd=rootfs root=ubi0:rootfs rootfstype=ubifs console=ttyS0,115200'\"" >> ${DEPLOY_DIR_IMAGE}/sysinit.txt; \
    cd ${DEPLOY_DIR_IMAGE}; \
    zip ${IMAGE_NAME}_usb.zip ${IMAGEDIR}/*; \
    zip ${IMAGE_NAME}_usb.zip sysinit.txt; \
    rm -f ${DEPLOY_DIR_IMAGE}/*.ubi; \
    rm -f ${DEPLOY_DIR_IMAGE}/*.ubifs; \
    rm -f ${DEPLOY_DIR_IMAGE}/*.manifest; \
    rm -f ${DEPLOY_DIR_IMAGE}/.ubifs; \
    rm -f ${DEPLOY_DIR_IMAGE}/.manifest; \
    rm -rf ${IMAGEDIR}; \
    "
```
