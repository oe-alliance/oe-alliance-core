## meta-brands/meta-xcore/conf/machine/xc7362.conf
```bitbake
#@TYPE: Machine
#@NAME: XCORE XC7362
#@DESCRIPTION: Machine configuration for the XCORE XC7362

SOC_FAMILY = "bcm7362"
require conf/machine/include/soc-family.inc

require conf/machine/include/xcore-mipsel.inc

MACHINE_FEATURES += "videoenhancement inibt blindscan-dvbs blindscan-dvbc directfb textlcd dvb-c skins1080 blindscan-tbs linuxwifi feature1 feature2 \
    ${@base_contains('MACHINEBUILD', 'spycat', 'ci' , '', d)} \
"

### 8723BS wireless/bluetooth ###
KERNEL_MODULE_AUTOLOAD += "r8723bs" 
KERNEL_MODULE_AUTOLOAD += "hci_uart" 

MACHINE_ESSENTIAL_EXTRA_RRECOMMENDS += " \
    kernel-module-hci-uart \
    "

MACHINE_EXTRA_RRECOMMENDS += " \
    firmware-rtl8723b \
    "

EXTRA_IMAGEDEPENDS += "\
    ${@base_contains('MACHINEBUILD', 'osmini', 'enigma2-plugin-systemplugins-vfdcontrol' , '', d)} \
    ${@base_contains('MACHINEBUILD', 'spycatmini', 'enigma2-plugin-systemplugins-vfdcontrol' , '', d)} \
    ${@base_contains('MACHINEBUILD', 'spycatminiplus', 'enigma2-plugin-systemplugins-vfdcontrol' , '', d)} \
    "

MACHINE_EXTRA_RDEPENDS = "\
    ${@base_contains('MACHINEBUILD', 'osmini', 'enigma2-plugin-systemplugins-vfdcontrol' , '', d)} \
    ${@base_contains('MACHINEBUILD', 'spycatmini', 'enigma2-plugin-systemplugins-vfdcontrol' , '', d)} \
    ${@base_contains('MACHINEBUILD', 'spycatminiplus', 'enigma2-plugin-systemplugins-vfdcontrol' , '', d)} \
    "

IMAGE_FSTYPES ?= "ubi"

UBI_VOLNAME = "rootfs"
MKUBIFS_ARGS = "-m 2048 -e 126976 -c 4096 -F"
UBINIZE_ARGS = "-m 2048 -p 128KiB"

IMAGE_CMD_ubi_prepend = " \
    rm -rf ${IMAGE_ROOTFS}/boot/*; \
    rm -rf ${IMAGE_ROOTFS}/tmp/*; \
    "

IMAGE_CMD_ubi_append = "\
    mkdir -p ${DEPLOY_DIR_IMAGE}/${IMAGEDIR}; \
    cp ${DEPLOY_DIR_IMAGE}/splash.bin ${DEPLOY_DIR_IMAGE}/${IMAGEDIR}/splash.bin; \
    mv ${DEPLOY_DIR_IMAGE}/${IMAGE_NAME}.rootfs.ubi ${DEPLOY_DIR_IMAGE}/${IMAGEDIR}/${ROOTFS_FILE}; \
    cp ${DEPLOY_DIR_IMAGE}/${KERNEL_IMAGETYPE}-${MACHINE}.bin ${DEPLOY_DIR_IMAGE}/${IMAGEDIR}/${KERNEL_FILE}; \
    echo ${IMAGE_VER_STRING} > ${DEPLOY_DIR_IMAGE}/${IMAGEDIR}/imageversion; \
    echo "rename this file to 'force' to force an update without confirmation" > ${DEPLOY_DIR_IMAGE}/${IMAGEDIR}/noforce; \
    cd ${DEPLOY_DIR_IMAGE}; \
    zip ${IMAGE_NAME}_usb.zip ${IMAGEDIR}/*; \
    rm -f ${DEPLOY_DIR_IMAGE}/*.ubi; \
    rm -f ${DEPLOY_DIR_IMAGE}/*.ubifs; \
    rm -f ${DEPLOY_DIR_IMAGE}/*.manifest; \
    rm -f ${DEPLOY_DIR_IMAGE}/.ubifs; \
    rm -f ${DEPLOY_DIR_IMAGE}/.manifest; \
    rm -Rf ${IMAGEDIR}; \
    "
```

## meta-brands/meta-xcore/conf/machine/xc7439.conf
```bitbake
#@TYPE: Machine
#@NAME: XCORE XC7439
#@DESCRIPTION: Machine configuration for the XCORE XC7439

require conf/machine/include/xcore-arm.inc

SOC_FAMILY = "bcm7439"
require conf/machine/include/soc-family.inc

MACHINE_FEATURES += "videoenhancement inibt directfb textlcd dvb-c skins1080 blindscan-tbs linuxwifi linux4extra ci mountboot \
    ${@bb.utils.contains('MACHINEBUILD', 'spycat4k', 'mmc emmc swap', '', d)} \
    ${@bb.utils.contains('MACHINEBUILD', 'spycat4kcombo', 'mmc emmc swap', '', d)} \
"
MTD_BOOTFS = "mmcblk1p1"
MTD_BLACK  = "mmcblk1"

### 8723BS wireless/bluetooth ###
KERNEL_MODULE_AUTOLOAD += "r8723bs"
KERNEL_MODULE_AUTOLOAD += "hci_uart"
KERNEL_MODULE_AUTOLOAD += "${@bb.utils.contains('MACHINE_FEATURES', 'emmc', 'wlan', '', d)}"

MACHINE_ESSENTIAL_EXTRA_RRECOMMENDS += " \
    kernel-module-hci-uart \
    "

MACHINE_EXTRA_RRECOMMENDS += " \
    firmware-rtl8723b \
    "

PREFERRED_VERSION_linux-xcore = "4.11"
PREFERRED_VERSION_linux-libc-headers = "4.11"

IMAGE_CLASSES += "image_types_xcore"
IMAGE_ROOTFS_SIZE ?= "294912"

IMAGE_FSTYPES ?= "${@bb.utils.contains('MACHINE_FEATURES', 'emmc', 'xcoreemmc', 'ubi', d)}"

IMAGE_CMD_xcoreemmc_append = "\
    mkdir -p ${DEPLOY_DIR_IMAGE}/${IMAGEDIR}; \
    cp ${DEPLOY_DIR_IMAGE}/splash.bin ${DEPLOY_DIR_IMAGE}/${IMAGEDIR}/splash.bin; \
    mv ${DEPLOY_DIR_IMAGE}/${IMAGE_NAME}.rootfs.emmc ${DEPLOY_DIR_IMAGE}/${IMAGEDIR}/emmc.img; \
    cd ${IMAGE_ROOTFS}; \
    tar -cvf ${DEPLOY_DIR_IMAGE}/rootfs.tar -C ${IMAGE_ROOTFS} .; \
    mv ${DEPLOY_DIR_IMAGE}/rootfs.tar ${DEPLOY_DIR_IMAGE}/${IMAGEDIR}/rootfs.tar; \
    bzip2 ${DEPLOY_DIR_IMAGE}/${IMAGEDIR}/rootfs.tar; \
    cp ${DEPLOY_DIR_IMAGE}/zImage ${DEPLOY_DIR_IMAGE}/${IMAGEDIR}/${KERNEL_FILE}; \
    echo ${IMAGE_VER_STRING} > ${DEPLOY_DIR_IMAGE}/${IMAGEDIR}/imageversion; \
    echo "rename this file to 'force' to force an update without confirmation" > ${DEPLOY_DIR_IMAGE}/${IMAGEDIR}/noforce; \
    cd ${DEPLOY_DIR_IMAGE}; \
    zip ${IMAGE_NAME}_usb.zip ${IMAGEDIR}/*; \
    rm -f ${DEPLOY_DIR_IMAGE}/*.ext4; \
    rm -f ${DEPLOY_DIR_IMAGE}/*.manifest; \
    rm -f ${DEPLOY_DIR_IMAGE}/.ext4; \
    rm -f ${DEPLOY_DIR_IMAGE}/.manifest; \
    rm -Rf ${IMAGEDIR}; \
    "

UBI_VOLNAME = "rootfs"

# 512 MB Flash TEST Model
#MKUBIFS_ARGS = "-m 2048 -e 126976 -c 4096 -F"
#UBINIZE_ARGS = "-m 2048 -p 128KiB"

# new 2 GB Flash Model
MKUBIFS_ARGS = "-m 4096 -e 1040384 -c 2048 -F"
UBINIZE_ARGS = "-m 4096 -p 1024KiB"

IMAGE_CMD_ubi_prepend = " \
    rm -rf ${IMAGE_ROOTFS}/boot/*; \
    rm -rf ${IMAGE_ROOTFS}/tmp/*; \
    "

IMAGE_CMD_ubi_append = "\
    mkdir -p ${DEPLOY_DIR_IMAGE}/${IMAGEDIR}; \
    cp ${DEPLOY_DIR_IMAGE}/splash.bin ${DEPLOY_DIR_IMAGE}/${IMAGEDIR}/splash.bin; \
    mv ${IMGDEPLOYDIR}/${IMAGE_NAME}.rootfs.ubi ${DEPLOY_DIR_IMAGE}/${IMAGEDIR}/${ROOTFS_FILE}; \
    cp ${DEPLOY_DIR_IMAGE}/${KERNEL_IMAGETYPE}-${MACHINE}.bin ${DEPLOY_DIR_IMAGE}/${IMAGEDIR}/${KERNEL_FILE}; \
    echo ${IMAGE_VER_STRING} > ${DEPLOY_DIR_IMAGE}/${IMAGEDIR}/imageversion; \
    echo "rename this file to 'force' to force an update without confirmation" > ${DEPLOY_DIR_IMAGE}/${IMAGEDIR}/noforce; \
    cd ${DEPLOY_DIR_IMAGE}; \
    zip ${IMAGE_NAME}_usb.zip ${IMAGEDIR}/*; \
    rm -f ${DEPLOY_DIR_IMAGE}/*.ubi; \
    rm -f ${DEPLOY_DIR_IMAGE}/*.ubifs; \
    rm -f ${DEPLOY_DIR_IMAGE}/*.manifest; \
    rm -f ${DEPLOY_DIR_IMAGE}/.ubifs; \
    rm -f ${DEPLOY_DIR_IMAGE}/.manifest; \
    rm -Rf ${IMAGEDIR}; \
    "

BBMASK = "meta-vuplus/recipes-graphics/"
BBMASK += "meta-vuplus/recipes-webkit/"
```

## meta-brands/meta-xp/conf/layer.conf
```bitbake
# We have a conf and classes directory, append to BBPATH
BBPATH .= ":${LAYERDIR}"

# We have a recipes directory, add to BBFILES
BBFILES += "${LAYERDIR}/recipes-*/*.bb ${LAYERDIR}/recipes-*/*.bbappend \
            ${LAYERDIR}/recipes-*/*/*.bb ${LAYERDIR}/recipes-*/*/*.bbappend"

BBFILE_COLLECTIONS += "xp-layer"
BBFILE_PATTERN_xp-layer := "^${LAYERDIR}/"
BBFILE_PRIORITY_xp-layer = "7"

OEA-META-VENDOR-BASE := '${@os.path.normpath("${LAYERDIR}/../")}'
```

## meta-brands/meta-xp/conf/machine/include/xp-oem.inc
```bitbake
# We know about rtc
include conf/machine/include/build-extras.inc

BRAND_OEM = "xp"

MACHINE_NAME = "\
${@base_contains('MACHINEBUILD', 'xp1000mk', 'XP1000' , '', d)}\
${@base_contains('MACHINEBUILD', 'xp1000max', 'XP1000' , '', d)}\
${@base_contains('MACHINEBUILD', 'sf8', 'SF8' , '', d)}\
${@base_contains('MACHINEBUILD', 'xp1000plus', 'XP1000 + ' , '', d)}\
"

MACHINE_BRAND = "\
${@base_contains('MACHINEBUILD', 'xp1000mk', 'MK-Digital' , '', d)}\
${@base_contains('MACHINEBUILD', 'xp1000max', 'MaxDigital' , '', d)}\
${@base_contains('MACHINEBUILD', 'sf8', 'Octagon' , '', d)}\
${@base_contains('MACHINEBUILD', 'xp1000plus', 'Octagon' , '', d)}\
"

IMAGEDIR ?= "\
${@base_contains('MACHINEBUILD', 'xp1000mk', 'xp1000' , '', d)}\
${@base_contains('MACHINEBUILD', 'xp1000max', 'xp1000' , '', d)}\
${@base_contains('MACHINEBUILD', 'sf8', 'xp1000' , '', d)}\
${@base_contains('MACHINEBUILD', 'xp1000plus', 'xp1000' , '', d)}\
"

MTD_KERNEL = "mtd1"
MTD_ROOTFS = "mtd2"
KERNEL_FILE = "kernel.bin"
ROOTFS_FILE = "rootfs.bin"

MACHINE_ESSENTIAL_EXTRA_RDEPENDS = "\
    xp-dvb-modules-${MACHINE} \
    "

DVBPROVIDER = "kernel"

MACHINE_ESSENTIAL_EXTRA_RRECOMMENDS = "\
    kernel-module-cdfs \
    "

MACHINE_EXTRA_RRECOMMENDS = " \
    gstreamer1.0-plugin-dvbmediasink \
    "

include conf/machine/include/autoload-filesystems.inc

DVBMEDIASINK_CONFIG = "--with-wma --with-wmv --with-pcm --with-dts --with-eac3"

TARGET_ARCH = "mipsel"
DEFAULTTUNE = "mips32el"

PREFERRED_PROVIDER_virtual/kernel = "linux-xp"
PREFERRED_VERSION_linux-xp = "3.12.1"
PREFERRED_VERSION_linux-libc-headers = "3.12.1"

KERNEL_IMAGETYPE = "vmlinux"
KERNEL_OUTPUT = "${KERNEL_IMAGETYPE}"
KERNEL_CONSOLE = "ttyS0,115200n8"

IMAGE_FSTYPES ?= "ubi"

UBI_VOLNAME = "rootfs"
MKUBIFS_ARGS = "-m 2048 -e 126976 -c 4096"
UBINIZE_ARGS = "-m 2048 -p 128KiB"

IMAGE_CMD_ubi_prepend = " \
    rm -rf ${IMAGE_ROOTFS}/boot/*; \
    rm -rf ${IMAGE_ROOTFS}/tmp/*; \
    "

IMAGE_CMD_ubi_append = " \
    mkdir -p ${DEPLOY_DIR_IMAGE}/${IMAGEDIR}; \
    cp ${DEPLOY_DIR_IMAGE}/splash.bin ${DEPLOY_DIR_IMAGE}/${IMAGEDIR}/splash.bin; \
    mv ${DEPLOY_DIR_IMAGE}/${IMAGE_NAME}.rootfs.ubi ${DEPLOY_DIR_IMAGE}/${IMAGEDIR}/${ROOTFS_FILE}; \
    gzip -9c ${DEPLOY_DIR_IMAGE}/vmlinux-${MACHINE}.bin > ${DEPLOY_DIR_IMAGE}/${IMAGEDIR}/${KERNEL_FILE}; \
    echo ${DISTRO_NAME}-${DISTRO_VERSION}.${BUILD_VERSION} > ${DEPLOY_DIR_IMAGE}/${IMAGEDIR}/imageversion; \
    echo "rename this file to 'force' to force an update without confirmation" > ${DEPLOY_DIR_IMAGE}/${IMAGEDIR}/noforce; \
    cd ${DEPLOY_DIR_IMAGE}; \
    zip ${IMAGE_NAME}_usb.zip ${IMAGEDIR}/*; \
    rm -f ${DEPLOY_DIR_IMAGE}/*.ubifs; \
    rm -f ${DEPLOY_DIR_IMAGE}/*.manifest; \
    rm -f ${DEPLOY_DIR_IMAGE}/.ubifs; \
    rm -f ${DEPLOY_DIR_IMAGE}/.manifest; \
    rm -Rf ${IMAGEDIR}; \
    "

MACHINE_FEATURES += "alsa wifi 3dtv switchoff hdmicec bootsplash omb"

BOOTLOGO_FILENAME = "splash.bin"

require conf/machine/include/tune-mips32.inc

EXTRA_IMAGEDEPENDS += " \
    enigma2-plugin-systemplugins-remotecontrolcode \
    "

MACHINE_EXTRA_RDEPENDS_${PN} = " \
    enigma2-plugin-systemplugins-remotecontrolcode \
    "

# add support for extra feeds
PACKAGE_ARCHS += " ${MACHINEBUILD}"
```

## meta-brands/meta-xtrend/conf/layer.conf
```bitbake
# We have a conf and classes directory, append to BBPATH
BBPATH .= ":${LAYERDIR}"

# We have a recipes directory, add to BBFILES
BBFILES += "${LAYERDIR}/recipes-*/*.bb ${LAYERDIR}/recipes-*/*.bbappend \
            ${LAYERDIR}/recipes-*/*/*.bb ${LAYERDIR}/recipes-*/*/*.bbappend"

BBFILE_COLLECTIONS += "xtrend-layer"
BBFILE_PATTERN_xtrend-layer := "^${LAYERDIR}/"
BBFILE_PRIORITY_xtrend-layer = "7"

OEA-META-XTREND-BASE := '${@os.path.normpath("${LAYERDIR}/../")}'
```

## meta-brands/meta-xtrend/conf/machine/et10000.conf
```bitbake
#@TYPE: Machine
#@NAME: Xtrend et10000
#@DESCRIPTION: Machine configuration for the Xtrend et10000

MACHINE_NAME = "ET10000"

FLASHSIZE = "1024"

PREFERRED_VERSION_linux-etxx00 = "4.10.6"

SOC_FAMILY = "bcm7425"

DVBSKYPROVIDER = "kernel"

UBI_VOLNAME = "rootfs"
MKUBIFS_ARGS = "-m 2048 -e 126976 -c 8192"
UBINIZE_ARGS = "-m 2048 -p 128KiB"

require conf/machine/include/etxx00.inc

MACHINE_FEATURES += "dvb-c ci fanctrl bwlcd128 videoenhancement blindscan-dvbc skins1080 multitranscoding blindscan-tbs linuxwifi boxmodel kodi19 HDMI_IN_HD HDMI WOL SCART YUV"

MACHINE_KERNEL_PR = "r0"
```

## meta-brands/meta-xtrend/conf/machine/et1x000.conf
```bitbake
#@TYPE: Machine
#@NAME: ET1x000
#@DESCRIPTION: Machine configuration for the ET ET1x000

PREFERRED_VERSION_linux-etxx00 = "4.1.37"
PREFERRED_VERSION_linux-libc-headers = "4.1"

SOC_FAMILY = "bcm7251s"

FLASHSIZE = "4096"

require conf/machine/include/etxx00-oem.inc

IMAGE_CMD_tar_prepend = "\
    mkdir -p ${DEPLOY_DIR_IMAGE}/${IMAGEDIR}; \
    ${@bb.utils.contains("MACHINE_FEATURES", "bootsplash", "cp ${DEPLOY_DIR_IMAGE}/splash.bin ${DEPLOY_DIR_IMAGE}/${IMAGEDIR}/splash.bin;" , "", d)} \
    cp ${DEPLOY_DIR_IMAGE}/${MACHINE}_update.bin ${DEPLOY_DIR_IMAGE}/${IMAGEDIR}/update.bin; \
    cp ${DEPLOY_DIR_IMAGE}/zImage ${DEPLOY_DIR_IMAGE}/${IMAGEDIR}/${KERNEL_FILE}; \
    echo ${DISTRO_NAME}-${DISTRO_VERSION}.${BUILD_VERSION} > ${DEPLOY_DIR_IMAGE}/${IMAGEDIR}/imageversion; \
    echo "rename this file to 'force' to force an update without confirmation" > ${DEPLOY_DIR_IMAGE}/${IMAGEDIR}/noforce; \
    echo "this file enable kernel update" > ${DEPLOY_DIR_IMAGE}/${IMAGEDIR}/partition.update \
    cd ${IMAGE_ROOTFS}; \
    tar -cvf ${DEPLOY_DIR_IMAGE}/rootfs.tar -C ${IMAGE_ROOTFS} .; \
    mv ${DEPLOY_DIR_IMAGE}/rootfs.tar ${DEPLOY_DIR_IMAGE}/${IMAGEDIR}/rootfs.tar; \
    bzip2 ${DEPLOY_DIR_IMAGE}/${IMAGEDIR}/rootfs.tar; \
    cd ${DEPLOY_DIR_IMAGE}; \
    zip ${IMAGE_NAME}_usb.zip ${IMAGEDIR}/*; \
    rm -f ${DEPLOY_DIR_IMAGE}/*.rootfs.tar.bz2; \
    rm -f ${DEPLOY_DIR_IMAGE}/.tar.bz2; \
    rm -f ${DEPLOY_DIR_IMAGE}/*.manifest; \
    rm -f ${DEPLOY_DIR_IMAGE}/.manifest; \
    rm -Rf ${IMAGEDIR}; \
"

MACHINE_FEATURES += "ci videoenhancement skins1080 hbbtv-browser-webkit emmc mmc \
    ${@bb.utils.contains('MACHINEBUILD', 'gi11000', ' 7segment textlcd' , '', d)} \
"
MTD_BLACK  = "mmcblk0"

BBMASK = "meta-vuplus/recipes-graphics/"
BBMASK += "meta-vuplus/recipes-webkit/"
```

## meta-brands/meta-xtrend/conf/machine/et4x00.conf
```bitbake
#@TYPE: Machine
#@NAME: Xtrend et4x00
#@DESCRIPTION: Machine configuration for the Xtrend et4x00

MACHINE_NAME = "ET4X00"

RCTYPE = "13"
RCNAME = "et4x00"

# Broken bootloader can only flash around 100 MB
FLASHSIZE = "96"

PREFERRED_VERSION_linux-etxx00 = "4.10.6"

SOC_FAMILY = "bcm7358"

DVBSKYPROVIDER = "kernel"

MACHINE_FEATURES += "videoenhancement singlecore smallflash no-cl-svr skins1080 blindscan-tbs linuxwifi blindscan-dvbs boxmodel SCART HDMI RCA oem-info"

UBI_VOLNAME = "rootfs"
MKUBIFS_ARGS = "-m 2048 -e 126976 -c 4096"
UBINIZE_ARGS = "-m 2048 -p 128KiB"

require conf/machine/include/etxx00.inc
```

## meta-brands/meta-xtrend/conf/machine/et5x00.conf
```bitbake
#@TYPE: Machine
#@NAME: Xtrend et5x00
#@DESCRIPTION: Machine configuration for the Xtrend et5x00

MACHINE_NAME = "ET5X00"

RCTYPE = "7"
RCNAME = "et6x00"
RCHARDWARE = "V2"

# Broken bootloader can only flash around 100 MB
FLASHSIZE = "96"

PREFERRED_VERSION_linux-etxx00 = "3.8.7"

SOC_FAMILY = "bcm7413"

UBI_VOLNAME = "rootfs"
MKUBIFS_ARGS = "-m 2048 -e 126976 -c 4096"
UBINIZE_ARGS = "-m 2048 -p 128KiB"

MACHINE_FEATURES += "nolcd skins1080 feature2 blindscan-tbs blindscan-dvbs boxmodel HDMI YUV smallflash oem-info"

require conf/machine/include/etxx00.inc
```
