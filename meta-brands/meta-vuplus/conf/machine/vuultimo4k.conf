## meta-brands/meta-vuplus/conf/machine/vuultimo4k.conf
```bitbake
#@TYPE: Machine
#@NAME: Vu+ Ultimo4k
#@DESCRIPTION: Machine configuration for the Vu+ Ultimo4K

MACHINE_NAME = "Ultimo4K"
MTD_ROOTFS = "mmcblk0p4"
MTD_KERNEL = "mmcblk0p1"
KERNEL_FILE = "kernel_auto.bin"
ROOTFS_FILE = "rootfs.tar.bz2"
MTD_BLACK  = "mmcblk0"

FLASHSIZE = "4096"

UPDATE_DIR = "ultimo4k"

DVBSKYPROVIDER = "kernel"

require conf/machine/include/vuplus.inc

IMAGE_CMD_tar_prepend = "\
    mkdir -p ${DEPLOY_DIR_IMAGE}/${IMAGEDIR}; \
    ${@bb.utils.contains("MACHINE_FEATURES", "bootsplash", "cp ${DEPLOY_DIR_IMAGE}/splash_cfe_auto.bin ${DEPLOY_DIR_IMAGE}/${IMAGEDIR}/splash_auto.bin;" , "", d)} \
    cp ${DEPLOY_DIR_IMAGE}/initrd_auto.bin ${DEPLOY_DIR_IMAGE}/${IMAGEDIR}/initrd_auto.bin; \
    cp ${DEPLOY_DIR_IMAGE}/zImage ${DEPLOY_DIR_IMAGE}/${IMAGEDIR}/${KERNEL_FILE}; \
    echo ${DISTRO_NAME}-${DISTRO_VERSION}.${BUILD_VERSION} > ${DEPLOY_DIR_IMAGE}/${IMAGEDIR}/imageversion; \
    echo "This file forces a reboot after the update." > ${DEPLOY_DIR_IMAGE}/${IMAGEDIR}/reboot.update; \
    cd ${IMAGE_ROOTFS}; \
    tar -cvf ${DEPLOY_DIR_IMAGE}/rootfs.tar -C ${IMAGE_ROOTFS} .; \
    mv ${DEPLOY_DIR_IMAGE}/rootfs.tar ${DEPLOY_DIR_IMAGE}/${IMAGEDIR}/rootfs.tar; \
    bzip2 ${DEPLOY_DIR_IMAGE}/${IMAGEDIR}/rootfs.tar; \
    cd ${DEPLOY_DIR_IMAGE}; \
    zip ${IMAGE_NAME}_usb.zip ${IMAGEDIR}/*; \
    rm -f ${DEPLOY_DIR_IMAGE}/*.rootfs.tar.bz2; \
    rm -f ${DEPLOY_DIR_IMAGE}/.tar.bz2; \
    rm -f ${DEPLOY_DIR_IMAGE}/*.manifest; \
    rm -f ${DEPLOY_DIR_IMAGE}/.manifest; \
    rm -Rf vuplus; \
"

EXTRA_IMAGEDEPENDS = "\
    vuplus-initrd-cfe-vuultimo4k \
    vuplus-wifi-util-vuultimo4k \
    vuplus-hdmi-in-helper \
    "

MACHINE_EXTRA_RDEPENDS = "\
    vuplus-initrd-cfe-vuultimo4k \
    enigma2-plugin-systemplugins-remotecontrolcode \
    vuplus-wifi-util-vuultimo4k \
    vuplus-hdmi-in-helper \
    "

PREFERRED_VERSION_linux-vuplus = "3.14.28"
PREFERRED_VERSION_linux-libc-headers = "3.19"

MACHINE_FEATURES += "colorlcd800 ci dvb-c blindscan-dvbc blindscan-dvbs skins1080 uianimation dvbproxy kodi minitv webkithbbtv transcoding chromiumos omb mmc emmc fcc bluetooth vubluetooth wowl quadpip vuglesdemo"

TARGET_ARCH = "arm"
DEFAULTTUNE = "cortexa15hf-neon-vfpv4"
IMAGE_FSTYPES =+ "tar.bz2"

MACHINE_FEATURES_BACKFILL_CONSIDERED = "rtc gobject-introspection-data"

require conf/machine/include/tune-cortexa15.inc

SOC_FAMILY = "bcm7376"

DVBMEDIASINK_CONFIG = "--with-dtsdownmix --with-dts --with-pcm --with-eac3 --with-amr --with-wmv --with-vb6 --with-vb8 --with-vb9 --with-spark --with-h265"
```

## meta-brands/meta-vuplus/conf/machine/vuzero.conf
```bitbake
#@TYPE: Machine
#@NAME: Vu+ zero
#@DESCRIPTION: Machine configuration for the Vu+ zero

MACHINE_NAME = "zero"
MTD_ROOTFS = "mtd0"
MTD_KERNEL = "mtd2"
KERNEL_FILE = "kernel_cfe_auto.bin"
ROOTFS_FILE = "root_cfe_auto.bin"

FLASHSIZE = "256"

UPDATE_DIR = "zero"

require conf/machine/include/vuplus.inc

IMAGE_CMD_ubi_append = "\
    mkdir -p ${DEPLOY_DIR_IMAGE}/${IMAGEDIR}; \
    ${@bb.utils.contains("MACHINE_FEATURES", "bootsplash", "cp ${DEPLOY_DIR_IMAGE}/splash_cfe_auto.bin ${DEPLOY_DIR_IMAGE}/${IMAGEDIR}/splash_cfe_auto.bin;" , "", d)} \
    cp ${DEPLOY_DIR_IMAGE}/initrd_cfe_auto.bin ${DEPLOY_DIR_IMAGE}/${IMAGEDIR}/initrd_cfe_auto.bin; \
    mv ${IMGDEPLOYDIR}/${IMAGE_NAME}.rootfs.ubi ${DEPLOY_DIR_IMAGE}/${IMAGEDIR}/${ROOTFS_FILE}; \
    gzip -f -9c ${DEPLOY_DIR_IMAGE}/vmlinux-${MACHINE}.bin > ${DEPLOY_DIR_IMAGE}/${IMAGEDIR}/${KERNEL_FILE}; \
    echo ${IMAGE_VER_STRING} > ${DEPLOY_DIR_IMAGE}/${IMAGEDIR}/imageversion; \
    echo "This file forces the update." > ${DEPLOY_DIR_IMAGE}/${IMAGEDIR}/force.update; \
    cd ${DEPLOY_DIR_IMAGE}; \
    zip ${IMAGE_NAME}_usb.zip ${IMAGEDIR}/*; \
    rm -f ${DEPLOY_DIR_IMAGE}/*.ubi; \
    rm -f ${DEPLOY_DIR_IMAGE}/*.ubifs; \
    rm -f ${DEPLOY_DIR_IMAGE}/*.manifest; \
    rm -f ${DEPLOY_DIR_IMAGE}/.ubifs; \
    rm -f ${DEPLOY_DIR_IMAGE}/.manifest; \
    rm -Rf vuplus; \
    "

EXTRA_IMAGEDEPENDS = "\
    vuplus-initrd-cfe-vuzero \
    "

MACHINE_EXTRA_RDEPENDS = "\
    vuplus-initrd-cfe-vuzero \
    enigma2-plugin-systemplugins-firmwareupgrade \
    enigma2-plugin-systemplugins-remotecontrolcode \
    vuplus-pau \
    "

PREFERRED_VERSION_linux-vuplus = "3.13.5"
#PREFERRED_VERSION_linux-libc-headers = "3.13"
MKFS_UBI_MAX_ERASE_BLK_COUNT = "4096"

TARGET_ARCH = "mipsel"
DEFAULTTUNE = "mips32el"
IMAGE_FSTYPES ?= "ubi"

MACHINE_FEATURES += "skins1080 omb operahbbtv"

require conf/machine/include/tune-mips32.inc

SOC_FAMILY = "bcm7362"

DVBMEDIASINK_CONFIG = "--with-pcm --with-eac3 --with-amr --with-wmv"
```

## meta-brands/meta-vuplus/conf/machine/vuzero4k.conf
```bitbake
#@TYPE: Machine
#@NAME: Vu+ Zero4K
#@DESCRIPTION: Machine configuration for the Vu+ Zero4K

MACHINE_NAME = "Zero4K"
MTD_ROOTFS = "mmcblk0p7"
MTD_KERNEL = "mmcblk0p4"
KERNEL_FILE = "kernel_auto.bin"
ROOTFS_FILE = "rootfs.tar.bz2"
MTD_BLACK  = "mmcblk0"

FLASHSIZE = "4096"

UPDATE_DIR = "zero4k"

DVBSKYPROVIDER = "kernel"

require conf/machine/include/vuplus.inc

IMAGE_CMD_tar_prepend = "\
    mkdir -p ${DEPLOY_DIR_IMAGE}/${IMAGEDIR}; \
    ${@bb.utils.contains("MACHINE_FEATURES", "bootsplash", "cp ${DEPLOY_DIR_IMAGE}/splash_cfe_auto.bin ${DEPLOY_DIR_IMAGE}/${IMAGEDIR}/splash_auto.bin;" , "", d)} \
    cp ${DEPLOY_DIR_IMAGE}/initrd_auto.bin ${DEPLOY_DIR_IMAGE}/${IMAGEDIR}/initrd_auto.bin; \
    cp ${DEPLOY_DIR_IMAGE}/zImage ${DEPLOY_DIR_IMAGE}/${IMAGEDIR}/${KERNEL_FILE}; \
    echo ${DISTRO_NAME}-${DISTRO_VERSION}.${BUILD_VERSION} > ${DEPLOY_DIR_IMAGE}/${IMAGEDIR}/imageversion; \
    echo "This file forces a reboot after the update." > ${DEPLOY_DIR_IMAGE}/${IMAGEDIR}/force.update; \
    cd ${IMAGE_ROOTFS}; \
    tar -cvf ${DEPLOY_DIR_IMAGE}/rootfs.tar -C ${IMAGE_ROOTFS} .; \
    mv ${DEPLOY_DIR_IMAGE}/rootfs.tar ${DEPLOY_DIR_IMAGE}/${IMAGEDIR}/rootfs.tar; \
    bzip2 ${DEPLOY_DIR_IMAGE}/${IMAGEDIR}/rootfs.tar; \
    cd ${DEPLOY_DIR_IMAGE}; \
    zip ${IMAGE_NAME}_usb.zip ${IMAGEDIR}/*; \
    rm -f ${DEPLOY_DIR_IMAGE}/*.rootfs.tar.bz2; \
    rm -f ${DEPLOY_DIR_IMAGE}/.tar.bz2; \
    rm -f ${DEPLOY_DIR_IMAGE}/*.manifest; \
    rm -f ${DEPLOY_DIR_IMAGE}/.manifest; \
    rm -Rf vuplus; \
"

EXTRA_IMAGEDEPENDS = "\
    vuplus-initrd-cfe-vuzero4k"

MACHINE_EXTRA_RDEPENDS = "\
    vuplus-initrd-cfe-vuzero4k \
    enigma2-plugin-systemplugins-remotecontrolcode \
    vuplus-pau \
    "

PREFERRED_VERSION_linux-vuplus = "4.1.20"
PREFERRED_VERSION_linux-libc-headers = "4.1.20"

MACHINE_FEATURES += "ci dvb-c blindscan-dvbc blindscan-dvbs skins1080 uianimation dvbproxy kodi webkithbbtv chromiumos omb mmc emmc bluetooth vubluetooth vuglesdemo"

TARGET_ARCH = "arm"
DEFAULTTUNE = "cortexa15hf-neon-vfpv4"
IMAGE_FSTYPES =+ "tar.bz2"

MACHINE_FEATURES_BACKFILL_CONSIDERED = "rtc gobject-introspection-data"

require conf/machine/include/tune-cortexa15.inc

SOC_FAMILY = "bcm72604"

DVBMEDIASINK_CONFIG = "--with-dtsdownmix --with-dts --with-pcm --with-eac3 --with-amr --with-wmv --with-vb6 --with-vb8 --with-vb9 --with-spark --with-h265"
```

## meta-brands/meta-wetek/conf/layer.conf
```bitbake
# We have a conf and classes directory, append to BBPATH
BBPATH .= ":${LAYERDIR}"

# We have a recipes directory, add to BBFILES
BBFILES += "${LAYERDIR}/recipes-*/*.bb ${LAYERDIR}/recipes-*/*.bbappend \
            ${LAYERDIR}/recipes-*/*/*.bb ${LAYERDIR}/recipes-*/*/*.bbappend"

BBFILE_COLLECTIONS += "wetek-layer"
BBFILE_PATTERN_wetek-layer := "^${LAYERDIR}/"
BBFILE_PRIORITY_wetek-layer = "7"

OEA-META-WETEK-BASE := '${@os.path.normpath("${LAYERDIR}/")}'
```

## meta-brands/meta-wetek/conf/machine/include/amlogic.inc
```bitbake
IMAGE_CLASSES += "sdcard_image-wetek"
PREFERRED_PROVIDER_virtual/libgles1 = "opengl-amlogic"
PREFERRED_PROVIDER_virtual/libgles2 = "opengl-amlogic"
PREFERRED_PROVIDER_virtual/egl = "opengl-amlogic"

PREFERRED_PROVIDER_jpeg = "libjpeg-turbo"
PREFERRED_PROVIDER_jpeg-native = "libjpeg-turbo-native"
```

## meta-brands/meta-wetek/conf/machine/include/multilib.inc
```bitbake
# Define multilib target
require conf/multilib.conf
MULTILIBS = "multilib:lib32"
DEFAULTTUNE_virtclass-multilib-lib32 = "armv7ahf-neon"
 
# Specify the 32-bit libraries to be added to the image
IMAGE_INSTALL_append = " lib32-glibc lib32-libgcc lib32-libstdc++"
```

## meta-brands/meta-wetek/conf/machine/include/wetek-amlogic.inc
```bitbake
PREFERRED_PROVIDER_virtual/libgles1 = "opengl-amlogic"
PREFERRED_PROVIDER_virtual/libgles2 = "opengl-amlogic"
PREFERRED_PROVIDER_virtual/egl = "opengl-amlogic"

PREFERRED_PROVIDER_jpeg = "libjpeg-turbo"
PREFERRED_PROVIDER_jpeg-native = "libjpeg-turbo-native"

EXTRA_OECONF_append_pn-enigma2 = " --with-alsa --with-alsacard=hw:0 --with-alsamixer=Master --with-fbdev=/dev/fb2 --with-lcddev=/dev/null --with-amlogic"
DEPENDS_append_pn-enigma2 = " libdvbcsa libamcodec libamadec"
EXTRA_OECONF_append_pn-tuxtxt-enigma2 = " --with-fbdev=/dev/fb2"
CC_append_pn-showiframe = " -DHAVE_AMLOGIC -I${STAGING_INCDIR}/amlogic/amcodec -lamcodec"
DEPENDS_append_pn-showiframe = " libamcodec"

# Add "MACHINEBUILD" override for recipes
MACHINEOVERRIDES =. "${@['', '${MACHINEBUILD}:']['${MACHINEBUILD}' != '']}"

BBMASK = "meta-vuplus/recipes-graphics/"
BBMASK = "meta-fulan/recipes-graphics/"
BBMASK += "meta-vuplus/recipes-webkit/"
```

## meta-brands/meta-wetek/conf/machine/include/wetek.inc
```bitbake
require conf/machine/include/soc-family.inc
include conf/machine/include/autoload-filesystems.inc

# We know about rtc
include conf/machine/include/build-extras.inc


PREFERRED_PROVIDER_virtual/libgles1 = "wetek-opengl-amlogic"
PREFERRED_PROVIDER_virtual/libgles2 = "wetek-opengl-amlogic"
PREFERRED_PROVIDER_virtual/egl = "wetek-opengl-amlogic"
PREFERRED_PROVIDER_virtual/kodi = "stb-kodi-${MACHINE}"

PREFERRED_PROVIDER_jpeg = "libjpeg-turbo"
PREFERRED_PROVIDER_jpeg-native = "libjpeg-turbo-native"

EXTRA_OECONF_append_pn-enigma2 = " --with-alsa --with-alsacard=hw:0 --with-alsamixer=Master --with-fbdev=/dev/fb2 --with-lcddev=/dev/null --with-amlogic"
DEPENDS_append_pn-enigma2 = " libdvbcsa wetek-libamcodec-${MACHINE} wetek-libamadec-${MACHINE}"
EXTRA_OECONF_append_pn-tuxtxt-enigma2 = " --with-fbdev=/dev/fb2"
CC_append_pn-showiframe = " -DHAVE_AMLOGIC -I${STAGING_INCDIR}/amlogic/amcodec -lamcodec"
DEPENDS_append_pn-showiframe = " wetek-libamcodec-${MACHINE}"

MACHINE_EXTRA_RRECOMMENDS = " \
    wetek-libamplayer-${MACHINE} \
    wetek-libamavutils-${MACHINE} \
    wetek-libamadec-${MACHINE} \
    wetek-libamcodec-${MACHINE} \
    "

IMAGE_FSTYPES += "ext4 sdcard"
IMAGE_ROOTFS_SIZE = "976562"
IMAGE_EXTRA_SPACE = "0"
IMAGE_OVERHEAD_FACTOR = "1.0"

# Serial console to be used
SERIAL_CONSOLE = "115200 ttyS0"

DVBPROVIDER = "kernel"
DVBSKYPROVIDER = "kernel"

UBOOT_ENTRYPOINT  = "0x80008000"
UBOOT_LOADADDRESS = "0x80008000"

IMAGEDIR ?= "${MACHINE}"

IMAGE_CLASSES += "image_types_wetek"

IMAGE_CMD_sdcard_append = " \
    mkdir -p ${DEPLOY_DIR_IMAGE}/${IMAGEDIR}; \
    mv ${DEPLOY_DIR_IMAGE}/${IMAGE_NAME}.rootfs.wetek-sd.img ${DEPLOY_DIR_IMAGE}/${IMAGEDIR}/${IMAGE_NAME}.sdcard.img; \
    echo ${DISTRO_NAME}-${DISTRO_VERSION}.${BUILD_VERSION} > ${DEPLOY_DIR_IMAGE}/${IMAGEDIR}/imageversion; \
    cd ${DEPLOY_DIR_IMAGE}; \
    zip ${IMAGE_NAME}_sdcard.zip ${IMAGEDIR}/*; \
    rm -f ${DEPLOY_DIR_IMAGE}/*.ext4; \
    rm -f ${DEPLOY_DIR_IMAGE}/*.manifest; \
    rm -f ${DEPLOY_DIR_IMAGE}/*.json; \
    rm -f ${DEPLOY_DIR_IMAGE}/.wetek-sd.img; \
    rm -f ${DEPLOY_DIR_IMAGE}/*.rootfs.wetek-sd.img; \
    rm -Rf ${IMAGEDIR}; \
    "

# Add "MACHINEBUILD" override for recipes
MACHINEOVERRIDES =. "${@['', '${MACHINEBUILD}:']['${MACHINEBUILD}' != '']}"

BBMASK = "meta-vuplus/recipes-graphics/"
BBMASK += "meta-vuplus/recipes-webkit/"
```

## meta-brands/meta-wetek/conf/machine/wetekplay.conf
```bitbake
#@TYPE: Machine
#@NAME: WeTeK play
#@DESCRIPTION: Machine configuration for the WeTeK play

MACHINE_NAME = "PLAY"
BRAND_OEM = "wetek"
MACHINE_BRAND = "WeTeK"

GST_VERSION = "0.10"

SOC_FAMILY = "AML8726"

# Amlogic defaults
require conf/machine/include/wetek.inc
DEFAULTTUNE ?= "cortexa9hf-neon"
include conf/machine/include/tune-cortexa9.inc

MACHINE_ESSENTIAL_EXTRA_RDEPENDS = "\
    wetek-dvb-modules-${MACHINE} \
    wetek-shutdown \
    enigma2-plugin-extensions-rcuselect \
    enigma2-plugin-extensions-rezap \
    enigma2-plugin-extensions-startkodi \
    wetek-gst-amlavsink \
    wetek-gst-app \
    wetek-gst-amlavout \
    gst-fluendo-mpegdemux \
    wetek-opengl-amlogic \
    "

MACHINE_ESSENTIAL_EXTRA_RRECOMMENDS = "\
    kernel-module-cdfs \
    kernel-module-sysfillrect \
    kernel-module-syscopyarea \
    kernel-module-mceusb \
    kernel-module-rc-core \
    kernel-module-mali \
    kernel-module-dhd \
    kernel-module-CH341 \
    wetek-amlsetfb \
    wetek-amremote \
    pcsc-lite \
    "

KERNEL_MODULE_AUTOLOAD += "\
    e2-procfs \
    sysfillrect \
    syscopyarea \
    mceusb \
    rc-core \
    mali \
    dhd \
    CH341 \
    rfcomm \
    hidp \
"

PREFERRED_PROVIDER_virtual/kernel = "linux-wetek"
PREFERRED_VERSION_linux-wetek = "3.10.93"
PREFERRED_VERSION_linux-libc-headers = "3.14.79"

KERNEL_IMAGETYPE = "uImage-dtb"
KERNEL_DEVICETREE = "wetekplay.dtd"


MACHINE_FEATURES = "bluetooth fb meson6 usbhost vfat alsa dvb-c nolcd skins1080 emmc kodi aml-plugins"
MTD_BLACK  = "mmcblk0"
```

## meta-brands/meta-wetek/conf/machine/wetekplay2.conf
```bitbake
#@TYPE: Machine
#@NAME: WeTeK play2
#@DESCRIPTION: Machine configuration for the WeTeK play2

MACHINE_NAME = "PLAY2"
BRAND_OEM = "wetek"
MACHINE_BRAND = "WeTeK"

GST_VERSION = "0.10"

SOC_FAMILY = "AMLS905"

# Amlogic defaults
require conf/machine/include/wetek.inc
require conf/machine/include/arm/arch-armv8.inc

require conf/machine/include/multilib.inc

MACHINE_ESSENTIAL_EXTRA_RDEPENDS = "\
    wetek-shutdown \
    wetek-dvb-modules-${MACHINE} \
    wetek-dhd-${MACHINE} \
    wetek-mali-${MACHINE} \
    enigma2-plugin-extensions-rcuselect \
    enigma2-plugin-extensions-rezap \
    wetek-gst-amlavsink \
    wetek-gst-app \
    wetek-gst-amlavout \
    gst-fluendo-mpegdemux \
    wetek-opengl-amlogic \
    "

MACHINE_ESSENTIAL_EXTRA_RRECOMMENDS = "\
    kernel-module-cdfs \
    kernel-module-sysfillrect \
    kernel-module-syscopyarea \
    kernel-module-mceusb \
    kernel-module-rc-core \
    kernel-module-CH341 \
    kernel-module-cfg80211 \
    kernel-module-rfcomm \
    kernel-module-hidp \
    kernel-module-bluetooth \
    kernel-module-6lowpan-iphc \
    kernel-module-libcrc32c \
    kernel-module-xfs \
    wetek-amlsetfb \
    wetek-amremote \
    pcsc-lite \
    "


KERNEL_MODULE_AUTOLOAD += "\
    e2-procfs \
    sysfillrect \
    syscopyarea \
    mceusb \
    rc-core \
    mali \
    dhd \
    CH341 \
    rfcomm \
    hidp \
    cfg80211 \
    bluetooth \
    6lowpan-iphc \
    libcrc32c \
"

module_conf_dhd = "options dhd firmware_path=/lib/firmware/brcm/ nvram_path=/lib/firmware/brcm/"

KERNEL_MODULE_PROBECONF += "\
	dhd \
"

PREFERRED_PROVIDER_virtual/kernel = "linux-wetek"
PREFERRED_VERSION_linux-wetek = "3.14.29"
PREFERRED_VERSION_linux-libc-headers = "3.14.79"

KERNEL_IMAGETYPE = "Image"
KERNEL_DEVICETREE = "gxbb_p200_2G_wetek_play_2.dtb"


MACHINE_FEATURES = "bluetooth fb usbhost vfat alsa dvb-c nolcd skins1080 emmc kodi aml-plugins"
MTD_BLACK  = "mmcblk0"
```

## meta-brands/meta-xcore/conf/layer.conf
```bitbake
# We have a conf and classes directory, append to BBPATH
BBPATH .= ":${LAYERDIR}"

# We have a recipes directory, add to BBFILES
BBFILES += "${LAYERDIR}/recipes-*/*.bb ${LAYERDIR}/recipes-*/*.bbappend \
            ${LAYERDIR}/recipes-*/*/*.bb ${LAYERDIR}/recipes-*/*/*.bbappend"

BBFILE_COLLECTIONS += "xcore-layer"
BBFILE_PATTERN_xcore-layer := "^${LAYERDIR}/"
BBFILE_PRIORITY_xcore-layer = "7"

LAYERSERIES_COMPAT_xcore-layer = "sumo"

OEA-META-XCORE-BASE := '${@os.path.normpath("${LAYERDIR}/")}'
```
