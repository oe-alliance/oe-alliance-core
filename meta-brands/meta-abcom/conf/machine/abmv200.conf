## meta-brands/meta-dinobot/conf/machine/u51.conf
```bitbake
# MACHINEBUILDS: anadol4kcombo anadol4kv2 axashis4kcombo dinobot4kl protek4kx1
#@TYPE: Machine
#@NAME: u51
#@DESCRIPTION: Machine configuration for the u51

EXTRA_OECONF:append:pn-enigma2 = " --with-lcddev=/dev/null --with-alphablendingacceleration=always"

SOC_FAMILY = "hisi3798mv200"

SDCARD = "no"

MACHINE_FEATURES += " chkrootmb multitranscoding hiaccel RCA blindscan-dvbs kodi22 7segment skins1080 WOL"

KERNEL_MODULE_AUTOLOAD += "8192eu"

VER = "-chiper"

require conf/machine/include/dinobot-cortexa15.inc
require conf/machine/include/dinobot-emmc.inc
```

## meta-brands/meta-dinobot/conf/machine/u52.conf
```bitbake
# MACHINEBUILDS: axashis4kcomboplus dinobot4kplus
#@TYPE: Machine
#@NAME: u52
#@DESCRIPTION: Machine configuration for the u52

EXTRA_OECONF:append:pn-enigma2 = " --with-lcddev=/dev/null --with-alphablendingacceleration=always"

SOC_FAMILY = "hisi3798mv200"

SDCARD = "no"

MACHINE_FEATURES += " chkrootmb multitranscoding hiaccel RCA blindscan-dvbs kodi22 7segment skins1080 ${E2EGL_WQHD_FEATURE} WOL ${E2EGL_MACHINE_FEATURE}"

KERNEL_MODULE_AUTOLOAD += "8192eu"

VER = "-chiper"

require conf/machine/include/dinobot-cortexa15.inc
require conf/machine/include/dinobot-emmc.inc
```

## meta-brands/meta-dinobot/conf/machine/u533.conf
```bitbake
# MACHINEBUILDS: arivatwin
#@TYPE: Machine
#@NAME: u533
#@DESCRIPTION: Machine configuration for the u533

EXTRA_OECONF:append:pn-enigma2 = " --with-lcddev=/dev/null --with-alphablendingacceleration=always"

SOC_FAMILY = "hisi3798cv200"

SDCARD = "no"

MACHINE_FEATURES += " chkrootmb multitranscoding hiaccel 7segment skins1080 ${E2EGL_WQHD_FEATURE} kodi22 WOL ${E2EGL_MACHINE_FEATURE}"

VER = "-chiper"

require conf/machine/include/dinobot-cortexa15.inc
require conf/machine/include/dinobot-emmc.inc
```

## meta-brands/meta-dinobot/conf/machine/u56.conf
```bitbake
# MACHINEBUILDS: axashisc4k dinobot4kelite
#@TYPE: Machine
#@NAME: u56
#@DESCRIPTION: Machine configuration for the u56

EXTRA_OECONF:append:pn-enigma2 = " --with-lcddev=/dev/null --with-alphablendingacceleration=always"

SOC_FAMILY = "hisi3798mv200"

SDCARD = "no"

MACHINE_FEATURES += " chkrootmb multitranscoding hiaccel RCA blindscan-dvbs kodi22 7segment skins1080 ${E2EGL_WQHD_FEATURE} WOL ${E2EGL_MACHINE_FEATURE}"

KERNEL_MODULE_AUTOLOAD += "8192eu"

VER = "-nochip"

require conf/machine/include/dinobot-cortexa15.inc
require conf/machine/include/dinobot-emmc.inc
```

## meta-brands/meta-dinobot/conf/machine/u5pvr.conf
```bitbake
#@TYPE: Machine
#@NAME: u5pvr
#@DESCRIPTION: Machine configuration for the u5pvr

EXTRA_OECONF:append:pn-enigma2 = " --with-lcddev=/dev/null --with-alphablendingacceleration=always"

SOC_FAMILY = "hisi3798cv200"

SDCARD = "yes"

MACHINE_FEATURES += " chkrootmb videoenhancement RCA 7segment skins1080 kodi21"

require conf/machine/include/dinobot-cortexa15.inc
require conf/machine/include/dinobot-emmc.inc

VER = "-chiper"

KERNEL_MODULE_AUTOLOAD += "brcmutil"
KERNEL_MODULE_AUTOLOAD += "brcmfmac"

MACHINE_ESSENTIAL_EXTRA_RDEPENDS += "\
    kernel-module-brcmutil \
    kernel-module-brcmfmac \
"

MACHINE_ESSENTIAL_EXTRA_RRECOMMENDS += "\
    kernel-module-cdfs \
    kernel-module-hid \
    kernel-module-isofs \
    kernel-module-udf \
    kernel-module-nfs \
    kernel-module-nfsv2 \
    kernel-module-nfsv3 \
    kernel-module-nfsv4 \
    kernel-module-nfsd \
    kernel-module-cifs \
    kernel-module-usbhid \
    kernel-module-exportfs \
    kernel-module-cfg80211 \
    kernel-module-lib80211 \
    kernel-module-ext2 \
    kernel-module-ipv6 \
    "
```
