## meta-brands/meta-tiviar/conf/layer.conf
```bitbake
# We have a conf and classes directory, append to BBPATH
BBPATH .= ":${LAYERDIR}"

# We have a recipes directory, add to BBFILES
BBFILES += "${LAYERDIR}/recipes-*/*.bb ${LAYERDIR}/recipes-*/*.bbappend \
            ${LAYERDIR}/recipes-*/*/*.bb ${LAYERDIR}/recipes-*/*/*.bbappend"

BBFILE_COLLECTIONS += "tiviar-layer"
BBFILE_PATTERN_tiviar-layer := "^${LAYERDIR}/"
BBFILE_PRIORITY_tiviar-layer = "7"

LAYERSERIES_COMPAT_tiviar-layer = "sumo"

OEA-META-TIVIAR-BASE := '${@os.path.normpath("${LAYERDIR}/")}'
```

## meta-brands/meta-tiviar/conf/machine/tiviaraplus.conf
```bitbake
#@TYPE: Machine
#@NAME:  Tiviar Alpha+
#@DESCRIPTION: Machine configuration for the Tiviar Alpha+

MACHINE_NAME = "Alpha+"

PREFERRED_VERSION_linux-tiviar = "4.10.6"

SOC_FAMILY = "bcm7356"

UBI_VOLNAME = "rootfs"
MKUBIFS_ARGS = "-m 2048 -e 126976 -c 8192"
UBINIZE_ARGS = "-m 2048 -p 128KiB"

 
MACHINE_FEATURES += "dvb-c textlcd videoenhancement multitranscoding SCART YUV"

require conf/machine/include/tiviar.inc
```

## meta-brands/meta-tiviar/conf/machine/tiviarmin.conf
```bitbake
#@TYPE: Machine
#@NAME: Tiviar mini
#@DESCRIPTION: Machine configuration for the Tiviar mini

MACHINE_NAME = "mini"
RCNAME = "tiviar1"

PREFERRED_VERSION_linux-tiviar = "4.10.6"

SOC_FAMILY = "bcm7362"

UBI_VOLNAME = "rootfs"
MKUBIFS_ARGS = "-m 2048 -e 126976 -c 8192"
UBINIZE_ARGS = "-m 2048 -p 128KiB"

MACHINE_FEATURES += "textlcd videoenhancement directfb 7segment AV_JACK smallflash"

require conf/machine/include/tiviar.inc
```

## meta-brands/meta-tripledot/conf/layer.conf
```bitbake
# We have a conf and classes directory, append to BBPATH
BBPATH .= ":${LAYERDIR}"

# We have a recipes directory, add to BBFILES
BBFILES += "${LAYERDIR}/recipes-*/*.bb ${LAYERDIR}/recipes-*/*.bbappend \
            ${LAYERDIR}/recipes-*/*/*.bb ${LAYERDIR}/recipes-*/*/*.bbappend"

BBFILE_COLLECTIONS += "tripledot-layer"
BBFILE_PATTERN_tripledot-layer := "^${LAYERDIR}/"
BBFILE_PRIORITY_tripledot-layer = "7"

OEA-META-TRIPLEDOT-BASE := '${@os.path.normpath("${LAYERDIR}/")}'
```

## meta-brands/meta-tripledot/conf/machine/include/tripledot-oem.inc
```bitbake
# We know about rtc
include conf/machine/include/build-extras.inc

BRAND_OEM = "tripledot"

MACHINE_NAME = "\
${@bb.utils.contains('MACHINEBUILD', 'enibox', 'EniBox' , '', d)}\
${@bb.utils.contains('MACHINEBUILD', 'mago', 'MAGO' , '', d)}\
${@bb.utils.contains('MACHINEBUILD', 'tyrant', 'tyrant' , '', d)}\
${@bb.utils.contains('MACHINEBUILD', 'xcombo', 'enfinityX combo plus' , '', d)}\
${@bb.utils.contains('MACHINEBUILD', 'x1plus', 'enfinityX 1plus' , '', d)}\
${@bb.utils.contains('MACHINEBUILD', 'sf108', 'SF108 E2HD' , '', d)}\
${@bb.utils.contains('MACHINEBUILD', 't2cable', 'ENFINITY T2/CABLE' , '', d)}\
${@bb.utils.contains('MACHINEBUILD', 'sf98', 'SF98' , '', d)}\
${@bb.utils.contains('MACHINEBUILD', 'evopanda', 'SLIM panda' , '', d)}\
"

MACHINE_BRAND = "\
${@bb.utils.contains('MACHINEBUILD', 'enibox', 'hdbox' , '', d)}\
${@bb.utils.contains('MACHINEBUILD', 'mago', 'relook' , '', d)}\
${@bb.utils.contains('MACHINEBUILD', 'tyrant', 'tripledot' , '', d)}\
${@bb.utils.contains('MACHINEBUILD', 'xcombo', 'EVO' , '', d)}\
${@bb.utils.contains('MACHINEBUILD', 'x1plus', 'EVO' , '', d)}\
${@bb.utils.contains('MACHINEBUILD', 'sf108', 'Octagon' , '', d)}\
${@bb.utils.contains('MACHINEBUILD', 't2cable', 'EVO' , '', d)}\
${@bb.utils.contains('MACHINEBUILD', 'sf98', 'Octagon' , '', d)}\
${@bb.utils.contains('MACHINEBUILD', 'evopanda', 'EVO' , '', d)}\
"

IMAGEDIR ?= "\
${@bb.utils.contains('MACHINEBUILD', 'enibox', 'enibox' , '', d)}\
${@bb.utils.contains('MACHINEBUILD', 'mago', 'mago' , '', d)}\
${@bb.utils.contains('MACHINEBUILD', 'tyrant', 'tyrant' , '', d)}\
${@bb.utils.contains('MACHINEBUILD', 'xcombo', 'xcombo' , '', d)}\
${@bb.utils.contains('MACHINEBUILD', 'x1plus', 'x1plus' , '', d)}\
${@bb.utils.contains('MACHINEBUILD', 'sf108', 'sf108' , '', d)}\
${@bb.utils.contains('MACHINEBUILD', 't2cable', 't2cable' , '', d)}\
${@bb.utils.contains('MACHINEBUILD', 'sf98', 'sf98' , '', d)}\
${@bb.utils.contains('MACHINEBUILD', 'evopanda', 'slim' , '', d)}\
"

MTD_KERNEL ?= "\
${@bb.utils.contains('MACHINEBUILD', 'enibox', 'mtd2' , '', d)}\
${@bb.utils.contains('MACHINEBUILD', 'mago', 'mtd2' , '', d)}\
${@bb.utils.contains('MACHINEBUILD', 'tyrant', 'mtd2' , '', d)}\
${@bb.utils.contains('MACHINEBUILD', 'xcombo', 'mtd2' , '', d)}\
${@bb.utils.contains('MACHINEBUILD', 'x1plus', 'mtd2' , '', d)}\
${@bb.utils.contains('MACHINEBUILD', 'sf108', 'mtd2' , '', d)}\
${@bb.utils.contains('MACHINEBUILD', 't2cable', 'mtd2' , '', d)}\
${@bb.utils.contains('MACHINEBUILD', 'sf98', 'mtd2' , '', d)}\
${@bb.utils.contains('MACHINEBUILD', 'evopanda', 'mtd2' , '', d)}\
"

MTD_ROOTFS ?= "\
${@bb.utils.contains('MACHINEBUILD', 'enibox', 'mtd8' , '', d)}\
${@bb.utils.contains('MACHINEBUILD', 'mago', 'mtd8' , '', d)}\
${@bb.utils.contains('MACHINEBUILD', 'tyrant', 'mtd8' , '', d)}\
${@bb.utils.contains('MACHINEBUILD', 'xcombo', 'mtd8' , '', d)}\
${@bb.utils.contains('MACHINEBUILD', 'x1plus', 'mtd8' , '', d)}\
${@bb.utils.contains('MACHINEBUILD', 'sf108', 'mtd8' , '', d)}\
${@bb.utils.contains('MACHINEBUILD', 't2cable', 'mtd8' , '', d)}\
${@bb.utils.contains('MACHINEBUILD', 'sf98', 'mtd0' , '', d)}\
${@bb.utils.contains('MACHINEBUILD', 'evopanda', 'mtd0' , '', d)}\
"

KERNEL_FILE = "kernel.bin"
ROOTFS_FILE = "rootfs.bin"

MACHINE_ESSENTIAL_EXTRA_RDEPENDS = "\
    tripledot-dvb-modules-${MACHINE} \
    "

DVBPROVIDER = "kernel"

MACHINE_ESSENTIAL_EXTRA_RRECOMMENDS = "\
    kernel-module-cdfs \
    "

MACHINE_EXTRA_RRECOMMENDS = " \
    gstreamer1.0-plugin-dvbmediasink \
    "

include conf/machine/include/autoload-filesystems.inc

DVBMEDIASINK_CONFIG = "--with-wma --with-wmv --with-pcm --with-dts --with-eac3"

TARGET_ARCH = "mipsel"
DEFAULTTUNE = "mips32el"

PREFERRED_PROVIDER_virtual/kernel = "linux-tripledot"

KERNEL_IMAGETYPE = "vmlinux"
KERNEL_OUTPUT = "${KERNEL_IMAGETYPE}"
KERNEL_CONSOLE = "ttyS0,115200n8"

IMAGE_FSTYPES ?= "ubi"

IMAGE_CMD_ubi_prepend = " \
    rm -rf ${IMAGE_ROOTFS}/boot/*; \
    rm -rf ${IMAGE_ROOTFS}/tmp/*; \
    "

IMAGE_CMD_ubi_append = "\
    mkdir -p ${DEPLOY_DIR_IMAGE}/${IMAGEDIR}; \
    ${@bb.utils.contains("MACHINE_FEATURES", "extrasplash", "cp ${DEPLOY_DIR_IMAGE}/cfe.bmp ${DEPLOY_DIR_IMAGE}/${IMAGEDIR}/;" , "", d)} \
    ${@bb.utils.contains("MACHINE_FEATURES", "extrasplash", "cp ${DEPLOY_DIR_IMAGE}/splash.bmp ${DEPLOY_DIR_IMAGE}/${IMAGEDIR}/;" , "", d)} \
    ${@bb.utils.contains("MACHINE_FEATURES", "extrasplash", "cp ${DEPLOY_DIR_IMAGE}/imageversion.bmp ${DEPLOY_DIR_IMAGE}/${IMAGEDIR}/;" , "", d)} \
    ${@bb.utils.contains("MACHINE_FEATURES", "extrasplash", "cp ${DEPLOY_DIR_IMAGE}/kernel.bmp ${DEPLOY_DIR_IMAGE}/${IMAGEDIR}/;" , "", d)} \
    ${@bb.utils.contains("MACHINE_FEATURES", "extrasplash", "cp ${DEPLOY_DIR_IMAGE}/rootfs.bmp ${DEPLOY_DIR_IMAGE}/${IMAGEDIR}/;" , "", d)} \
    ${@bb.utils.contains("MACHINE_FEATURES", "extrasplash", "cp ${DEPLOY_DIR_IMAGE}/finished.bmp ${DEPLOY_DIR_IMAGE}/${IMAGEDIR}/;" , "", d)} \
    cp ${DEPLOY_DIR_IMAGE}/splash.bin ${DEPLOY_DIR_IMAGE}/${IMAGEDIR}/splash.bin; \
    mv ${IMGDEPLOYDIR}/${IMAGE_NAME}.rootfs.ubi ${DEPLOY_DIR_IMAGE}/${IMAGEDIR}/${ROOTFS_FILE}; \
    gzip -9c ${DEPLOY_DIR_IMAGE}/vmlinux-${MACHINE}.bin > ${DEPLOY_DIR_IMAGE}/${IMAGEDIR}/${KERNEL_FILE}; \
    echo ${IMAGE_VER_STRING} > ${DEPLOY_DIR_IMAGE}/${IMAGEDIR}/imageversion; \
    ${@bb.utils.contains('MACHINE', 'yh7362', \
    'echo "dont change this file" > ${DEPLOY_DIR_IMAGE}/${IMAGEDIR}/force;' , \
    'echo "rename this file to force to force an update without confirmation" > ${DEPLOY_DIR_IMAGE}/${IMAGEDIR}/noforce;', d)} \
    cd ${DEPLOY_DIR_IMAGE}; \
    zip ${IMAGE_NAME}_usb.zip ${IMAGEDIR}/*; \
    rm -f ${DEPLOY_DIR_IMAGE}/*.ubi; \
    rm -f ${DEPLOY_DIR_IMAGE}/*.ubifs; \
    rm -f ${DEPLOY_DIR_IMAGE}/*.manifest; \
    rm -f ${DEPLOY_DIR_IMAGE}/.ubifs; \
    rm -f ${DEPLOY_DIR_IMAGE}/.manifest; \
    rm -Rf ${IMAGEDIR}; \
    "


MACHINE_FEATURES += "3dtv alsa hdmicec switchoff bootsplash omb feature1 feature2 blindscan-tbs"

BOOTLOGO_FILENAME = "splash.bin"

require conf/machine/include/tune-mips32.inc
require conf/machine/include/soc-family.inc

# add support for extra feeds
PACKAGE_ARCHS += " ${MACHINEBUILD}"

# Add "MACHINEBUILD" override for recipes
MACHINEOVERRIDES =. "${@['', '${MACHINEBUILD}:']['${MACHINEBUILD}' != '']}"
```

## meta-brands/meta-tripledot/conf/machine/vg1000.conf
```bitbake
PREFERRED_VERSION_linux-tripledot = "3.14.2"
PREFERRED_VERSION_linux-libc-headers = "3.13"

CHIPSET = "bcm7356"

UBI_VOLNAME = "rootfs"
MKUBIFS_ARGS = "-m 2048 -e 126976 -c 4096"
UBINIZE_ARGS = "-m 2048 -p 128KiB -s 2048"

MACHINE_FEATURES += "dvb-c ci textlcd videoenhancement"

require conf/machine/include/tripledot-oem.inc
```

## meta-brands/meta-tripledot/conf/machine/vg2000.conf
```bitbake
PREFERRED_VERSION_linux-tripledot = "3.14.2"
PREFERRED_VERSION_linux-libc-headers = "3.13"

CHIPSET = "bcm7362"

UBI_VOLNAME = "rootfs"
MKUBIFS_ARGS = "-m 2048 -e 126976 -c 4096"
UBINIZE_ARGS = "-m 2048 -p 128KiB -s 2048"

MACHINE_FEATURES += "videoenhancement ci"

require conf/machine/include/tripledot-oem.inc

EXTRA_IMAGEDEPENDS += "\
    enigma2-plugin-systemplugins-vfdcontrol \
    "

MACHINE_EXTRA_RDEPENDS = "\
    enigma2-plugin-systemplugins-vfdcontrol \
    "
```

## meta-brands/meta-tripledot/conf/machine/yh62tc.conf
```bitbake
PREFERRED_VERSION_linux-tripledot = "3.14.2"
PREFERRED_VERSION_linux-libc-headers = "3.13"

SOC_FAMILY = "bcm7362"

UBI_VOLNAME = "rootfs"
MKUBIFS_ARGS = "-m 2048 -e 126976 -c 4096"
UBINIZE_ARGS = "-m 2048 -p 128KiB -s 2048"

MACHINE_FEATURES += "videoenhancement dvb-c dvbc-only"

require conf/machine/include/tripledot-oem.inc

MACHINE_KERNEL_PR = "r0"

MACHINE_EXTRA_RRECOMMENDS += "\
    tripledot-cfe \
    "
```

## meta-brands/meta-uclan/conf/layer.conf
```bitbake
# We have a conf and classes directory, append to BBPATH
BBPATH .= ":${LAYERDIR}"

# We have a recipes directory, add to BBFILES
BBFILES += "${LAYERDIR}/recipes-*/*.bb ${LAYERDIR}/recipes-*/*.bbappend \
            ${LAYERDIR}/recipes-*/*/*.bb ${LAYERDIR}/recipes-*/*/*.bbappend"

BBFILE_COLLECTIONS += "uclan-layer"
BBFILE_PATTERN_uclan-layer := "^${LAYERDIR}/"
BBFILE_PRIORITY_uclan-layer = "7"

LAYERSERIES_COMPAT_uclan-layer = "langdale mickledore"

OEA-META-UCLAN-BASE := '${@os.path.normpath("${LAYERDIR}/")}'
```

## meta-brands/meta-uclan/conf/machine/include/uclan-hisi.inc
```bitbake
PACKAGECONFIG_GL:pn-qtbase = "gles2 eglfs linuxfb"
PACKAGECONFIG_FB:pn-qtbase = " "

# We know about rtc
include conf/machine/include/build-extras.inc

DISTRO_FEATURES:remove = "x11 wayland"

BRAND_OEM = "uclan"

IMAGEDIR = "uclan/${MACHINE}"

MACHINE_BRAND = "Uclan"

KERNEL_FILE = "kernel.bin"
ROOTFS_FILE = "rootfs.tar.bz2"
MTD_BLACK  = "mmcblk0"

VER = "-ustym4kpro"

MACHINE_ESSENTIAL_EXTRA_RDEPENDS += "\
    uclan-dvb-modules-${MACHINE} \
    uclan-loadmodules-${SOC_FAMILY} \ 
    uclan-opengl-${SOC_FAMILY} \
    uclan-libs-${MACHINE} \
    uclan-hihalt-${SOC_FAMILY} \
    uclan-reader-${MACHINE} \
    uclan-libreader-${SOC_FAMILY} \
    uclan-partitions-${MACHINE} \
    uclan-tntfs-${HICHIPSET} \
    uclan-buildimage \
    e2fsprogs-resize2fs \
    gptfdisk \
"

MACHINE_FEATURES += "hisil switchoff hdmicec skins1080 emmc mmc kodi20 alsa hbbtv-browser-webkit qtstalker qtnetflix openhbbtv hisichromium mali"

IMAGE_CLASSES  += "uclan-emmc_image"
IMAGE_FSTYPES += "uclanemmc"
IMAGE_ROOTFS_SIZE ?= "624288"

TARGET_ARCH = "arm"
DEFAULTTUNE = "cortexa15hf-neon-vfpv4"

PREFERRED_VERSION_linux-uclan = "${LINUX_VERSION}"
PREFERRED_PROVIDER_virtual/kernel = "linux-uclan"
PREFERRED_PROVIDER_virtual/egl = "uclan-opengl-${SOC_FAMILY}" 
PREFERRED_PROVIDER_virtual/libgles1 = "uclan-opengl-${SOC_FAMILY}"
PREFERRED_PROVIDER_virtual/libgles2 = "uclan-opengl-${SOC_FAMILY}"
PREFERRED_PROVIDER_virtual/kodi = "stb-kodi-${MACHINE}"
PREFERRED_PROVIDER_virtual/blindscan-dvbs = "uclan-blindscan-${SOC_FAMILY}"

PREFERRED_RPROVIDER_showiframe = "uclan-showiframe-${SOC_FAMILY}"
PREFERRED_RPROVIDER_aio-grab = "uclan-grab-${SOC_FAMILY}"

require conf/machine/include/arm/armv7a/tune-cortexa15.inc

MACHINE_EXTRA_RRECOMMENDS += " \
    gstreamer1.0-plugin-dvbmediasink \
    gstreamer1.0-libav \
    ${@bb.utils.contains('MACHINE', 'ustym4kottpremium', 'enigma2-plugin-extensions-gbipboxclient enigma2-plugin-systemplugins-satipclient' , '', d)} \
    ${@bb.utils.contains('MACHINE_FEATURES', 'oem-info', 'oem-info', '',d)} \
    "

DVBPROVIDER = "kernel"
DVBSKYPROVIDER = "kernel"

include conf/machine/include/autoload-filesystems.inc
require conf/machine/include/soc-family.inc
require conf/machine/box-hardware.inc

DVBMEDIASINK_CONFIG = "--with-h265 --with-vb8 --with-vb9 --with-spark --with-wma --with-wmv --with-pcm --with-dts --with-eac3"

IMAGE_CMD:uclanemmc:append = "\
    mkdir -p ${DEPLOY_DIR_IMAGE}/${IMAGEDIR}; \
    mv ${IMGDEPLOYDIR}/${IMAGE_NAME}.rootfs.ext4 ${DEPLOY_DIR_IMAGE}/${MACHINE}-partitions/rootfs.ext4; \
    cd ${IMAGE_ROOTFS}; \
    tar -cvf ${DEPLOY_DIR_IMAGE}/rootfs.tar -C ${IMAGE_ROOTFS} .; \
    mv ${DEPLOY_DIR_IMAGE}/rootfs.tar ${DEPLOY_DIR_IMAGE}/${IMAGEDIR}/rootfs.tar; \
    bzip2 ${DEPLOY_DIR_IMAGE}/${IMAGEDIR}/rootfs.tar; \
    cp ${DEPLOY_DIR_IMAGE}/uImage ${DEPLOY_DIR_IMAGE}/${IMAGEDIR}/${KERNEL_FILE}; \
    cp ${DEPLOY_DIR_IMAGE}/uImage ${DEPLOY_DIR_IMAGE}/${MACHINE}-partitions/${KERNEL_FILE}; \
    if [ -e ${DEPLOY_DIR_IMAGE}/logo-${DISTRO_NAME}.img ]; then \
        cp -f ${DEPLOY_DIR_IMAGE}/logo-${DISTRO_NAME}.img ${DEPLOY_DIR_IMAGE}/${MACHINE}-partitions/logo.img; \
    fi; \
    echo ${IMAGE_VER_STRING} > ${DEPLOY_DIR_IMAGE}/${IMAGEDIR}/imageversion; \
    cd ${DEPLOY_DIR_IMAGE}/${MACHINE}-partitions; \
    mkupdate -s 00000003-00000001-01010101 -f ${DEPLOY_DIR_IMAGE}/${MACHINE}-partitions/emmc_partitions.xml -d ${DEPLOY_DIR_IMAGE}/usb_update.bin; \ 
    cd ${DEPLOY_DIR_IMAGE}; \
    cp ${IMGDEPLOYDIR}/${IMAGE_NAME}.rootfs.manifest ${IMAGE_NAME}_usb.zip.manifest; \
    zip -j ${IMAGE_NAME}_recovery_emmc.zip ${DEPLOY_DIR_IMAGE}/usb_update.bin ${DEPLOY_DIR_IMAGE}/${IMAGEDIR}/imageversion ${DEPLOY_DIR_IMAGE}/${MACHINE}-partitions/bootargs.bin ${DEPLOY_DIR_IMAGE}/${MACHINE}-partitions/fastboot.bin ${DEPLOY_DIR_IMAGE}/${MACHINE}-partitions/apploader.bin; \
    zip ${IMAGE_NAME}_mmc.zip ${IMAGEDIR}/*; \
    rm -f ${DEPLOY_DIR_IMAGE}/*.ext4; \
    rm -f ${DEPLOY_DIR_IMAGE}/.ext4; \
    rm -f -f ${DEPLOY_DIR_IMAGE}/*.json; \
    rm -Rf ${DEPLOY_DIR_IMAGE}/usb_update.bin; \
    rm -Rf ${IMAGEDIR}; \
    rm -Rf ${IMGDEPLOYDIR}/userdata; \
    "

# Add "MACHINEBUILD" override for recipes
MACHINEOVERRIDES =. "${@['', '${MACHINEBUILD}:']['${MACHINEBUILD}' != '']}"

BBMASK = "meta-vuplus/recipes-graphics/"
BBMASK += "meta-vuplus/recipes-webkit/"
```

## meta-brands/meta-uclan/conf/machine/ustym4kott.conf
```bitbake
#@TYPE: Machine
#@NAME: ustym4kottpremium
#@DESCRIPTION: Machine configuration for the ustym4kottpremium

EXTRA_OECONF:append:pn-enigma2 = "--with-lcddev=/dev/null --with-alphablendingacceleration=always --with-blitaccelerationthreshold=250  --with-fillaccelerationthreshold=190000"

MACHINE_FEATURES += " no-subssupport HDMI AV_JACK multitranscoding"

SOC_FAMILY = "hisi3798mv200advca"
HICHIPSET = "3798mv200advca"
LINUX_VERSION = "4.4.176"

MTD_KERNEL = "mmcblk0p15"
MTD_ROOTFS = "mmcblk0p19"

MACHINE_NAME = "Ustym 4K OTT Premium"

require conf/machine/include/uclan-hisi.inc
```
