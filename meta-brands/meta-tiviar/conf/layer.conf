## meta-brands/meta-uclan/conf/machine/ustym4kpro.conf
```bitbake
#@TYPE: Machine
#@NAME: ustym4kpro
#@DESCRIPTION: Machine configuration for the ustym4kpro

EXTRA_OECONF_append_pn-enigma2 = "--with-lcddev=/dev/null --with-alphablendingacceleration=always --with-blitaccelerationthreshold=250  --with-fillaccelerationthreshold=190000"

MACHINE_FEATURES += " no-subssupport HDMI AV_JACK multitranscoding blindscan-dvbs 7segment"

SOC_FAMILY = "hisi3798mv200"
HICHIPSET = "3798mv200"
LINUX_VERSION = "4.4.35"

MTD_KERNEL = "mmcblk0p12"
MTD_ROOTFS = "mmcblk0p16"

MACHINE_NAME = "Ustym 4K PRO"

require conf/machine/include/uclan-hisi.inc
```

## meta-brands/meta-uclan/conf/machine/ustym4ks2ottx.conf
```bitbake
#@TYPE: Machine
#@NAME: ustym4ks2ottx
#@DESCRIPTION: Machine configuration for the ustym4ks2ottx

EXTRA_OECONF:append:pn-enigma2 = " --with-lcddev=/dev/null --with-alphablendingacceleration=always --with-blitaccelerationthreshold=250  --with-fillaccelerationthreshold=190000 --with-subttxtabnormalptsdiffs=3600000"

MACHINE_FEATURES += " no-subssupport HDMI AV_JACK multitranscoding blindscan-dvbs 7segment"

SOC_FAMILY = "hisi3798mv300"
HICHIPSET = "3798mv300"
LINUX_VERSION = "4.4.176"

MACHINE_NAME = "Ustym 4K S2 OTT X"

MTD_KERNEL = "mmcblk0p12"
MTD_ROOTFS = "mmcblk0p16"
RCNAME = "uclan3"

require conf/machine/include/uclan-hisi.inc
```

## meta-brands/meta-ultramini/conf/layer.conf
```bitbake
# We have a conf and classes directory, append to BBPATH
BBPATH .= ":${LAYERDIR}"

# We have a recipes directory, add to BBFILES
BBFILES += "${LAYERDIR}/recipes-*/*.bb ${LAYERDIR}/recipes-*/*.bbappend \
            ${LAYERDIR}/recipes-*/*/*.bb ${LAYERDIR}/recipes-*/*/*.bbappend"

BBFILE_COLLECTIONS += "ultramini-layer"
BBFILE_PATTERN_ultramini-layer := "^${LAYERDIR}/"
BBFILE_PRIORITY_ultramini-layer = "7"

LAYERSERIES_COMPAT_ultramini-layer = "sumo"

OEA-META-ULTRAMINI-BASE := '${@os.path.normpath("${LAYERDIR}/")}'
```

## meta-brands/meta-ultramini/conf/machine/include/ultramini-oem.inc
```bitbake
# We know about rtc
include conf/machine/include/build-extras.inc

BRAND_OEM = "ultramini"

MACHINE_NAME = "\
${@bb.utils.contains('MACHINEBUILD', 'xpeedlxcs2', 'XPEED LX CLASS S2' , '', d)}\
${@bb.utils.contains('MACHINEBUILD', 'xpeedlxcc', 'XPEED LX CLASS C' , '', d)}\
${@bb.utils.contains('MACHINEBUILD', 'et7x00mini', 'ET-7000 Mini' , '', d)}\
"

MACHINE_BRAND = "\
${@bb.utils.contains('MACHINEBUILD', 'xpeedlxcs2', 'GOLDEN INTERSTAR' , '', d)}\
${@bb.utils.contains('MACHINEBUILD', 'xpeedlxcc', 'GOLDEN INTERSTAR' , '', d)}\
${@bb.utils.contains('MACHINEBUILD', 'et7x00mini', 'Galaxy Innovations' , '', d)}\
"

IMAGEDIR ?= "\
${@bb.utils.contains('MACHINEBUILD', 'xpeedlxcs2', 'xpeedc' , '', d)}\
${@bb.utils.contains('MACHINEBUILD', 'xpeedlxcc', 'xpeedc' , '', d)}\
${@bb.utils.contains('MACHINEBUILD', 'et7x00mini', 'et7x00' , '', d)}\
"

MTD_KERNEL = "\
${@bb.utils.contains('MACHINEBUILD', 'xpeedlxcs2', 'mtd1' , '', d)}\
${@bb.utils.contains('MACHINEBUILD', 'xpeedlxcc', 'mtd1' , '', d)}\
${@bb.utils.contains('MACHINEBUILD', 'et7x00mini', 'mtd1' , '', d)}\
"

MTD_ROOTFS = "\
${@bb.utils.contains('MACHINEBUILD', 'xpeedlxcs2', 'mtd2' , '', d)}\
${@bb.utils.contains('MACHINEBUILD', 'xpeedlxcc', 'mtd2' , '', d)}\
${@bb.utils.contains('MACHINEBUILD', 'et7x00mini', 'mtd2' , '', d)}\
"

MACHINE_DRIVER = "\
${@bb.utils.contains('MACHINEBUILD', 'xpeedlxcs2', 'xpeedc' , '', d)}\
${@bb.utils.contains('MACHINEBUILD', 'xpeedlxcc', 'xpeedc' , '', d)}\
${@bb.utils.contains('MACHINEBUILD', 'et7x00mini', 'et7000mini' , '', d)}\
"

KERNEL_FILE = "kernel.bin"
ROOTFS_FILE = "rootfs.bin"

DVBPROVIDER = "kernel"
DVBSKYPROVIDER = "kernel"

MACHINE_ESSENTIAL_EXTRA_RDEPENDS = "\
    ultramini-dvb-modules-${MACHINE_DRIVER} \
    "

MACHINE_ESSENTIAL_EXTRA_RRECOMMENDS = "\
    kernel-module-cdfs \
    "

MACHINE_EXTRA_RRECOMMENDS = " \
    gstreamer1.0-plugin-dvbmediasink \
    "

include conf/machine/include/autoload-filesystems.inc

DVBMEDIASINK_CONFIG = "--with-wma --with-wmv --with-pcm --with-dtsdownmix \
    ${@bb.utils.contains('MACHINE', 'ultramini', '--with-vb6 --with-vb8 --with-spark' , '', d)} \
"

TARGET_ARCH = "mipsel"
DEFAULTTUNE = "mips32el"

PREFERRED_PROVIDER_virtual/kernel = "linux-ultramini"
PREFERRED_PROVIDER_virtual/blindscan-dvbc = "ultramini-blindscan-utils-dvbc"
PREFERRED_PROVIDER_virtual/blindscan-dvbs = "ultramini-blindscan-utils-dvbs"

PREFERRED_VERSION_nfs-utils ?= "1.2.8"

KERNEL_IMAGETYPE = "vmlinux"
KERNEL_OUTPUT = "${KERNEL_IMAGETYPE}"
KERNEL_CONSOLE = "ttyS0,115200n8"

IMAGE_FSTYPES ?= "ubi"

UBI_VOLNAME = "rootfs"
MKUBIFS_ARGS = "-m 2048 -e 126976 -c 4096"
UBINIZE_ARGS = "-m 2048 -p 128KiB"

IMAGE_CMD_ubi_prepend = " \
    rm -rf ${IMAGE_ROOTFS}/boot/*; \
    rm -rf ${IMAGE_ROOTFS}/tmp/*; \
    "

IMAGE_CMD_ubi_append = "\
    mkdir -p ${DEPLOY_DIR_IMAGE}/${IMAGEDIR}; \
    ${@bb.utils.contains("MACHINE_FEATURES", "bootsplash", "cp ${DEPLOY_DIR_IMAGE}/${BOOTLOGO_FILENAME} ${DEPLOY_DIR_IMAGE}/${IMAGEDIR}/${BOOTLOGO_FILENAME};" , "", d)} \
    mv ${IMGDEPLOYDIR}/${IMAGE_NAME}.rootfs.ubi ${DEPLOY_DIR_IMAGE}/${IMAGEDIR}/${ROOTFS_FILE}; \
    gzip -9c ${DEPLOY_DIR_IMAGE}/vmlinux-${MACHINE}.bin > ${DEPLOY_DIR_IMAGE}/${IMAGEDIR}/${KERNEL_FILE}; \
    echo ${IMAGE_VER_STRING} > ${DEPLOY_DIR_IMAGE}/${IMAGEDIR}/imageversion; \
    echo "rename this file to 'force' to force an update without confirmation" > ${DEPLOY_DIR_IMAGE}/${IMAGEDIR}/noforce; \
    cd ${DEPLOY_DIR_IMAGE}; \
    zip ${IMAGE_NAME}_usb.zip ${IMAGEDIR}/*; \
    rm -f ${DEPLOY_DIR_IMAGE}/*.ubi; \
    rm -f ${DEPLOY_DIR_IMAGE}/*.ubifs; \
    rm -f ${DEPLOY_DIR_IMAGE}/*.manifest; \
    rm -f ${DEPLOY_DIR_IMAGE}/.ubifs; \
    rm -f ${DEPLOY_DIR_IMAGE}/.manifest; \
    rm -Rf ${IMAGEDIR}; \
    "

MACHINE_FEATURES += "3dtv alsa hdmicec switchoff wifi bootsplash omb skins1080 feature1 feature2 \
    ${@bb.utils.contains('MACHINEBUILD', 'xpeedlxcc', 'dvb-c dvbc-only blindscan-dvbc boxmodel' , '', d)} \
    ${@bb.utils.contains('MACHINEBUILD', 'xpeedlxcs2', 'boxmodel' , '', d)} \
    "

BOOTLOGO_FILENAME = "splash.bin"

require conf/machine/include/tune-mips32.inc
require conf/machine/include/soc-family.inc

# add support for extra feeds
PACKAGE_ARCHS += " ${MACHINEBUILD}"

# Add "MACHINEBUILD" override for recipes
MACHINEOVERRIDES =. "${@['', '${MACHINEBUILD}:']['${MACHINEBUILD}' != '']}"
```

## meta-brands/meta-vuplus/conf/layer.conf
```bitbake
# We have a conf and classes directory, append to BBPATH
BBPATH .= ":${LAYERDIR}"

# We have a recipes directory, add to BBFILES
BBFILES += "${LAYERDIR}/recipes-*/*.bb ${LAYERDIR}/recipes-*/*.bbappend \
            ${LAYERDIR}/recipes-*/*/*.bb ${LAYERDIR}/recipes-*/*/*.bbappend"

BBFILE_COLLECTIONS += "vuplus-layer"
BBFILE_PATTERN_vuplus-layer := "^${LAYERDIR}/"
BBFILE_PRIORITY_vuplus-layer = "7"

OEA-META-VUPLUS-BASE := '${@os.path.normpath("${LAYERDIR}/../")}'
```

## meta-brands/meta-vuplus/conf/machine/include/vuplus.inc
```bitbake
PACKAGECONFIG_GL:pn-qtbase = "gles2 eglfs linuxfb"
PACKAGECONFIG_FB:pn-qtbase = " "

# We know about rtc
include conf/machine/include/build-extras.inc

BRAND_OEM = "vuplus"
MACHINE_BRAND = "Vu+"
RCHARDWARE = "VU"

MACHINE_ESSENTIAL_EXTRA_RDEPENDS += " \
    ${@bb.utils.contains("MACHINE_FEATURES", "dvbproxy", "vuplus-dvb-proxy-${MACHINE} vuplus-libgles-${MACHINE} vuplus-platform-util-${MACHINE}", "vuplus-dvb-modules-${MACHINE}", d)} \
    "

DVBPROVIDER = "kernel"
DVB_CYPRESS ?= "kernel-module"

MACHINE_ESSENTIAL_EXTRA_RRECOMMENDS += "\
    kernel-module-cdfs \
    "

MACHINE_EXTRA_RRECOMMENDS += " \
    vuplus-shutdown \
    gstreamer1.0-plugin-dvbmediasink \
    gstreamer1.0-libav \
    "

include conf/machine/include/autoload-filesystems.inc

PREFERRED_PROVIDER_virtual/kernel = "linux-vuplus"
PREFERRED_PROVIDER_virtual/blindscan-dvbc = "vuplus-blindscan-utils"
PREFERRED_PROVIDER_virtual/blindscan-dvbs = "vuplus-blindscan-utils"
PREFERRED_PROVIDER_virtual/transtreamproxy = "vuplus-transtreamproxy"
PREFERRED_PROVIDER_virtual/egl ?= "vuplus-libgles-${MACHINE}"
PREFERRED_PROVIDER_virtual/libgles1 ?= "vuplus-libgles-${MACHINE}"
PREFERRED_PROVIDER_virtual/libgles2 ?= "vuplus-libgles-${MACHINE}"
PREFERRED_PROVIDER_virtual/libopencl ?= "vuplus-libgles-${MACHINE}"
PREFERRED_PROVIDER_virtual/libgbm ?= "vuplus-libgles-${MACHINE}"
PREFERRED_PROVIDER_virtual/libgl ?= "mesa"
PREFERRED_PROVIDER_virtual/mesa ?= "mesa"
PREFERRED_PROVIDER_virtual/kodi = "stb-kodi-${MACHINE}"

KERNEL_IMAGETYPE = "vmlinux"
KERNEL_OUTPUT = "${KERNEL_IMAGETYPE}"
KERNEL_CONSOLE = "ttyS0,115200n8"

UBI_VOLNAME = "rootfs"
MKUBIFS_ARGS = "-m 2048 -e 126976 -c ${MKFS_UBI_MAX_ERASE_BLK_COUNT} ${MKFS_EXTRA}"
UBINIZE_ARGS = "-m 2048 -p 128KiB"
EXTRA_IMAGECMD_COMPAT = "--eraseblock=0x20000 -n -l"

IMAGEDIR ?= "vuplus/${UPDATE_DIR}"

IMAGE_CMD:ubifs:prepend = " \
    rm -rf ${IMAGE_ROOTFS}/boot/*; \
    rm -rf ${IMAGE_ROOTFS}/tmp/*; \
    "

BOOTLOGO_FILENAME = "splash_cfe_auto.bin"

MACHINE_FEATURES += "3dtv alsa hdmicec switchoff bootsplash blindscan-tbs HDMI"

require conf/machine/include/soc-family.inc
require conf/machine/box-hardware.inc

# Add "MACHINEBUILD" override for recipes
MACHINEOVERRIDES =. "${@['', '${MACHINEBUILD}:']['${MACHINEBUILD}' != '']}"

BBMASK = "meta-octagon/"
BBMASK += "meta-fulan/recipes-graphics/"
```

## meta-brands/meta-vuplus/conf/machine/vuduo.conf
```bitbake
#@TYPE: Machine
#@NAME: Vu+ Duo
#@DESCRIPTION: Machine configuration for the Vu+ Duo

MACHINE_NAME = "Duo"
MTD_ROOTFS = "mtd0"
MTD_KERNEL = "mtd1"
KERNEL_FILE = "kernel_cfe_auto.bin"
ROOTFS_FILE = "root_cfe_auto.jffs2"

UPDATE_DIR = "duo"

require conf/machine/include/vuplus.inc

DVB_CYPRESS = "kernel-module-dvb-usb"

IMAGE_CMD_ubi_append = "\
    mkdir -p ${DEPLOY_DIR_IMAGE}/${IMAGEDIR}; \
    ${@bb.utils.contains("MACHINE_FEATURES", "bootsplash", "cp ${DEPLOY_DIR_IMAGE}/splash_cfe_auto.bin ${DEPLOY_DIR_IMAGE}/${IMAGEDIR}/splash_cfe_auto.bin;" , "", d)} \
    mv ${IMGDEPLOYDIR}/${IMAGE_NAME}.rootfs.ubi ${DEPLOY_DIR_IMAGE}/${IMAGEDIR}/${ROOTFS_FILE}; \
    gzip -f -9c ${DEPLOY_DIR_IMAGE}/vmlinux-${MACHINE}.bin > ${DEPLOY_DIR_IMAGE}/${IMAGEDIR}/${KERNEL_FILE}; \
    echo ${IMAGE_VER_STRING} > ${DEPLOY_DIR_IMAGE}/${IMAGEDIR}/imageversion; \
    echo "This file forces a reboot after the update." > ${DEPLOY_DIR_IMAGE}/${IMAGEDIR}/reboot.update; \
    cd ${DEPLOY_DIR_IMAGE}; \
    zip ${IMAGE_NAME}_usb.zip ${IMAGEDIR}/*; \
    rm -f ${DEPLOY_DIR_IMAGE}/*.ubi; \
    rm -f ${DEPLOY_DIR_IMAGE}/*.ubifs; \
    rm -f ${DEPLOY_DIR_IMAGE}/*.manifest; \
    rm -f ${DEPLOY_DIR_IMAGE}/.ubifs; \
    rm -f ${DEPLOY_DIR_IMAGE}/.manifest; \
    rm -Rf vuplus; \
    "

EXTRA_IMAGEDEPENDS = "vuplus-displayvfd"
MACHINE_EXTRA_RDEPENDS = "vuplus-displayvfd"

PREFERRED_VERSION_linux-vuplus = "3.9.6"
PREFERRED_VERSION_linux-libc-headers = "3.9"
MKFS_UBI_MAX_ERASE_BLK_COUNT = "4096"
MKFS_EXTRA = "-F"

TARGET_ARCH = "mipsel"
DEFAULTTUNE = "mips32el"
IMAGE_FSTYPES ?= "ubi"

MACHINE_FEATURES += "textlcd ci fanctrl skins1080 omb operahbbtv"

require conf/machine/include/tune-mips32.inc

SOC_FAMILY = "bcm7335"

DVBMEDIASINK_CONFIG = "--with-vuplus --with-pcm --with-eac3 --with-amr --with-wmv"
```

## meta-brands/meta-vuplus/conf/machine/vuduo2.conf
```bitbake
#@TYPE: Machine
#@NAME: Vu+ Duo2
#@DESCRIPTION: Machine configuration for the Vu+ Duo2

MACHINE_NAME = "Duo²"
MTD_ROOTFS = "mtd0"
MTD_KERNEL = "mtd2"
KERNEL_FILE = "kernel_cfe_auto.bin"
ROOTFS_FILE = "root_cfe_auto.bin"

FLASHSIZE = "1024"

UPDATE_DIR = "duo2"

require conf/machine/include/vuplus.inc

IMAGE_CMD_ubi_append = "\
    mkdir -p ${DEPLOY_DIR_IMAGE}/${IMAGEDIR}; \
    ${@bb.utils.contains("MACHINE_FEATURES", "bootsplash", "cp ${DEPLOY_DIR_IMAGE}/splash_cfe_auto.bin ${DEPLOY_DIR_IMAGE}/${IMAGEDIR}/splash_cfe_auto.bin;" , "", d)} \
    cp ${DEPLOY_DIR_IMAGE}/initrd_cfe_auto.bin ${DEPLOY_DIR_IMAGE}/${IMAGEDIR}/initrd_cfe_auto.bin; \
    mv ${IMGDEPLOYDIR}/${IMAGE_NAME}.rootfs.ubi ${DEPLOY_DIR_IMAGE}/${IMAGEDIR}/${ROOTFS_FILE}; \
    gzip -f -9c ${DEPLOY_DIR_IMAGE}/vmlinux-${MACHINE}.bin > ${DEPLOY_DIR_IMAGE}/${IMAGEDIR}/${KERNEL_FILE}; \
    echo ${IMAGE_VER_STRING} > ${DEPLOY_DIR_IMAGE}/${IMAGEDIR}/imageversion; \
    echo "This file forces a reboot after the update." > ${DEPLOY_DIR_IMAGE}/${IMAGEDIR}/reboot.update; \
    cd ${DEPLOY_DIR_IMAGE}; \
    zip ${IMAGE_NAME}_usb.zip ${IMAGEDIR}/*; \
    rm -f ${DEPLOY_DIR_IMAGE}/*.ubi; \
    rm -f ${DEPLOY_DIR_IMAGE}/*.ubifs; \
    rm -f ${DEPLOY_DIR_IMAGE}/*.manifest; \
    rm -f ${DEPLOY_DIR_IMAGE}/.ubifs; \
    rm -f ${DEPLOY_DIR_IMAGE}/.manifest; \
    rm -Rf vuplus; \
    "

EXTRA_IMAGEDEPENDS = "\
    vuplus-displayvfd \
    vuplus-initrd-cfe-vuduo2"

MACHINE_EXTRA_RDEPENDS = "\
    vuplus-coldboot \
    vuplus-ethwol \
    vuplus-displayvfd \
    vuplus-initrd-cfe-vuduo2 \
    enigma2-plugin-systemplugins-firmwareupgrade \
    enigma2-plugin-systemplugins-remotecontrolcode \
    enigma2-plugin-extensions-lcd4linux \
    "

PREFERRED_VERSION_linux-vuplus = "3.13.5"
PREFERRED_VERSION_linux-libc-headers = "3.13"
MKFS_UBI_MAX_ERASE_BLK_COUNT = "8192"

TARGET_ARCH = "mipsel"
DEFAULTTUNE = "mips32el"
IMAGE_FSTYPES ?= "ubi"

MACHINE_FEATURES += "vuprogress bwlcd140 ci dvb-c fan blindscan-dvbc blindscan-dvbs transcoding wol skins1080 uianimation dvbproxy kodi omb operahbbtv vuglesdemo"

require conf/machine/include/tune-mips32.inc 

SOC_FAMILY = "bcm7425"

DVBMEDIASINK_CONFIG = "--with-pcm --with-eac3 --with-amr --with-wmv"

BOOTLOGO_FILENAME = "splash_cfe_auto.bin"
```
