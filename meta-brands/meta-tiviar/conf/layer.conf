## meta-brands/meta-vuplus/conf/machine/vuduo4kse.conf
```bitbake
#@TYPE: Machine
#@NAME: Vu+ Duo4K SE
#@DESCRIPTION: Machine configuration for the Vu+ Duo4K SE

MACHINE_NAME = "Duo4K SE"
MTD_ROOTFS = "mmcblk0p9"
MTD_KERNEL = "mmcblk0p6"
KERNEL_FILE = "kernel_auto.bin"
ROOTFS_FILE = "rootfs.tar.bz2"
MTD_BLACK  = "mmcblk0"

FLASHSIZE = "4096"

UPDATE_DIR = "duo4kse"

DVBSKYPROVIDER = "kernel"

require conf/machine/include/vuplus.inc

IMAGE_CMD_tar_prepend = "\
    mkdir -p ${DEPLOY_DIR_IMAGE}/${IMAGEDIR}; \
    ${@bb.utils.contains("MACHINE_FEATURES", "bootsplash", "cp ${DEPLOY_DIR_IMAGE}/splash_cfe_auto.bin ${DEPLOY_DIR_IMAGE}/${IMAGEDIR}/splash_auto.bin;" , "", d)} \
    cp ${DEPLOY_DIR_IMAGE}/initrd_auto.bin ${DEPLOY_DIR_IMAGE}/${IMAGEDIR}/initrd_auto.bin; \
    cp ${DEPLOY_DIR_IMAGE}/zImage ${DEPLOY_DIR_IMAGE}/${IMAGEDIR}/${KERNEL_FILE}; \
    echo ${DISTRO_NAME}-${DISTRO_VERSION}.${BUILD_VERSION} > ${DEPLOY_DIR_IMAGE}/${IMAGEDIR}/imageversion; \
    echo "This file forces a reboot after the update." > ${DEPLOY_DIR_IMAGE}/${IMAGEDIR}/reboot.update; \
    echo "This file forces create partition and kernel update." > ${DEPLOY_DIR_IMAGE}/${IMAGEDIR}/mkpart.update; \
    cd ${IMAGE_ROOTFS}; \
    tar -cvf ${DEPLOY_DIR_IMAGE}/rootfs.tar -C ${IMAGE_ROOTFS} .; \
    mv ${DEPLOY_DIR_IMAGE}/rootfs.tar ${DEPLOY_DIR_IMAGE}/${IMAGEDIR}/rootfs.tar; \
    bzip2 ${DEPLOY_DIR_IMAGE}/${IMAGEDIR}/rootfs.tar; \
    cd ${DEPLOY_DIR_IMAGE}; \
    zip ${IMAGE_NAME}_usb.zip ${IMAGEDIR}/*; \
    rm -f ${DEPLOY_DIR_IMAGE}/*.rootfs.tar.bz2; \
    rm -f ${DEPLOY_DIR_IMAGE}/.tar.bz2; \
    rm -f ${DEPLOY_DIR_IMAGE}/*.manifest; \
    rm -f ${DEPLOY_DIR_IMAGE}/.manifest; \
    rm -Rf vuplus; \
"

EXTRA_IMAGEDEPENDS = "\
    vuplus-initrd-cfe-vuduo4kse \
    vuplus-wifi-util-vuduo4kse \
    vuplus-hdmi-in-helper \
    "

MACHINE_EXTRA_RDEPENDS = "\
    vuplus-initrd-cfe-vuduo4kse \
    enigma2-plugin-systemplugins-remotecontrolcode \
    vuplus-wifi-util-vuduo4kse \
    vuplus-hdmi-in-helper \
    "

PREFERRED_VERSION_linux-vuplus = "4.1.45"

MACHINE_FEATURES += "colorlcd480 ci dvb-c blindscan-dvbc blindscan-dvbs skins1080 dvbproxy kodi18 minitv webkithbbtv transcoding chromiumos omb mmc emmc fcc bluetooth vubluetooth quadpip vuglesdemo vustalker HDMI-IN-FHD"

TARGET_ARCH = "arm"
DEFAULTTUNE = "cortexa15hf-neon-vfpv4"
IMAGE_FSTYPES =+ "tar.bz2"

MACHINE_FEATURES_BACKFILL_CONSIDERED = "rtc gobject-introspection-data"

require conf/machine/include/tune-cortexa15.inc

SOC_FAMILY = "bcm7376"

DVBMEDIASINK_CONFIG = "--with-dtsdownmix --with-dts --with-pcm --with-eac3 --with-amr --with-wmv --with-vb6 --with-vb8 --with-vb9 --with-spark --with-h265"
```

## meta-brands/meta-vuplus/conf/machine/vusolo2.conf
```bitbake
#@TYPE: Machine
#@NAME: Vu+ Solo2
#@DESCRIPTION: Machine configuration for the Vu+ Solo2

MACHINE_NAME = "Solo²"
MTD_ROOTFS = "mtd0"
MTD_KERNEL = "mtd2"
KERNEL_FILE = "kernel_cfe_auto.bin"
ROOTFS_FILE = "root_cfe_auto.bin"

FLASHSIZE = "256"

UPDATE_DIR = "solo2"

require conf/machine/include/vuplus.inc

IMAGE_CMD_ubi_append = "\
    mkdir -p ${DEPLOY_DIR_IMAGE}/${IMAGEDIR}; \
    ${@bb.utils.contains("MACHINE_FEATURES", "bootsplash", "cp ${DEPLOY_DIR_IMAGE}/splash_cfe_auto.bin ${DEPLOY_DIR_IMAGE}/${IMAGEDIR}/splash_cfe_auto.bin;" , "", d)} \
    cp ${DEPLOY_DIR_IMAGE}/initrd_cfe_auto.bin ${DEPLOY_DIR_IMAGE}/${IMAGEDIR}/initrd_cfe_auto.bin; \
    mv ${IMGDEPLOYDIR}/${IMAGE_NAME}.rootfs.ubi ${DEPLOY_DIR_IMAGE}/${IMAGEDIR}/${ROOTFS_FILE}; \
    gzip -f -9c ${DEPLOY_DIR_IMAGE}/vmlinux-${MACHINE}.bin > ${DEPLOY_DIR_IMAGE}/${IMAGEDIR}/${KERNEL_FILE}; \
    echo ${IMAGE_VER_STRING} > ${DEPLOY_DIR_IMAGE}/${IMAGEDIR}/imageversion; \
    echo "This file forces a reboot after the update." > ${DEPLOY_DIR_IMAGE}/${IMAGEDIR}/reboot.update; \
    cd ${DEPLOY_DIR_IMAGE}; \
    zip ${IMAGE_NAME}_usb.zip ${IMAGEDIR}/*; \
    rm -f ${DEPLOY_DIR_IMAGE}/*.ubi; \
    rm -f ${DEPLOY_DIR_IMAGE}/*.ubifs; \
    rm -f ${DEPLOY_DIR_IMAGE}/*.manifest; \
    rm -f ${DEPLOY_DIR_IMAGE}/.ubifs; \
    rm -f ${DEPLOY_DIR_IMAGE}/.manifest; \
    rm -Rf vuplus; \
    "

EXTRA_IMAGEDEPENDS = "\
    vuplus-displayvfd \
    vuplus-initrd-cfe-vusolo2"

MACHINE_EXTRA_RDEPENDS = "\
    vuplus-displayvfd \
    vuplus-initrd-cfe-vusolo2 \
    enigma2-plugin-systemplugins-firmwareupgrade \
    enigma2-plugin-systemplugins-remotecontrolcode \
    "

PREFERRED_VERSION_linux-vuplus = "3.13.5"
PREFERRED_VERSION_linux-libc-headers = "3.13"
MKFS_UBI_MAX_ERASE_BLK_COUNT = "4096"

TARGET_ARCH = "mipsel"
DEFAULTTUNE = "mips32el"
IMAGE_FSTYPES ?= "ubi"

MACHINE_FEATURES += "textlcd ci fan blindscan-dvbs transcoding skins1080 uianimation dvbproxy kodi omb operahbbtv vuglesdemo"

require conf/machine/include/tune-mips32.inc

SOC_FAMILY = "bcm7346"

DVBMEDIASINK_CONFIG = "--with-pcm --with-eac3 --with-amr --with-wmv"
```

## meta-brands/meta-vuplus/conf/machine/vusolo4k.conf
```bitbake
#@TYPE: Machine
#@NAME: Vu+ Solo4k
#@DESCRIPTION: Machine configuration for the Vu+ Solo4K

MACHINE_NAME = "Solo4K"
MTD_ROOTFS = "mmcblk0p4"
MTD_KERNEL = "mmcblk0p1"
KERNEL_FILE = "kernel_auto.bin"
ROOTFS_FILE = "rootfs.tar.bz2"
MTD_BLACK  = "mmcblk0"

FLASHSIZE = "4096"

UPDATE_DIR = "solo4k"

DVBSKYPROVIDER = "kernel"

require conf/machine/include/vuplus.inc

IMAGE_CMD_tar_prepend = "\
    mkdir -p ${DEPLOY_DIR_IMAGE}/${IMAGEDIR}; \
    ${@bb.utils.contains("MACHINE_FEATURES", "bootsplash", "cp ${DEPLOY_DIR_IMAGE}/splash_cfe_auto.bin ${DEPLOY_DIR_IMAGE}/${IMAGEDIR}/splash_auto.bin;" , "", d)} \
    cp ${DEPLOY_DIR_IMAGE}/initrd_auto.bin ${DEPLOY_DIR_IMAGE}/${IMAGEDIR}/initrd_auto.bin; \
    cp ${DEPLOY_DIR_IMAGE}/zImage ${DEPLOY_DIR_IMAGE}/${IMAGEDIR}/${KERNEL_FILE}; \
    echo ${DISTRO_NAME}-${DISTRO_VERSION}.${BUILD_VERSION} > ${DEPLOY_DIR_IMAGE}/${IMAGEDIR}/imageversion; \
    echo "This file forces a reboot after the update." > ${DEPLOY_DIR_IMAGE}/${IMAGEDIR}/reboot.update; \
    cd ${IMAGE_ROOTFS}; \
    tar -cvf ${DEPLOY_DIR_IMAGE}/rootfs.tar -C ${IMAGE_ROOTFS} .; \
    mv ${DEPLOY_DIR_IMAGE}/rootfs.tar ${DEPLOY_DIR_IMAGE}/${IMAGEDIR}/rootfs.tar; \
    bzip2 ${DEPLOY_DIR_IMAGE}/${IMAGEDIR}/rootfs.tar; \
    cd ${DEPLOY_DIR_IMAGE}; \
    zip ${IMAGE_NAME}_usb.zip ${IMAGEDIR}/*; \
    rm -f ${DEPLOY_DIR_IMAGE}/*.rootfs.tar.bz2; \
    rm -f ${DEPLOY_DIR_IMAGE}/.tar.bz2; \
    rm -f ${DEPLOY_DIR_IMAGE}/*.manifest; \
    rm -f ${DEPLOY_DIR_IMAGE}/.manifest; \
    rm -Rf vuplus; \
"

EXTRA_IMAGEDEPENDS = "\
    vuplus-displayvfd \
    vuplus-initrd-cfe-vusolo4k"

MACHINE_EXTRA_RDEPENDS = "\
    vuplus-displayvfd \
    vuplus-initrd-cfe-vusolo4k \
    enigma2-plugin-systemplugins-remotecontrolcode \
    "

PREFERRED_VERSION_linux-vuplus = "3.14.28"
PREFERRED_VERSION_linux-libc-headers = "3.13"

MACHINE_FEATURES += "colorlcd480 ci dvb-c blindscan-dvbc blindscan-dvbs skins1080 uianimation dvbproxy kodi minitv webkithbbtv transcoding chromiumos omb mmc emmc fcc bluetooth vubluetooth quadpip vuglesdemo"

TARGET_ARCH = "arm"
DEFAULTTUNE = "cortexa15hf-neon-vfpv4"
IMAGE_FSTYPES =+ "tar.bz2"

MACHINE_FEATURES_BACKFILL_CONSIDERED = "rtc gobject-introspection-data"

require conf/machine/include/tune-cortexa15.inc

SOC_FAMILY = "bcm7376"

DVBMEDIASINK_CONFIG = "--with-dtsdownmix --with-dts --with-pcm --with-eac3 --with-amr --with-wmv --with-vb6 --with-vb8 --with-spark --with-h265"
```

## meta-brands/meta-vuplus/conf/machine/vusolose.conf
```bitbake
#@TYPE: Machine
#@NAME: Vu+ Solo SE
#@DESCRIPTION: Machine configuration for the Vu+ Solo SE

MACHINE_NAME = "Solo SE"
MTD_ROOTFS = "mtd0"
MTD_KERNEL = "mtd2"
KERNEL_FILE = "kernel_cfe_auto.bin"
ROOTFS_FILE = "root_cfe_auto.bin"

# Solo SE V2 has 512MB, but the images are supposed to work on both, so use the smaller value from V1:
FLASHSIZE = "256"


UPDATE_DIR = "solose"

require conf/machine/include/vuplus.inc

IMAGE_CMD_ubi_append = "\
    mkdir -p ${DEPLOY_DIR_IMAGE}/${IMAGEDIR}; \
    ${@bb.utils.contains("MACHINE_FEATURES", "bootsplash", "cp ${DEPLOY_DIR_IMAGE}/splash_cfe_auto.bin ${DEPLOY_DIR_IMAGE}/${IMAGEDIR}/splash_cfe_auto.bin;" , "", d)} \
    cp ${DEPLOY_DIR_IMAGE}/initrd_cfe_auto.bin ${DEPLOY_DIR_IMAGE}/${IMAGEDIR}/initrd_cfe_auto.bin; \
    mv ${IMGDEPLOYDIR}/${IMAGE_NAME}.rootfs.ubi ${DEPLOY_DIR_IMAGE}/${IMAGEDIR}/${ROOTFS_FILE}; \
    gzip -f -9c ${DEPLOY_DIR_IMAGE}/vmlinux-${MACHINE}.bin > ${DEPLOY_DIR_IMAGE}/${IMAGEDIR}/${KERNEL_FILE}; \
    echo ${IMAGE_VER_STRING} > ${DEPLOY_DIR_IMAGE}/${IMAGEDIR}/imageversion; \
    echo "This file forces the update." > ${DEPLOY_DIR_IMAGE}/${IMAGEDIR}/force.update; \
    cd ${DEPLOY_DIR_IMAGE}; \
    zip ${IMAGE_NAME}_usb.zip ${IMAGEDIR}/*; \
    rm -f ${DEPLOY_DIR_IMAGE}/*.ubi; \
    rm -f ${DEPLOY_DIR_IMAGE}/*.ubifs; \
    rm -f ${DEPLOY_DIR_IMAGE}/*.manifest; \
    rm -f ${DEPLOY_DIR_IMAGE}/.ubifs; \
    rm -f ${DEPLOY_DIR_IMAGE}/.manifest; \
    rm -Rf vuplus; \
    "

EXTRA_IMAGEDEPENDS = "\
    vuplus-initrd-cfe-vusolose \
    "

MACHINE_EXTRA_RDEPENDS = "\
    vuplus-initrd-cfe-vusolose \
    enigma2-plugin-systemplugins-firmwareupgrade \
    enigma2-plugin-systemplugins-remotecontrolcode \
    vuplus-pau \
    "

PREFERRED_VERSION_linux-vuplus = "3.13.5"
PREFERRED_VERSION_linux-libc-headers = "3.13"
MKFS_UBI_MAX_ERASE_BLK_COUNT = "4096"

TARGET_ARCH = "mipsel"
DEFAULTTUNE = "mips32el"
IMAGE_FSTYPES ?= "ubi"

MACHINE_FEATURES += "textlcd ci fan blindscan-dvbs blindscan-dvbc transcoding skins1080 uianimation dvbproxy kodi omb operahbbtv vuglesdemo"

require conf/machine/include/tune-mips32.inc

SOC_FAMILY = "bcm7241"

DVBMEDIASINK_CONFIG = "--with-pcm --with-eac3 --with-amr --with-wmv"
```

## meta-brands/meta-vuplus/conf/machine/vuultimo.conf
```bitbake
#@TYPE: Machine
#@NAME: Vu+ Ultimo
#@DESCRIPTION: Machine configuration for the Vu+ Ultimo

MACHINE_NAME = "Ultimo"
MTD_ROOTFS = "mtd0"
MTD_KERNEL = "mtd1"
KERNEL_FILE = "kernel_cfe_auto.bin"
ROOTFS_FILE = "root_cfe_auto.jffs2"

FLASHSIZE=1024

UPDATE_DIR = "ultimo"

require conf/machine/include/vuplus.inc

DVB_CYPRESS = "kernel-module-dvb-usb"

IMAGE_CMD_ubi_append = "\
    mkdir -p ${DEPLOY_DIR_IMAGE}/${IMAGEDIR}; \
    ${@bb.utils.contains("MACHINE_FEATURES", "bootsplash", "cp ${DEPLOY_DIR_IMAGE}/splash_cfe_auto.bin ${DEPLOY_DIR_IMAGE}/${IMAGEDIR}/splash_cfe_auto.bin;" , "", d)} \
    mv ${IMGDEPLOYDIR}/${IMAGE_NAME}.rootfs.ubi ${DEPLOY_DIR_IMAGE}/${IMAGEDIR}/${ROOTFS_FILE}; \
    gzip -f -9c ${DEPLOY_DIR_IMAGE}/vmlinux-${MACHINE}.bin > ${DEPLOY_DIR_IMAGE}/${IMAGEDIR}/${KERNEL_FILE}; \
    echo ${IMAGE_VER_STRING} > ${DEPLOY_DIR_IMAGE}/${IMAGEDIR}/imageversion; \
    echo "This file forces a reboot after the update." > ${DEPLOY_DIR_IMAGE}/${IMAGEDIR}/reboot.update; \
    cd ${DEPLOY_DIR_IMAGE}; \
    zip ${IMAGE_NAME}_usb.zip ${IMAGEDIR}/*; \
    rm -f ${DEPLOY_DIR_IMAGE}/*.ubi; \
    rm -f ${DEPLOY_DIR_IMAGE}/*.ubifs; \
    rm -f ${DEPLOY_DIR_IMAGE}/*.manifest; \
    rm -f ${DEPLOY_DIR_IMAGE}/.ubifs; \
    rm -f ${DEPLOY_DIR_IMAGE}/.manifest; \
    rm -Rf vuplus; \
    "

EXTRA_IMAGEDEPENDS = "\
    vuplus-displayvfd \
    enigma2-plugin-systemplugins-firmwareupgrade \
    enigma2-plugin-systemplugins-remotecontrolcode \
    "

MACHINE_EXTRA_RDEPENDS = "\
    vuplus-displayvfd \
    enigma2-plugin-systemplugins-firmwareupgrade \
    enigma2-plugin-systemplugins-remotecontrolcode \
    "

PREFERRED_VERSION_linux-vuplus = "3.9.6"
PREFERRED_VERSION_linux-libc-headers = "3.9"
MKFS_UBI_MAX_ERASE_BLK_COUNT = "3894"
MKFS_EXTRA = "-F"

TARGET_ARCH = "mipsel"
DEFAULTTUNE = "mips32el"
IMAGE_FSTYPES ?= "ubi"

MACHINE_FEATURES += "bwlcd255 ci dvb-c fan blindscan-dvbc blindscan-dvbs skins1080 omb operahbbtv"

require conf/machine/include/tune-mips32.inc

SOC_FAMILY = "bcm7413"

DVBMEDIASINK_CONFIG = "--with-pcm --with-eac3 --with-amr --with-wmv"
```
