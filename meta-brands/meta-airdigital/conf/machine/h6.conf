## meta-brands/meta-anadol/conf/machine/include/anadol-hisi.inc
```bitbake
PACKAGECONFIG_GL:pn-qtbase = "gles2 eglfs linuxfb"
PACKAGECONFIG_FB:pn-qtbase = " "

# We know about rtc
include conf/machine/include/build-extras.inc

DISTRO_FEATURES:remove = "x11 wayland"

BRAND_OEM = "anadol"

IMAGEDIR = "anadol/${MACHINE}"

MACHINE_BRAND = "ANADOL"

KERNEL_FILE = "kernel.bin"
ROOTFS_FILE = "rootfs.tar.bz2"
MTD_BLACK  = "mmcblk0"

VER = "-sf8008"

MACHINE_ESSENTIAL_EXTRA_RDEPENDS += "\
    anadol-dvb-modules-${MACHINE} \
    anadol-loadmodules-${SOC_FAMILY} \ 
    anadol-opengl-${SOC_FAMILY} \
    anadol-libs-${MACHINE} \
    anadol-hihalt-${SOC_FAMILY} \
    anadol-reader-${MACHINE} \
    anadol-libreader-${SOC_FAMILY} \
    anadol-partitions-${MACHINE} \
    anadol-tntfs-${HICHIPSET} \
    anadol-buildimage \
    e2fsprogs-resize2fs \
    gptfdisk \
"

MACHINE_FEATURES += "hisil switchoff hdmicec skins1080 emmc mmc kodi21 alsa hbbtv-browser-webkit qtstalker qtnetflix openhbbtv event0 hisichromium mali HDMISTANDBY"

IMAGE_CLASSES  += "anadol-emmc_image"
IMAGE_FSTYPES += "anadolemmc"
IMAGE_ROOTFS_SIZE ?= "524288"

TARGET_ARCH = "arm"
DEFAULTTUNE = "cortexa15hf-neon-vfpv4"

PREFERRED_VERSION_linux-anadol = "${LINUX_VERSION}"

PREFERRED_PROVIDER_virtual/kernel = "linux-anadol"
PREFERRED_PROVIDER_virtual/egl = "anadol-opengl-${SOC_FAMILY}" 
PREFERRED_PROVIDER_virtual/libgles1 = "anadol-opengl-${SOC_FAMILY}"
PREFERRED_PROVIDER_virtual/libgles2 = "anadol-opengl-${SOC_FAMILY}"
PREFERRED_PROVIDER_virtual/kodi = "stb-kodi-${MACHINE}"

PREFERRED_RPROVIDER_showiframe = "anadol-showiframe-${SOC_FAMILY}"
PREFERRED_RPROVIDER_aio-grab = "anadol-grab-${SOC_FAMILY}"

require conf/machine/include/arm/armv7a/tune-cortexa15.inc

MACHINE_EXTRA_RRECOMMENDS += " \
    gstreamer1.0-plugin-dvbmediasink \
    gstreamer1.0-libav \
    ${@bb.utils.contains('MACHINE', 'ip8', 'enigma2-plugin-extensions-gbipboxclient' , '', d)} \
    ${@bb.utils.contains('MACHINE', 'ip8', 'enigma2-plugin-systemplugins-satipclient' , '', d)} \
    ${@bb.utils.contains('MACHINE', 'ip8', 'enigma2-plugin-extensions-youtube' , '', d)} \
    "

DVBPROVIDER = "kernel"
DVBSKYPROVIDER = "kernel"

include conf/machine/include/autoload-filesystems.inc
require conf/machine/include/soc-family.inc
require conf/machine/box-hardware.inc

DVBMEDIASINK_CONFIG = "--with-h265 --with-vb8 --with-vb9 --with-spark --with-wma --with-wmv --with-pcm --with-dts --with-eac3"

IMAGE_CMD:anadolemmc:append = "\
	mkdir -p ${IMAGE_ROOTFS}/usr/lib; \
	if [ "${PACKAGE_LIST}" = "1" ]; then \
        cp ${IMAGE_MANIFEST} ${IMAGE_ROOTFS}/usr/lib/package.lst; \
    fi; \
    mkdir -p ${DEPLOY_DIR_IMAGE}/${IMAGEDIR}; \
    mv ${IMGDEPLOYDIR}/${IMAGE_NAME}.ext4 ${DEPLOY_DIR_IMAGE}/${MACHINE}-partitions/rootfs.ext4; \
    cd ${IMAGE_ROOTFS}; \
    tar -cvf ${DEPLOY_DIR_IMAGE}/rootfs.tar -C ${IMAGE_ROOTFS} .; \
    mv ${DEPLOY_DIR_IMAGE}/rootfs.tar ${DEPLOY_DIR_IMAGE}/${IMAGEDIR}/rootfs.tar; \
    bzip2 ${DEPLOY_DIR_IMAGE}/${IMAGEDIR}/rootfs.tar; \
    cp ${DEPLOY_DIR_IMAGE}/uImage ${DEPLOY_DIR_IMAGE}/${IMAGEDIR}/${KERNEL_FILE}; \
    cp ${DEPLOY_DIR_IMAGE}/uImage ${DEPLOY_DIR_IMAGE}/${MACHINE}-partitions/${KERNEL_FILE}; \
    if [ -e ${DEPLOY_DIR_IMAGE}/logo-${DISTRO_NAME}.img ]; then \
        cp -f ${DEPLOY_DIR_IMAGE}/logo-${DISTRO_NAME}.img ${DEPLOY_DIR_IMAGE}/${MACHINE}-partitions/logo.img; \
    fi; \
    echo ${IMAGE_VER_STRING} > ${DEPLOY_DIR_IMAGE}/${IMAGEDIR}/imageversion; \
    cd ${DEPLOY_DIR_IMAGE}/${MACHINE}-partitions; \
    mkupdate -s 00000003-00000001-01010101 -f ${DEPLOY_DIR_IMAGE}/${MACHINE}-partitions/emmc_partitions.xml -d ${DEPLOY_DIR_IMAGE}/usb_update.bin; \ 
    cd ${DEPLOY_DIR_IMAGE}; \
    cp ${IMGDEPLOYDIR}/${IMAGE_NAME}.manifest ${IMAGE_NAME}_usb.zip.manifest; \
    zip -j ${IMAGE_NAME}_recovery_emmc.zip ${DEPLOY_DIR_IMAGE}/usb_update.bin ${DEPLOY_DIR_IMAGE}/${IMAGEDIR}/imageversion ${DEPLOY_DIR_IMAGE}/${MACHINE}-partitions/bootargs.bin ${DEPLOY_DIR_IMAGE}/${MACHINE}-partitions/fastboot.bin ${DEPLOY_DIR_IMAGE}/${MACHINE}-partitions/apploader.bin; \
    zip ${IMAGE_NAME}_mmc.zip ${IMAGEDIR}/*; \
    rm -f ${DEPLOY_DIR_IMAGE}/*.ext4; \
    rm -f ${DEPLOY_DIR_IMAGE}/.ext4; \
    rm -f -f ${DEPLOY_DIR_IMAGE}/*.json; \
    rm -Rf ${DEPLOY_DIR_IMAGE}/usb_update.bin; \
    rm -Rf ${IMAGEDIR}; \
    rm -Rf ${IMGDEPLOYDIR}/userdata; \
    "

# Add "MACHINEBUILD" override for recipes
MACHINEOVERRIDES =. "${@['', '${MACHINEBUILD}:']['${MACHINEBUILD}' != '']}"

BBMASK = "meta-vuplus/recipes-graphics/"
BBMASK += "meta-fulan/recipes-graphics/"
BBMASK += "meta-vuplus/recipes-webkit/"
```

## meta-brands/meta-anadol/conf/machine/ip8.conf
```bitbake
#@TYPE: Machine
#@NAME: ip8
#@DESCRIPTION: Machine configuration for the ip8

EXTRA_OECONF:append:pn-enigma2 = "--with-lcddev=/dev/null --with-alphablendingacceleration=always --with-blitaccelerationthreshold=250  --with-fillaccelerationthreshold=190000 --with-subttxtabnormalptsdiffs=3600000"

MACHINE_FEATURES += " no-subssupport HDMI AV_JACK multitranscoding"

SOC_FAMILY = "hisi3798mv200advca"
HICHIPSET = "3798mv200advca"
LINUX_VERSION = "4.4.176"

MACHINE_NAME = "IP8 4K"
RCNAME = "anadol4"

MTD_KERNEL = "mmcblk0p15"
MTD_ROOTFS = "mmcblk0p19"

require conf/machine/include/anadol-hisi.inc
```

## meta-brands/meta-ax/conf/layer.conf
```bitbake
# We have a conf and classes directory, append to BBPATH
BBPATH .= ":${LAYERDIR}"

# We have a recipes directory, add to BBFILES
BBFILES += "${LAYERDIR}/recipes-*/*.bb ${LAYERDIR}/recipes-*/*.bbappend \
            ${LAYERDIR}/recipes-*/*/*.bb ${LAYERDIR}/recipes-*/*/*.bbappend"

BBFILE_COLLECTIONS += "ax-layer"
BBFILE_PATTERN_ax-layer := "^${LAYERDIR}/"
BBFILE_PRIORITY_ax-layer = "7"

LAYERSERIES_COMPAT_ax-layer = "sumo"

OEA-META-AX-BASE := '${@os.path.normpath("${LAYERDIR}/")}'
```

## meta-brands/meta-ax/conf/machine/include/ax.inc
```bitbake
# We know about rtc
include conf/machine/include/build-extras.inc

BRAND_OEM = "ax"
MACHINE_BRAND = "AX"

MTD_KERNEL = "mtd1"
MTD_ROOTFS = "mtd2"
KERNEL_FILE = "kernel.bin"
ROOTFS_FILE = "rootfs.bin"

MACHINE_ESSENTIAL_EXTRA_RDEPENDS = "\
    ax-dvb-modules-${MACHINE} \
    "

DVBPROVIDER = "kernel"
DVBSKYPROVIDER = "kernel"

MACHINE_ESSENTIAL_EXTRA_RRECOMMENDS = "\
    kernel-module-cdfs \
    "

MACHINE_EXTRA_RRECOMMENDS = " \
    gstreamer1.0-plugin-dvbmediasink \
    "

include conf/machine/include/autoload-filesystems.inc

DVBMEDIASINK_CONFIG = "--with-wma --with-wmv --with-pcm --with-dts --with-eac3 \
    ${@bb.utils.contains('MACHINE', 'ultrabox', '--with-h265 --with-vb6 --with-vb8 --with-spark' , '', d)} \
"

TARGET_ARCH = "mipsel"
DEFAULTTUNE = "mips32el"

PREFERRED_PROVIDER_virtual/kernel = "linux-ax"

KERNEL_IMAGETYPE = "vmlinux"
KERNEL_OUTPUT = "${KERNEL_IMAGETYPE}"
KERNEL_CONSOLE = "ttyS0,115200n8"

IMAGE_FSTYPES ?= "ubi"

IMAGEDIR ?= "${MACHINE}"

IMAGE_CMD_ubi_prepend = " \
    rm -rf ${IMAGE_ROOTFS}/boot/*; \
    rm -rf ${IMAGE_ROOTFS}/tmp/*; \
    "

IMAGE_CMD_ubi_append = "\
    mkdir -p ${DEPLOY_DIR_IMAGE}/${IMAGEDIR}; \
    mv ${IMGDEPLOYDIR}/${IMAGE_NAME}.rootfs.ubi ${DEPLOY_DIR_IMAGE}/${IMAGEDIR}/${ROOTFS_FILE}; \
    gzip -9c ${DEPLOY_DIR_IMAGE}/vmlinux-${MACHINE}.bin > ${DEPLOY_DIR_IMAGE}/${IMAGEDIR}/${KERNEL_FILE}; \
    echo ${IMAGE_VER_STRING} > ${DEPLOY_DIR_IMAGE}/${IMAGEDIR}/imageversion; \
    echo "rename this file to 'force' to force an update without confirmation" > ${DEPLOY_DIR_IMAGE}/${IMAGEDIR}/noforce; \
    cd ${DEPLOY_DIR_IMAGE}; \
    zip ${IMAGE_NAME}_usb.zip ${IMAGEDIR}/*; \
    rm -f ${DEPLOY_DIR_IMAGE}/*.ubi; \
    rm -f ${DEPLOY_DIR_IMAGE}/*.ubifs; \
    rm -f ${DEPLOY_DIR_IMAGE}/*.manifest; \
    rm -f ${DEPLOY_DIR_IMAGE}/.ubifs; \
    rm -f ${DEPLOY_DIR_IMAGE}/.manifest; \
    rm -Rf ${IMAGEDIR}; \
    "


MACHINE_FEATURES += "3dtv alsa hdmicec switchoff omb boxmodel feature1"

BOOTLOGO_FILENAME = "splash.bin"

require conf/machine/include/tune-mips32.inc
require conf/machine/include/soc-family.inc

# Add "MACHINEBUILD" override for recipes
MACHINEOVERRIDES =. "${@['', '${MACHINEBUILD}:']['${MACHINEBUILD}' != '']}"
```

## meta-brands/meta-ax/conf/machine/triplex.conf
```bitbake
#@TYPE: Machine
#@NAME: AX Triplex
#@DESCRIPTION: Machine configuration for the AX Triplex

MACHINE_NAME = "Triplex"

# Actually the box has 512MB, but cfe can only flash up to 100MB
# As this variable is used to determine the acceptable preload, use the lower value
FLASHSIZE = "96"

PREFERRED_VERSION_linux-ax = "4.10.6"

SOC_FAMILY = "bcm7356"

UBI_VOLNAME = "rootfs"
MKUBIFS_ARGS = "-m 2048 -e 126976 -c 8192"
UBINIZE_ARGS = "-m 2048 -p 128KiB"

require conf/machine/include/ax.inc

MACHINE_FEATURES += "dvb-c ci textlcd videoenhancement fan blindscan-tbs linuxwifi v3d kodi19 RCA SCART YUV"

MACHINE_KERNEL_PR = "r0"
```

## meta-brands/meta-ax/conf/machine/ultrabox.conf
```bitbake
#@TYPE: Machine
#@NAME: AX Ultrabox
#@DESCRIPTION: Machine configuration for the AX Ultrabox

MACHINE_NAME = "Ultrabox"

FLASHSIZE = "1024"

PREFERRED_VERSION_linux-ax = "4.7.6"
PREFERRED_VERSION_linux-libc-headers = "4.7"

SOC_FAMILY = "bcm73625"

UBI_VOLNAME = "rootfs"
MKUBIFS_ARGS = "-m 2048 -e 126976 -c 8192"
UBINIZE_ARGS = "-m 2048 -p 128KiB"

require conf/machine/include/ax.inc

MACHINE_FEATURES += "videoenhancement skins1080 linuxwifi"

MACHINE_KERNEL_PR = "r0"

IMAGE_CMD_ubi_prepend = " \
    rm -rf ${IMAGE_ROOTFS}/boot/*; \
    rm -rf ${IMAGE_ROOTFS}/tmp/*; \
    "
```

## meta-brands/meta-azbox/conf/machine/azboxhd.conf
```bitbake
#@TYPE: Machine
#@NAME: AZBox HD
#@DESCRIPTION: Machine configuration for the AZBox HD

MACHINE_NAME = "HD"

require conf/machine/include/azbox-331.inc

MACHINE_ESSENTIAL_EXTRA_RRECOMMENDS = " \
    kernel-module-rt61pci \
    kernel-module-rt2x00pci \
    kernel-module-rt2x00lib \
    kernel-module-mac80211 \
    kernel-module-eeprom_93cx6 \
    rt61-firmware \
    domextender \
    "

EXTRA_IMAGEDEPENDS += " \
    kmod-native \
    "

IMAGE_DEPENDS_azboxcramfs_append = " \
    azbox-hd-buildimage-native \
    "

MACHINE_FEATURES += "ci smallflash"

SOC_FAMILY = "smp8634"

###  Wifi ###
KERNEL_MODULE_AUTOLOAD += "rt61pci"
KERNEL_MODULE_AUTOLOAD += "rt2x00pci"
KERNEL_MODULE_AUTOLOAD += "rt2x00lib"
KERNEL_MODULE_AUTOLOAD += "mac80211"
KERNEL_MODULE_AUTOLOAD += "eeprom_93cx6"

IMAGE_FSTYPES = "azboxcramfs"

IMAGE_CMD_azboxcramfs_append = "\
    rm -f ${DEPLOY_DIR_IMAGE}/*.manifest; \
    rm -f ${DEPLOY_DIR_IMAGE}/.manifest; \
    rm -fR ${IMAGE_ROOTFS}/boot/*; \
    mkfs.cramfs ${IMAGE_ROOTFS} ${DEPLOY_DIR_IMAGE}/azboxhd.cramfs; \
    pack_e2 -t OE-A \
    -d Alliance \
    -a Enigma2 \
    -v ${AZVERSION}.${AZREVISION} \
    -i ${DEPLOY_DIR_IMAGE}/azboxhd.cramfs \
    -k ${DEPLOY_DIR_IMAGE}/zbimage-linux-xload -K ULK-3.3.1 \
    -p ${DEPLOY_DIR_IMAGE}/patch.e2; \
    rm -f ${DEPLOY_DIR_IMAGE}/*.tgz; \
    rm -f ${DEPLOY_DIR_IMAGE}/*.cramfs; \
    cd ${DEPLOY_DIR_IMAGE}; \
    zip ${IMAGE_NAME}_azup.zip patch.e2; \
    rm -f ${DEPLOY_DIR_IMAGE}/*.e2; \
"

TARGET_ARCH = "mipsel"
DEFAULTTUNE = "mips32el"
```

## meta-brands/meta-azbox/conf/machine/include/azbox-331.inc
```bitbake
# We know about rtc
include conf/machine/include/build-extras.inc

BRAND_OEM = "azbox"
MACHINE_BRAND = "AZBOX"

MACHINE_ESSENTIAL_EXTRA_RDEPENDS = " \
    azbox-dvb-modules-331 \
    "

DVBPROVIDER = "kernel"

MACHINE_EXTRA_RRECOMMENDS = " \
    gst-plugin-azbox-dvbmediasink \
    azbox-mrua \
    azbox-compat \
    kernel-module-cifs \
    "

DVBMEDIASINK_CONFIG = "--with-wma --with-wmv --with-pcm --with-dtsdownmix"

MACHINE_FEATURES += " kernel26 alsa usbhost wifi nl80211 3dtv switchoff lpcm textlcd 32bpp hdtv dvbapi5 dvb-c blindscan-dvbs boxmodel"

PREFERRED_VERSION_linux-azbox = "3.3.1"
PREFERRED_VERSION_linux-libc-headers = "3.3"
PREFERRED_VERSION_nfs-utils ?= "1.2.8"

GLIBC_EXTRA_OECONF = "--with-tls --with-__thread"

PREFERRED_PROVIDER_virtual/kernel = "linux-azbox"
PREFERRED_PROVIDER_virtual/blindscan-dvbs = "azbox-blindscan-dvbs-utils"

require conf/machine/include/tune-mips32.inc
include conf/machine/include/autoload-filesystems.inc

SYSVINIT_ENABLED_GETTYS = ""

EXTRA_IMAGEDEPENDS += " \
    enigma2-plugin-systemplugins-rtisys \
    enigma2-plugin-systemplugins-videosettingssetup \
    kmod \
    "

MACHINE_EXTRA_RDEPENDS_${PN} = " \
    enigma2-plugin-systemplugins-rtisys \
    enigma2-plugin-systemplugins-videosettingssetup \
    "
```
