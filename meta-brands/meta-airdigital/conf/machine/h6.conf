## meta-brands/meta-airdigital/conf/machine/h6.conf
```bitbake
SOC_FAMILY = "bcm73625"

FLASHSIZE = "256"

UBI_VOLNAME = "rootfs"
MKUBIFS_ARGS = "-m 2048 -e 126976 -c 8192"
UBINIZE_ARGS = "-m 2048 -p 128KiB"

MACHINE_FEATURES += "videoenhancement ci 7segment textlcd"

require conf/machine/include/airdigital-mipsel.inc

MACHINE_KERNEL_PR = "r0"
```

## meta-brands/meta-airdigital/conf/machine/h8.conf
```bitbake
#@TYPE: Machine
#@NAME: h8
#@DESCRIPTION: Machine configuration for the h8

SOC_FAMILY = "hisi3716mv430"
HICHIPSET = "3716mv430"
HAVE_GLES = ""
VER = "-v2"

RCTYPE = "25"
RCNAME = "zgemma3"

MTD_KERNEL = "mtd8"
MTD_ROOTFS = "mtd9"
KERNEL_FILE = "uImage"
ROOTFS_FILE = "rootfs.ubi"

IMAGE_CLASSES += " zgemma-yaffs_image"
IMAGE_FSTYPES += "ubi zgemmayaffs"

MACHINE_FEATURES += " hisil-3716mv430 hisi-recovery dvb-c himedia adwol no-opengl skins1080"

EXTRA_OECONF:append:pn-enigma2 = " --with-alphablendingacceleration=always --with-blitaccelerationthreshold=250 --with-fillaccelerationthreshold=190000"

require conf/machine/include/zgemma-hisil-3716mv430.inc

BBMASK = "meta-vuplus/recipes-graphics/"
BBMASK += "meta-vuplus/recipes-webkit/"
```

## meta-brands/meta-airdigital/conf/machine/h9.conf
```bitbake
#@TYPE: Machine
#@NAME: h9
#@DESCRIPTION: Machine configuration for the h9

SOC_FAMILY = "hisi3798mv200"
HICHIPSET = "3798mv200"
VER = "-v2"

MTD_KERNEL = "mtd6"
MTD_ROOTFS = "mtd7"
KERNEL_FILE = "uImage"
ROOTFS_FILE = "rootfs.ubi"

IMAGE_FSTYPES += "ubi"

MACHINE_FEATURES += " hisil-3798mv200 mali skins1080 multitranscoding kodi19 himedia no-subssupport adwol SDcard emmc \
    ${@bb.utils.contains('MACHINEBUILD', 'zgemmah9t', ' dvb-c dvbc-only' , '', d)} \
    ${@bb.utils.contains('MACHINEBUILD', 'zgemmah9splus', ' ci blindscan-dvbs' , '', d)} \
    ${@bb.utils.contains('MACHINEBUILD', 'zgemmah9s', ' blindscan-dvbs' , '', d)} \
    ${@bb.utils.contains('MACHINEBUILD', 'zgemmah92s', ' blindscan-dvbs' , '', d)} \
    ${@bb.utils.contains('MACHINEBUILD', 'zgemmah92h', ' blindscan-dvbs dvb-c' , '', d)} \
"

EXTRA_OECONF_append_pn-enigma2 += " --with-alphablendingacceleration=always --with-blitaccelerationthreshold=250  --with-fillaccelerationthreshold=190000"

require conf/machine/include/airdigital-hisil-3798mv200.inc

BBMASK = "meta-vuplus/recipes-graphics/"
BBMASK += "meta-vuplus/recipes-webkit/"
BBMASK += "meta-oe/recipes-qt5.14/"
```

## meta-brands/meta-airdigital/conf/machine/h9combo.conf
```bitbake
#@TYPE: Machine
#@NAME: h9
#@DESCRIPTION: Machine configuration for the h9combo

SOC_FAMILY = "hisi3798mv200"
HICHIPSET = "3798mv200"
VER = "-v2"

IMAGE_CLASSES += " airdigital-fastboot8gb_image"

MTD_BOOTFS = "mmcblk0p4"
MTD_ROOTFS = "mmcblk0p19"
MTD_KERNEL = "mmcblk0p18"
KERNEL_FILE = "uImage"
ROOTFS_FILE = "rootfs.tar.bz2"
MTD_BLACK  = "mmcblk0"

IMAGE_FSTYPES += "zgemmafastboot8gb tar"

MACHINE_FEATURES += " hisil-3798mv200 mali emmc 7segment skins1080 multitranscoding kodi19 himedia no-subssupport blindscan-dvbs ci adwol hisi-recovery mountboot \
${@bb.utils.contains('MACHINEBUILD', 'zgemmah9combo', 'dvb-c' , '', d)} \
"

EXTRA_OECONF_append_pn-enigma2 += " --with-alphablendingacceleration=always --with-blitaccelerationthreshold=250  --with-fillaccelerationthreshold=190000"

require conf/machine/include/airdigital-hisil-3798mv200.inc

BBMASK = "meta-vuplus/recipes-graphics/"
BBMASK += "meta-vuplus/recipes-webkit/"
BBMASK += "meta-oe/recipes-qt5.14/"
```

## meta-brands/meta-airdigital/conf/machine/h9combose.conf
```bitbake
#@TYPE: Machine
#@NAME: h9combose
#@DESCRIPTION: Machine configuration for the h9combose

SOC_FAMILY = "hisi3798mv200"
HICHIPSET = "3798mv200"
VER = "-v2"

RCTYPE = "28"
RCNAME = "zgemma3"

IMAGE_CLASSES += " airdigital-fastboot8gb_image"

MTD_BOOTFS = "mmcblk0p4"
MTD_ROOTFS = "mmcblk0p23"
MTD_KERNEL = "mmcblk0p19"
KERNEL_FILE = "uImage"
ROOTFS_FILE = "rootfs.tar.bz2"
MTD_BLACK  = "mmcblk0"

IMAGE_FSTYPES += "zgemmafastboot8gb tar"

MACHINE_FEATURES += " hisil-3798mv200 mali emmc 7segment skins1080 multitranscoding kodi22 himedia no-subssupport blindscan-dvbs ci adwol hisi-recovery mountboot hbbtv-browser-webkit \
${@bb.utils.contains('MACHINEBUILD', 'zgemmah9combose', 'dvb-c' , '', d)} \
"

EXTRA_OECONF:append:pn-enigma2 = " --with-alphablendingacceleration=always --with-blitaccelerationthreshold=250  --with-fillaccelerationthreshold=190000"

require conf/machine/include/airdigital-hisil-3798mv200.inc

BBMASK = "meta-vuplus/recipes-graphics/"
BBMASK += "meta-vuplus/recipes-webkit/"
```

## meta-brands/meta-airdigital/conf/machine/hzero.conf
```bitbake
#@TYPE: Machine
#@NAME: hzero
#@DESCRIPTION: Machine configuration for the hzero

SOC_FAMILY = "hisi3716mv430"
HICHIPSET = "3716mv430"
HAVE_GLES = ""
VER = "-v2"

RCTYPE = "25"
RCNAME = "zgemma8"

MTD_KERNEL = "mtd9"
MTD_ROOTFS = "mtd10"
KERNEL_FILE = "uImage"
ROOTFS_FILE = "rootfs.ubi"

IMAGE_CLASSES += " zgemma-yaffs_image"
IMAGE_FSTYPES += "ubi zgemmayaffs"

MACHINE_FEATURES += " hisil-3716mv430 hisi-recovery ci himedia adwol no-opengl"

EXTRA_OECONF:append:pn-enigma2 = " --with-alphablendingacceleration=always --with-blitaccelerationthreshold=250 --with-fillaccelerationthreshold=190000"

require conf/machine/include/zgemma-hisil-3716mv430.inc

BBMASK = "meta-vuplus/recipes-graphics/"
BBMASK += "meta-vuplus/recipes-webkit/"
```

## meta-brands/meta-airdigital/conf/machine/i55.conf
```bitbake
SOC_FAMILY = "bcm7362"

FLASHSIZE = "256"

UBI_VOLNAME = "rootfs"
MKUBIFS_ARGS = "-m 2048 -e 126976 -c 8192"
UBINIZE_ARGS = "-m 2048 -p 128KiB"

MACHINE_FEATURES += "videoenhancement no-cl-svr dvbc-only"

require conf/machine/include/airdigital-mipsel.inc

MACHINE_KERNEL_PR = "r0"

MACHINE_EXTRA_RDEPENDS = "\
    enigma2-plugin-extensions-gbipboxclient \
    enigma2-plugin-systemplugins-satipclient \
"
```

## meta-brands/meta-airdigital/conf/machine/i55se.conf
```bitbake
#@TYPE: Machine
#@NAME: i55se
#@DESCRIPTION: Machine configuration for the i55se

SOC_FAMILY = "hisi3798mv200"
HICHIPSET = "3798mv200"
VER = "-v2"

RCTYPE = "28"
RCNAME = "zgemma3"

IMAGE_CLASSES += " airdigital-fastboot8gb_image"

MTD_BOOTFS = "mmcblk0p4"
MTD_ROOTFS = "mmcblk0p23"
MTD_KERNEL = "mmcblk0p19"
KERNEL_FILE = "uImage"
ROOTFS_FILE = "rootfs.tar.bz2"
MTD_BLACK  = "mmcblk0"

IMAGE_FSTYPES += "zgemmafastboot8gb tar"

MACHINE_FEATURES += " hisil-3798mv200 mali skins1080 multitranscoding kodi21 himedia no-subssupport dvbc-only adwol emmc hisi-recovery mountboot"

MACHINE_EXTRA_RDEPENDS = "\
    enigma2-plugin-extensions-gbipboxclient \
    enigma2-plugin-extensions-stalker-qt \
"

EXTRA_OECONF:append:pn-enigma2 = " --with-alphablendingacceleration=always --with-blitaccelerationthreshold=250  --with-fillaccelerationthreshold=190000"

require conf/machine/include/airdigital-hisil-3798mv200.inc

BBMASK = "meta-vuplus/recipes-graphics/"
BBMASK += "meta-vuplus/recipes-webkit/"
```

## meta-brands/meta-airdigital/conf/machine/include/airdigital-arm.inc
```bitbake
PACKAGECONFIG_GL_pn-qtbase = " "
PACKAGECONFIG_append_pn-qtbase += " gles2 linuxfb"

#IMAGE_CLASSES += "airdigitalemmc_image_single"
IMAGE_CLASSES += "airdigital-emmc_image_multiboot"

MACHINE_FEATURES += "qthbbtv qtstalker linuxwifi"

IMAGE_FSTYPES += "airdigitalemmc"
IMAGE_ROOTFS_SIZE ?= "589824"

TARGET_ARCH = "arm"
DEFAULTTUNE = "cortexa15hf-neon-vfpv4"

PREFERRED_VERSION_linux-airdigital = "4.10.12"

PREFERRED_PROVIDER_virtual/egl ?= "airdigital-v3ddriver-${MACHINE}" 
PREFERRED_PROVIDER_virtual/libgles1 ?= "airdigital-v3ddriver-${MACHINE}"
PREFERRED_PROVIDER_virtual/libgles2 ?= "airdigital-v3ddriver-${MACHINE}"
PREFERRED_PROVIDER_virtual/libgbm ?= "airdigital-v3ddriver-${MACHINE}"
PREFERRED_PROVIDER_virtual/libgl ?= "mesa"
PREFERRED_PROVIDER_virtual/mesa ?= "mesa"
PREFERRED_PROVIDER_virtual/blindscan-dvbc ?= "airdigital-dvb-modules-${MACHINE}"
PREFERRED_PROVIDER_virtual/blindscan-dvbs ?= "airdigital-dvb-modules-${MACHINE}"

IMAGE_CMD_airdigitalemmc_prepend = " \
    rm -f ${DEPLOY_DIR_IMAGE}/*.ext4; \
    rm -f ${DEPLOY_DIR_IMAGE}/*.manifest; \
    "

IMAGE_CMD_airdigitalemmc_append = "\
    mkdir -p ${DEPLOY_DIR_IMAGE}/${IMAGEDIR}; \
    mv ${DEPLOY_DIR_IMAGE}/${IMAGE_NAME}.emmc.img ${DEPLOY_DIR_IMAGE}/${IMAGEDIR}/disk.img; \
    cd ${IMAGE_ROOTFS}; \
    tar -cvf ${DEPLOY_DIR_IMAGE}/rootfs.tar -C ${IMAGE_ROOTFS} .; \
    mv ${DEPLOY_DIR_IMAGE}/rootfs.tar ${DEPLOY_DIR_IMAGE}/${IMAGEDIR}/rootfs.tar; \
    bzip2 ${DEPLOY_DIR_IMAGE}/${IMAGEDIR}/rootfs.tar; \
    cp ${DEPLOY_DIR_IMAGE}/zImage ${DEPLOY_DIR_IMAGE}/${IMAGEDIR}/${KERNEL_FILE}; \
    echo ${IMAGE_VER_STRING} > ${DEPLOY_DIR_IMAGE}/${IMAGEDIR}/imageversion; \
    cd ${DEPLOY_DIR_IMAGE}; \
    zip ${IMAGE_NAME}_recovery_emmc.zip ${IMAGEDIR}/disk.img ${IMAGEDIR}/imageversion; \
    zip ${IMAGE_NAME}_usb.zip ${IMAGEDIR}/imageversion ${IMAGEDIR}/kernel.bin ${IMAGEDIR}/rootfs.tar.bz2; \
    rm -f ${DEPLOY_DIR_IMAGE}/*.ext4; \
    rm -f ${DEPLOY_DIR_IMAGE}/*.manifest; \
    rm -f ${DEPLOY_DIR_IMAGE}/.ext4; \
    rm -f ${DEPLOY_DIR_IMAGE}/.manifest; \
    rm -Rf ${IMAGEDIR}; \
    "

require conf/machine/include/tune-cortexa15.inc
require conf/machine/include/airdigital-oem.inc
```

## meta-brands/meta-airdigital/conf/machine/include/airdigital-hisil.inc
```bitbake
MACHINE_FEATURES += "qthbbtv qtstalker"
DISTRO_FEATURES_remove = "x11 wayland directfb"

PREFERRED_PROVIDER_virtual/egl = "airdigital-mali-${MACHINE}"
PREFERRED_PROVIDER_virtual/libgles1 = "airdigital-mali-${MACHINE}"
PREFERRED_PROVIDER_virtual/libgles2 = "airdigital-mali-${MACHINE}"
PREFERRED_PROVIDER_virtual/libopencl = "airdigital-mali-${MACHINE}"
PREFERRED_PROVIDER_virtual/blindscan-dvbc = "airdigital-dvb-modules-${MACHINE}"
PREFERRED_PROVIDER_virtual/blindscan-dvbs = "airdigital-dvb-modules-${MACHINE}"

TARGET_ARCH = "arm"
DEFAULTTUNE = "cortexa15hf-neon-vfpv4"

MTD_KERNEL = "mtd7"
MTD_ROOTFS = "mtd8"
KERNEL_FILE = "uImage"
ROOTFS_FILE = "rootfs.ubi"

IMAGE_FSTYPES += "ubi"
MKUBIFS_ARGS = "-m 2048 -e 126976 -c 8192"
UBINIZE_ARGS = "-m 2048 -p 128KiB"
UBI_VOLNAME = "rootfs"
CMDLINE ?= "console=ttyAMA0,115200n8"

KERNEL_MODULE_AUTOLOAD += "mali"

PREFERRED_VERSION_linux-airdigital = "4.4.35"
PREFERRED_VERSION_linux-libc-headers = "4.4"

IMAGE_CMD_ubi_append = " \
    mkdir -p ${DEPLOY_DIR_IMAGE}/${IMAGEDIR}; \
    mv ${IMGDEPLOYDIR}/${IMAGE_NAME}${IMAGE_NAME_SUFFIX}.ubi ${DEPLOY_DIR_IMAGE}/${IMAGEDIR}/${ROOTFS_FILE}; \
    cp ${DEPLOY_DIR_IMAGE}/uImage ${DEPLOY_DIR_IMAGE}/${IMAGEDIR}/${KERNEL_FILE}; \
    cp ${DEPLOY_DIR_IMAGE}/${MACHINE}-partitions/${MACHINE}/fastboot.bin ${DEPLOY_DIR_IMAGE}/${IMAGEDIR}/fastboot.bin; \
    cp ${DEPLOY_DIR_IMAGE}/${MACHINE}-partitions/${MACHINE}/pq_param.bin ${DEPLOY_DIR_IMAGE}/${IMAGEDIR}/pq_param.bin; \
    cp ${DEPLOY_DIR_IMAGE}/${MACHINE}-partitions/${MACHINE}/bootargs.bin ${DEPLOY_DIR_IMAGE}/${IMAGEDIR}/bootargs.bin; \
    cp ${DEPLOY_DIR_IMAGE}/${MACHINE}-partitions/${MACHINE}/baseparam.img ${DEPLOY_DIR_IMAGE}/${IMAGEDIR}/baseparam.img; \
    if [ -e ${DEPLOY_DIR_IMAGE}/logo-${DISTRO_NAME}.img ]; then \
        cp ${DEPLOY_DIR_IMAGE}/logo-${DISTRO_NAME}.img ${DEPLOY_DIR_IMAGE}/${IMAGEDIR}/logo.img; \
    else \
        cp ${DEPLOY_DIR_IMAGE}/${MACHINE}-partitions/${MACHINE}/logo.img ${DEPLOY_DIR_IMAGE}/${IMAGEDIR}/logo.img; \
    fi; \
    echo "${IMAGEVERSION}" > ${DEPLOY_DIR_IMAGE}/${IMAGEDIR}/imageversion; \
    echo "rename this file to 'force' to force an update without confirmation" > ${DEPLOY_DIR_IMAGE}/${IMAGEDIR}/noforce; \
    cd ${DEPLOY_DIR_IMAGE}; \
    zip ${IMAGE_NAME}_usb.zip ${IMAGEDIR}/*; \
    zip -j ${IMAGE_NAME}_usb.zip ${DEPLOY_DIR_IMAGE}/${MACHINE}-partitions/fastboot.bin; \
    zip -j ${IMAGE_NAME}_usb.zip ${DEPLOY_DIR_IMAGE}/${MACHINE}-partitions/bootargs.bin; \
    rm -f ${DEPLOY_DIR_IMAGE}/*.ubi; \
    rm -f ${DEPLOY_DIR_IMAGE}/*.ubifs; \
    rm -f ${DEPLOY_DIR_IMAGE}/*.manifest; \
    rm -f ${DEPLOY_DIR_IMAGE}/.ubifs; \
    rm -f ${DEPLOY_DIR_IMAGE}/.manifest; \
    rm -Rf ${IMAGEDIR}; \
    "

require conf/machine/include/tune-cortexa15.inc
require conf/machine/include/airdigital-oem.inc
```

## meta-brands/meta-airdigital/conf/machine/include/airdigital-mipsel.inc
```bitbake
PACKAGECONFIG_GL:pn-qtbase = " "
PACKAGECONFIG:append:pn-qtbase = " gles2 linuxfb"

MTD_KERNEL = "mtd1"
MTD_ROOTFS = "mtd2"
KERNEL_FILE = "kernel.bin"
ROOTFS_FILE = "rootfs.bin"

KERNEL_IMAGETYPE = "vmlinux"
KERNEL_OUTPUT = "${KERNEL_IMAGETYPE}"
KERNEL_CONSOLE = "ttyS0,115200n8"

TARGET_ARCH = "mipsel"
DEFAULTTUNE = "mips32el"

PREFERRED_VERSION_linux-airdigital = "4.10.12"

PREFERRED_PROVIDER_virtual/egl ?= "airdigital-v3ddriver-${MACHINE}"
PREFERRED_PROVIDER_virtual/libgles1 ?= "airdigital-v3ddriver-${MACHINE}"
PREFERRED_PROVIDER_virtual/libgles2 ?= "airdigital-v3ddriver-${MACHINE}"
PREFERRED_PROVIDER_virtual/libgbm ?= "airdigital-v3ddriver-${MACHINE}"
PREFERRED_PROVIDER_virtual/libgl ?= "mesa"
PREFERRED_PROVIDER_virtual/mesa ?= "mesa"

IMAGE_FSTYPES ?= "ubi"

IMAGE_CMD:ubifs:prepend = " \
	mkdir -p ${IMAGE_ROOTFS}/usr/lib; \
	if [ "${PACKAGE_LIST}" = "1" ]; then \
        cp ${IMAGE_MANIFEST} ${IMAGE_ROOTFS}/usr/lib/package.lst; \
    fi; \
    rm -rf ${IMAGE_ROOTFS}/boot/*; \
    rm -rf ${IMAGE_ROOTFS}/tmp/*; \
    "

IMAGE_CMD:ubi:append = "\
    mkdir -p ${DEPLOY_DIR_IMAGE}/${IMAGEDIR}; \
    cp ${DEPLOY_DIR_IMAGE}/splash.bin ${DEPLOY_DIR_IMAGE}/${IMAGEDIR}/splash.bin; \
    mv ${IMGDEPLOYDIR}/${IMAGE_NAME}.ubi ${DEPLOY_DIR_IMAGE}/${IMAGEDIR}/${ROOTFS_FILE}; \
    gzip -9c ${DEPLOY_DIR_IMAGE}/vmlinux-${MACHINE}.bin > ${DEPLOY_DIR_IMAGE}/${IMAGEDIR}/${KERNEL_FILE}; \
    echo ${IMAGE_VER_STRING} > ${DEPLOY_DIR_IMAGE}/${IMAGEDIR}/imageversion; \
    ${@bb.utils.contains('MACHINE', 'i55', \
    'echo "dont change this file" > ${DEPLOY_DIR_IMAGE}/${IMAGEDIR}/force;' , \
    'echo "rename this file to force to force an update without confirmation" > ${DEPLOY_DIR_IMAGE}/${IMAGEDIR}/noforce;', d)} \
    cd ${DEPLOY_DIR_IMAGE}; \
    zip ${IMAGE_NAME}_usb.zip ${IMAGEDIR}/*; \
    rm -f ${DEPLOY_DIR_IMAGE}/*.ubi; \
    rm -f ${DEPLOY_DIR_IMAGE}/*.ubifs; \
    rm -f ${DEPLOY_DIR_IMAGE}/*.manifest; \
    rm -f ${DEPLOY_DIR_IMAGE}/.ubifs; \
    rm -f ${DEPLOY_DIR_IMAGE}/.manifest; \
    rm -Rf ${IMAGEDIR}; \
    "

MACHINE_FEATURES += " bootsplash omb boxmodel feature1 linuxwifi skins1080"

BOOTLOGO_FILENAME = "splash.bin"

require conf/machine/include/mips/tune-mips32.inc
require conf/machine/include/airdigital-oem.inc
```
