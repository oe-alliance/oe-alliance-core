## meta-brands/meta-octagon/conf/machine/sf4008.conf
```bitbake
#@TYPE: Machine
#@NAME: Octagon SF4008
#@DESCRIPTION: Machine configuration for the Octagon SF4008

PREFERRED_VERSION_linux-octagon = "4.1.37"
PREFERRED_VERSION_linux-libc-headers = "4.1"

SOC_FAMILY = "bcm7251s"

MACHINE_NAME = "SF4008"
MTD_ROOTFS = "mmcblk0p4"
MTD_KERNEL = "mmcblk0p3"
MTD_BLACK  = "mmcblk0"
KERNEL_FILE = "kernel.bin"
ROOTFS_FILE = "rootfs.tar.bz2"

FLASHSIZE = "4096"

require conf/machine/include/octagon.inc

IMAGE_CMD_tar_prepend = "\
    mkdir -p ${DEPLOY_DIR_IMAGE}/${IMAGEDIR}; \
    ${@bb.utils.contains("MACHINE_FEATURES", "bootsplash", "cp ${DEPLOY_DIR_IMAGE}/splash.bin ${DEPLOY_DIR_IMAGE}/${IMAGEDIR}/splash.bin;" , "", d)} \
    cp ${DEPLOY_DIR_IMAGE}/${MACHINE}_update.bin ${DEPLOY_DIR_IMAGE}/${IMAGEDIR}/update.bin; \
    cp ${DEPLOY_DIR_IMAGE}/zImage ${DEPLOY_DIR_IMAGE}/${IMAGEDIR}/${KERNEL_FILE}; \
    echo ${DISTRO_NAME}-${DISTRO_VERSION}.${BUILD_VERSION} > ${DEPLOY_DIR_IMAGE}/${IMAGEDIR}/imageversion; \
    echo "rename this file to 'force' to force an update without confirmation" > ${DEPLOY_DIR_IMAGE}/${IMAGEDIR}/noforce; \
    echo "this file enable kernel update" > ${DEPLOY_DIR_IMAGE}/${IMAGEDIR}/partition.update; \
    cd ${IMAGE_ROOTFS}; \
    tar -cvf ${DEPLOY_DIR_IMAGE}/rootfs.tar -C ${IMAGE_ROOTFS} .; \
    mv ${DEPLOY_DIR_IMAGE}/rootfs.tar ${DEPLOY_DIR_IMAGE}/${IMAGEDIR}/rootfs.tar; \
    bzip2 ${DEPLOY_DIR_IMAGE}/${IMAGEDIR}/rootfs.tar; \
    cd ${DEPLOY_DIR_IMAGE}; \
    zip ${IMAGE_NAME}_usb.zip ${IMAGEDIR}/*; \
    rm -f ${DEPLOY_DIR_IMAGE}/*.rootfs.tar.bz2; \
    rm -f ${DEPLOY_DIR_IMAGE}/.tar.bz2; \
    rm -f ${DEPLOY_DIR_IMAGE}/*.manifest; \
    rm -f ${DEPLOY_DIR_IMAGE}/.manifest; \
    rm -Rf ${IMAGEDIR}; \
"

MACHINE_FEATURES += "dvb-c ci textlcd videoenhancement skins1080 hbbtv-browser-webkit emmc mmc v3d kodi"

BBMASK = "meta-vuplus/recipes-graphics/"
BBMASK += "meta-vuplus/recipes-webkit/"
```

## meta-brands/meta-octagon/conf/machine/sf5008.conf
```bitbake
#@TYPE: Machine
#@NAME: Octagon SF5008
#@DESCRIPTION: Machine configuration for the Octagon SF5008

PREFERRED_VERSION_linux-octagon = "4.9.51"
PREFERRED_VERSION_linux-libc-headers = "4.9"

SOC_FAMILY = "bcm7252s"

MACHINE_NAME = "SF5008"
MTD_ROOTFS = "mmcblk0p4"
MTD_KERNEL = "mmcblk0p3"
MTD_BLACK  = "mmcblk0"
KERNEL_FILE = "kernel.bin"
ROOTFS_FILE = "rootfs.tar.bz2"

FLASHSIZE = "8192"

require conf/machine/include/octagon.inc

IMAGE_CMD_tar_prepend = "\
    mkdir -p ${DEPLOY_DIR_IMAGE}/${IMAGEDIR}; \
    ${@bb.utils.contains("MACHINE_FEATURES", "bootsplash", "cp ${DEPLOY_DIR_IMAGE}/splash.bin ${DEPLOY_DIR_IMAGE}/${IMAGEDIR}/splash.bin;" , "", d)} \
    cp ${DEPLOY_DIR_IMAGE}/${MACHINE}_update.bin ${DEPLOY_DIR_IMAGE}/${IMAGEDIR}/update.bin; \
    cp ${DEPLOY_DIR_IMAGE}/zImage ${DEPLOY_DIR_IMAGE}/${IMAGEDIR}/${KERNEL_FILE}; \
    echo ${DISTRO_NAME}-${DISTRO_VERSION}.${BUILD_VERSION} > ${DEPLOY_DIR_IMAGE}/${IMAGEDIR}/imageversion; \
    echo "rename this file to 'force' to force an update without confirmation" > ${DEPLOY_DIR_IMAGE}/${IMAGEDIR}/noforce; \
    echo "this file enable kernel update" > ${DEPLOY_DIR_IMAGE}/${IMAGEDIR}/partition.update; \
    cd ${IMAGE_ROOTFS}; \
    tar -cvf ${DEPLOY_DIR_IMAGE}/rootfs.tar -C ${IMAGE_ROOTFS} .; \
    mv ${DEPLOY_DIR_IMAGE}/rootfs.tar ${DEPLOY_DIR_IMAGE}/${IMAGEDIR}/rootfs.tar; \
    bzip2 ${DEPLOY_DIR_IMAGE}/${IMAGEDIR}/rootfs.tar; \
    cd ${DEPLOY_DIR_IMAGE}; \
    zip ${IMAGE_NAME}_usb.zip ${IMAGEDIR}/*; \
    rm -f ${DEPLOY_DIR_IMAGE}/*.rootfs.tar.bz2; \
    rm -f ${DEPLOY_DIR_IMAGE}/.tar.bz2; \
    rm -f ${DEPLOY_DIR_IMAGE}/*.manifest; \
    rm -f ${DEPLOY_DIR_IMAGE}/.manifest; \
    rm -Rf ${IMAGEDIR}; \
"

MACHINE_FEATURES += "dvb-c ci textlcd videoenhancement skins1080 hbbtv-browser-webkit emmc mmc linuxwifi multitranscoding v3d kodi"

BBMASK = "meta-vuplus/recipes-graphics/"
BBMASK += "meta-vuplus/recipes-webkit/"
```

## meta-brands/meta-octagon/conf/machine/sf8008.conf
```bitbake
#@TYPE: Machine
#@NAME: sf8008
#@DESCRIPTION: Machine configuration for the sf8008

EXTRA_OECONF:append:pn-enigma2 = " --with-lcddev=/dev/null --with-alphablendingacceleration=always --with-blitaccelerationthreshold=250  --with-fillaccelerationthreshold=190000 --with-subttxtabnormalptsdiffs=3600000"

MACHINE_FEATURES += " no-subssupport HDMI AV_JACK multitranscoding blindscan-dvbs dvb-c 7segment oem-info"

SOC_FAMILY = "hisi3798mv200"
HICHIPSET = "3798mv200"
LINUX_VERSION = "4.4.35"

MTD_KERNEL = "mmcblk0p12"
MTD_ROOTFS = "mmcblk0p16"

MACHINE_NAME = "SF8008 4K UHD"
RCNAME = "octagon1"

require conf/machine/include/octagon-hisi.inc
```

## meta-brands/meta-octagon/conf/machine/sf8008m.conf
```bitbake
#@TYPE: Machine
#@NAME: sf8008m
#@DESCRIPTION: Machine configuration for the sf8008m

EXTRA_OECONF_append_pn-enigma2 = "--with-lcddev=/dev/null --with-alphablendingacceleration=always --with-blitaccelerationthreshold=250  --with-fillaccelerationthreshold=190000 --with-subttxtabnormalptsdiffs=3600000"

MACHINE_FEATURES += " no-subssupport HDMI AV_JACK multitranscoding"

SOC_FAMILY = "hisi3798mv200"

MACHINE_NAME = "SF8008 MINI 4K"

GCCVERSION = "8.%"

require conf/machine/include/octagon-hisi.inc
```
