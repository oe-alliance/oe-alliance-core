## meta-brands/meta-ini/conf/machine/inihde.conf
```bitbake
include conf/machine/include/ini-oem.inc

PREFERRED_PROVIDER_virtual/kernel = "linux-ini-hde"
PREFERRED_VERSION_linux-ini-hde = "3.12.1"
PREFERRED_VERSION_linux-libc-headers = "3.12.1"

SOC_FAMILY = "bcm7358"

MACHINE_FEATURES += " videoenhancement singlecore dvb-c blindscan-dvbc blindscan-dvbs ci skins1080 blindscan-tbs textlcd \
    ${@bb.utils.contains('MACHINEBUILD', 'bwidowx', ' 7segment' , '', d)} \
    ${@bb.utils.contains('MACHINEBUILD', 'xpeedlx1', ' 7segment' , '', d)} \
"

UBI_VOLNAME = "rootfs"
MKUBIFS_ARGS = "-m 2048 -e 126976 -c 4096"
UBINIZE_ARGS = "-m 2048 -p 128KiB"

EXTRA_IMAGEDEPENDS += "\
    enigma2-plugin-systemplugins-micomupgrade \
    "

MACHINE_EXTRA_RDEPENDS = "\
    enigma2-plugin-systemplugins-micomupgrade \
    "
```

## meta-brands/meta-ini/conf/machine/inihde2.conf
```bitbake
#
# This is config file for INI HDe2 HW
#

include conf/machine/include/ini-oem.inc

PREFERRED_PROVIDER_virtual/kernel = "linux-ini-hde2"
PREFERRED_VERSION_linux-ini-hde2 = "3.14.2"
PREFERRED_VERSION_linux-libc-headers = "3.13"

MACHINE_FEATURES += "videoenhancement singlecore skins1080 extrasplash blindscan-tbs textlcd \
    ${@bb.utils.contains('MACHINEBUILD', 'atemio6000', 'blindscan-dvbs 7segment' , '', d)} \
    ${@bb.utils.contains('MACHINEBUILD', 'atemio6100', 'dvb-c dvbc-only 7segment' , '', d)} \
    ${@bb.utils.contains('MACHINEBUILD', 'atemio6200', 'dvb-c blindscan-dvbc blindscan-dvbs ci' , '', d)} \
    ${@bb.utils.contains('MACHINEBUILD', 'mbminiplus', 'dvb-c blindscan-dvbc blindscan-dvbs ci' , '', d)} \
    ${@bb.utils.contains('MACHINEBUILD', 'bwidowx2', 'dvb-c blindscan-dvbc blindscan-dvbs ci 7segment' , '', d)} \
    ${@bb.utils.contains('MACHINEBUILD', 'mbhybrid', 'dvb-c dvbc-only 7segment' , '', d)} \
    ${@bb.utils.contains('MACHINEBUILD', 'opticumtt', 'dvb-c blindscan-dvbc blindscan-dvbs ci 7segment' , '', d)} \
    ${@bb.utils.contains('MACHINEBUILD', 'beyonwizt2', 'dvbc-only' , '', d)} \
    ${@bb.utils.contains('MACHINEBUILD', 'xpeedlxpro', 'blindscan-dvbs' , '', d)} \
"

SOC_FAMILY = "bcm7362"

UBI_VOLNAME = "rootfs"
MKUBIFS_ARGS = "-m 2048 -e 126976 -c 4096"
UBINIZE_ARGS = "-m 2048 -p 128KiB"

EXTRA_IMAGEDEPENDS += "\
    ${@bb.utils.contains('MACHINEBUILD', 'xpeedlxpro', '' , 'enigma2-plugin-systemplugins-micomupgrade', d)} \
    "

MACHINE_EXTRA_RDEPENDS = "\
    ${@bb.utils.contains('MACHINEBUILD', 'xpeedlxpro', '' , 'enigma2-plugin-systemplugins-micomupgrade', d)} \
    "

MACHINE_EXTRA_RRECOMMENDS += "\
    ini-cfe \
    "
```

## meta-brands/meta-ini/conf/machine/inihde2am.conf
```bitbake
#
# This is config file for Atemio 6x00
#

include conf/machine/include/ini-oem.inc

PREFERRED_PROVIDER_virtual/kernel = "linux-ini-hde2"
PREFERRED_VERSION_linux-${MACHINE} = "3.14.2"
PREFERRED_VERSION_linux-libc-headers = "3.13"

MACHINE_FEATURES += "textlcd videoenhancement singlecore kernelrt2800 skins1080 \
    ${@base_contains('MACHINEBUILD', 'atemio6000', 'blindscan-dvbs' , '', d)} \
    ${@base_contains('MACHINEBUILD', 'atemio6100', 'dvbc-only' , '', d)} \
    ${@base_contains('MACHINEBUILD', 'atemio6200', 'dvb-c blindscan-dvbc blindscan-dvbs ci' , '', d)} \
"

CHIPSET = "bcm7362"

MACHINE_KERNEL_PR = "r6"

UBI_VOLNAME = "rootfs"
MKUBIFS_ARGS = "-m 2048 -e 126976 -c 4096"
UBINIZE_ARGS = "-m 2048 -p 128KiB"

EXTRA_IMAGEDEPENDS += ""

MACHINE_EXTRA_RDEPENDS = "\
	ini-factory-hde2 \
	"
```

## meta-brands/meta-ini/conf/machine/inihdp.conf
```bitbake
include conf/machine/include/ini-oem.inc

PREFERRED_PROVIDER_virtual/kernel = "linux-ini-hdp"
PREFERRED_VERSION_linux-ini-hdp = "3.14.2"
PREFERRED_VERSION_linux-libc-headers = "3.13"

MACHINE_FEATURES += "bwlcd255 fanctrl fan iniwol dvb-c blindscan-dvbc blindscan-dvbs ci skins1080 multitranscoding extrasplash blindscan-tbs \
    ${@bb.utils.contains('MACHINEBUILD', 'mbultra', 'inibt' , '', d)} \
    ${@bb.utils.contains('MACHINEBUILD', 'atemionemesis', 'inibt' , '', d)} \
    ${@bb.utils.contains('MACHINEBUILD', 'beyonwizt4', 'dvb-c dvb-c-only' , '', d)} \
"

SOC_FAMILY = "bcm7425"

MACHINE_KERNEL_PR = "r0"

UBI_VOLNAME = "rootfs"
MKUBIFS_ARGS = "-m 4096 -e 1040384 -c 1984"
UBINIZE_ARGS = "-m 4096 -p 1024KiB"

EXTRA_IMAGEDEPENDS = "\
    enigma2-plugin-systemplugins-micomupgrade \
    "

MACHINE_EXTRA_RDEPENDS = "\
    enigma2-plugin-systemplugins-micomupgrade \
    \
    ini-coldboot \
    ini-ethwol \
    \
    ${@bb.utils.contains('MACHINE_DRIVER', 'ini-800', 'rt8723bt kernel-module-rtk-btusb rt8723a kernel-module-8723au' , '', d)} \
    \
    ${@bb.utils.contains('MACHINE_DRIVER', 'ini-900', 'rt3070 firmware-rt2870' , '', d)} \
    "

MACHINE_EXTRA_RRECOMMENDS += "\
    ini-cfe \
    "
```

## meta-brands/meta-ini/conf/machine/inihdx.conf
```bitbake
include conf/machine/include/ini-oem.inc

PREFERRED_PROVIDER_virtual/kernel = "linux-ini-hdx"
PREFERRED_VERSION_linux-${MACHINE} = "3.6.0"
PREFERRED_VERSION_linux-libc-headers = "3.6"

MACHINE_FEATURES += "textlcd fanctrl dvb-c blindscan-dvbc blindscan-dvbs ci skins1080 \
    ${@bb.utils.contains('MACHINEBUILD', 'beyonwizt3', 'dvb-c dvb-c-only' , '', d)} \
"

CHIPSET = "bcm7413"

UBI_VOLNAME = "rootfs"
MKUBIFS_ARGS = "-m 2048 -e 126976 -c 4096"
UBINIZE_ARGS = "-m 2048 -p 128KiB"

EXTRA_IMAGEDEPENDS = "\
    enigma2-plugin-systemplugins-micomupgrade \
    "

MACHINE_EXTRA_RDEPENDS = "\
    enigma2-plugin-systemplugins-micomupgrade \
    "

GLIBCVERSION = "2.22"
```

## meta-brands/meta-ixuss/conf/layer.conf
```bitbake
# We have a conf and classes directory, append to BBPATH
BBPATH .= ":${LAYERDIR}"

# We have a recipes directory, add to BBFILES
BBFILES += "${LAYERDIR}/recipes-*/*.bb ${LAYERDIR}/recipes-*/*.bbappend \
            ${LAYERDIR}/recipes-*/*/*.bb ${LAYERDIR}/recipes-*/*/*.bbappend"

BBFILE_COLLECTIONS += "ixuss-layer"
BBFILE_PATTERN_ixuss-layer := "^${LAYERDIR}/"
BBFILE_PRIORITY_ixuss-layer = "7"

LAYERSERIES_COMPAT_ixuss-layer = "sumo"

OEA-META-IXUSS-BASE := '${@os.path.normpath("${LAYERDIR}/")}'
```

## meta-brands/meta-ixuss/conf/machine/ixussone.conf
```bitbake
#@TYPE: Machine
#@NAME: Ixuss One
#@DESCRIPTION: Machine configuration for the Ixuss One

MACHINE_NAME = "One"
MTD_ROOTFS = "mtd2"
MTD_KERNEL = "mtd1"

IMAGEDIR ?= "medialink/ixussone"

require conf/machine/include/ixuss.inc

GLIBCVERSION = "2.22"
```

## meta-brands/meta-ixuss/conf/machine/ixusszero.conf
```bitbake
#@TYPE: Machine
#@NAME: Ixuss Zero
#@DESCRIPTION: Machine configuration for the Ixuss Zero

MACHINE_NAME = "Zero"
MTD_ROOTFS = "mtd0"
MTD_KERNEL = "mtd1"

IMAGEDIR ?= "medialink/ixusszero"

MACHINE_FEATURES += "RCA"

require conf/machine/include/ixuss.inc
```

## meta-brands/meta-linkdroid/conf/layer.conf
```bitbake
# We have a conf and classes directory, append to BBPATH
BBPATH .= ":${LAYERDIR}"

# We have a recipes directory, add to BBFILES
BBFILES += "${LAYERDIR}/recipes-*/*.bb ${LAYERDIR}/recipes-*/*.bbappend \
            ${LAYERDIR}/recipes-*/*/*.bb ${LAYERDIR}/recipes-*/*/*.bbappend \
            ${LAYERDIR}/recipes-*/*/*/*.bb ${LAYERDIR}/recipes-*/*/*/*.bbappend"

BBFILE_COLLECTIONS += "linkdroid-layer"
BBFILE_PATTERN_linkdroid-layer := "^${LAYERDIR}/"
BBFILE_PRIORITY_linkdroid-layer = "7"

LAYERSERIES_COMPAT_linkdroid-layer = "sumo"

OEA-META-LINKDROID-BASE := '${@os.path.normpath("${LAYERDIR}/")}'
```

## meta-brands/meta-linkdroid/conf/machine/alien5.conf
```bitbake
#@TYPE: Machine
#@NAME: 
#@DESCRIPTION: Machine configuration for the Amiko Alien5 

MACHINE_NAME = "Alien5"
BRAND_OEM = "LinkDroid"
MACHINE_BRAND = "Amiko"

MTD_BLACK  = "mmcblk0"
KERNEL_FILE = "kernel.itb"
ROOTFS_FILE = "rootfs.tar.bz2"

SOC_FAMILY = "AML905D"


# Amlogic defaults
require conf/machine/include/linkdroid.inc
require conf/machine/include/arm/arch-armv8.inc
require conf/machine/include/soc-family.inc

# enable multilib
require conf/machine/include/multilib.inc

IMAGE_CLASSES += "sdcard_image-alien5"
SDCARD_ROOTFS ?= "${DEPLOY_DIR_IMAGE}/${IMAGE_NAME}.rootfs.ext4"
IMAGE_FSTYPES ?= "ext4 alien5sdimg"
#IMAGE_ROOTFS_SIZE = "976562"
IMAGE_ROOTFS_SIZE = "476562"
IMAGE_EXTRA_SPACE = "0"
IMAGE_OVERHEAD_FACTOR = "1.0"

BB_HASH_IGNORE_MISMATCH = "1"

# Serial console to be used
SERIAL_CONSOLE = "115200 ttyS0"

PREFERRED_PROVIDER_virtual/kernel = "linux-linkdroid"
PREFERRED_VERSION_linux-linkdroid = "3.14.29"
PREFERRED_VERSION_linux-libc-headers = "3.14.79"

KERNEL_CLASSES += "aarch64-fitimage"
#KERNEL_CLASSES += "kernel-fitimage"
KERNEL_IMAGETYPE = "fitImage"
KERNEL_DEVICETREE = "alien5.dtb"

UBOOT_ENTRYPOINT = "0x01080000"
UBOOT_LOADADDRESS = "0x01080000"

INITRAMFS_IMAGE = "linkdroid-initramfs"

MACHINE_FEATURES = "bluetooth usbhost vfat alsa dvb-c nolcd hdmicec fb skins1080 emmc kodi aml-plugins"

MACHINE_ESSENTIAL_EXTRA_RDEPENDS = "\
    linkdroid-shutdown \
    linkdroid-autoscript \
    \
    linkdroid-mali-${MACHINE} \
    linkdroid-gst-amlavsink1 \
    linkdroid-gst-app \
    linkdroid-libamplayer-${MACHINE} \
    linkdroid-libamavutils-${MACHINE} \
    linkdroid-libamadec-${MACHINE} \
    linkdroid-libamcodec-${MACHINE} \
    linkdroid-amlsetfb \
    \
    kernel-modules \
    linkdroid-amremote \
    linkdroid-opengl-amlogic \
    \
    linkdroid-stb-${MACHINE} \
    linkdroid-libavlib-audio-so-${MACHINE} \
    libmad \
    linkdroid-extra-${MACHINE} \
    " 


DVBPROVIDER = "kernel"
DVBSKYPROVIDER = "kernel"

### TODO:     8189es builitin with cfg80211
MACHINE_ESSENTIAL_EXTRA_RRECOMMENDS = "\
     \
    kernel-module-cdfs \
    kernel-module-sysfillrect \
    kernel-module-syscopyarea \
    kernel-module-mceusb \
    kernel-module-rc-core \
    kernel-module-CH341 \
    kernel-module-rfcomm \
    kernel-module-hidp \
    kernel-module-bluetooth \
    kernel-module-6lowpan-iphc \
    kernel-module-libcrc32c \
    kernel-module-xfs \
    pcsc-lite \
    kernel-module-8189es \
    kernel-module-cfg80211 \
    "

MACHINE_EXTRA_RRECOMMENDS += " \
    linkdroid-lkdosth \
    libdvbcsa \
    ntfs-3g \
    parted \
    linkdroid-cnim \
    "

KERNEL_MODULE_AUTOLOAD += " \
    se2io_se \
    ampanel \
    a5stb \ 
    mali \
    rfcomm \
    hidp \
    bluetooth \
    6lowpan-iphc \
    libcrc32c \
    mceusb \
    rc-core \
    cfg80211 \
    8189es \   
"


# We know about rtc
include conf/machine/include/build-extras.inc
```

## meta-brands/meta-linkdroid/conf/machine/include/linkdroid.inc
```bitbake
MACHINE_ESSENTIAL_EXTRA_RDEPENDS += " ${@bb.utils.contains('MACHINE_FEATURES', 'fb', 'linkdroid-amlsetfb', '', d)}"

PREFERRED_PROVIDER_virtual/libgles1 = "linkdroid-opengl-amlogic"
PREFERRED_PROVIDER_virtual/libgles2 = "linkdroid-opengl-amlogic"
PREFERRED_PROVIDER_virtual/egl = "linkdroid-opengl-amlogic"
PREFERRED_PROVIDER_virtual/kodi = "stb-kodi-${MACHINE}"

PREFERRED_PROVIDER_jpeg = "libjpeg-turbo"
PREFERRED_PROVIDER_jpeg-native = "libjpeg-turbo-native"

EXTRA_OECONF_append_pn-enigma2 = " --with-alsa --with-alsacard=hw:0 --with-alsamixer=Master --with-fbdev=/dev/fb0 --with-lcddev=/dev/null --with-amlogic"
DEPENDS_append_pn-enigma2 = " libdvbcsa linkdroid-libamcodec-${MACHINE} linkdroid-libamadec-${MACHINE} "
EXTRA_OECONF_append_pn-tuxtxt-enigma2 = " --with-fbdev=/dev/fb0"
CC_append_pn-showiframe = " -DHAVE_AMLOGIC -I${STAGING_INCDIR}/amlogic/amcodec -lamcodec -lgstpbutils-1.0 -lgstreamer-1.0 -lgobject-2.0 -lglib-2.0"
DEPENDS_append_pn-showiframe = " linkdroid-libamcodec-${MACHINE} gstreamer1.0 gstreamer1.0-libav  gstreamer1.0-plugins-base  gstreamer1.0-plugins-good gstreamer1.0-plugins-ugly"

DISTRO_FEATURES_remove = "x11 wayland"

IMAGEDIR ?= "${MACHINE}"

IMAGE_CMD_alien5sdimg_append = " \
    mkdir -p ${DEPLOY_DIR_IMAGE}/${IMAGEDIR}; \
    mv ${DEPLOY_DIR_IMAGE}/${IMAGE_NAME}-sd.img ${DEPLOY_DIR_IMAGE}/${IMAGEDIR}/${IMAGE_NAME}-sd.img; \
    echo ${DISTRO_NAME}-${DISTRO_VERSION}.${BUILD_VERSION} > ${DEPLOY_DIR_IMAGE}/${IMAGEDIR}/imageversion; \
    cd ${DEPLOY_DIR_IMAGE}; \
    zip ${IMAGE_NAME}_sdcard.zip ${IMAGEDIR}/*; \
    rm -f ${DEPLOY_DIR_IMAGE}/*.ext4; \
    rm -f ${DEPLOY_DIR_IMAGE}/*.manifest; \
    rm -f ${DEPLOY_DIR_IMAGE}/*.json; \
    rm -f ${DEPLOY_DIR_IMAGE}/*-sd.img; \
    rm -Rf ${IMAGEDIR}; \
    "

BBMASK += "meta-vuplus/recipes-graphics/"
BBMASK += "meta-fulan/recipes-graphics/"
BBMASK += "meta-vuplus/recipes-webkit/"
```

## meta-brands/meta-maxytec/conf/layer.conf
```bitbake
# We have a conf and classes directory, append to BBPATH
BBPATH .= ":${LAYERDIR}"

# We have a recipes directory, add to BBFILES
BBFILES += "${LAYERDIR}/recipes-*/*.bb ${LAYERDIR}/recipes-*/*.bbappend \
            ${LAYERDIR}/recipes-*/*/*.bb ${LAYERDIR}/recipes-*/*/*.bbappend"

BBFILE_COLLECTIONS += "maxytec-layer"
BBFILE_PATTERN_maxytec-layer := "^${LAYERDIR}/"
BBFILE_PRIORITY_maxytec-layer = "7"

LAYERSERIES_COMPAT_maxytec-layer = "langdale mickledore nanbield scarthgap"

OEA-META-MAXYTEC-BASE := '${@os.path.normpath("${LAYERDIR}/")}'
```
