## meta-brands/meta-gigablue/conf/machine/gb7252.conf
```bitbake
#@TYPE: Machine
#@NAME: Gigablue 7252S series
#@DESCRIPTION: Machine configuration for the Gigablue 7252S series

SOC_FAMILY = "bcm7252s"

# eMMC has 4 GB in total, but one image gets only 1 GB of that (Partitioned eMMC)
FLASHSIZE = "1024"

require conf/machine/include/gigablue-arm.inc

MTD_BOOTFS = "mmcblk0p1"
MTD_BLACK  = "mmcblk0"

SRCDATE_BOLT = "\
${@bb.utils.contains('MACHINEBUILD', 'gbue4k', '20181120' , '', d)}\
${@bb.utils.contains('MACHINEBUILD', 'gbquad4k', '20181120' , '', d)}\
"

MACHINE_FEATURES += "bolt transcoding gigabluelcd ci dvb-c gigabluearmbootvideo nexusplatform blindscan-dvbs blindscan-dvbc mountboot quadpip kodi19 chromiumos qtegls gb-qthbbtv gbbluetooth \
    ${@bb.utils.contains('MACHINEBUILD', 'gbue4k', ' colorlcd220 gigabluelcd220' , '', d)} \
    ${@bb.utils.contains('MACHINEBUILD', 'gbquad4k', ' colorlcd400 gigabluelcd400' , '', d)} \
"

### Logitech keyboard ###
KERNEL_MODULE_AUTOLOAD += "hid-logitech"
KERNEL_MODULE_AUTOLOAD += "hid-logitech-dj"

DVBSKYPROVIDER = "kernel"

PREFERRED_VERSION_linux-gigablue = "4.1.20"

OEM_ARCH = "${MACHINEBUILD}"

BBMASK = "meta-vuplus/recipes-graphics/"
BBMASK += "meta-fulan/recipes-graphics/"
BBMASK += "meta-vuplus/recipes-webkit/"
BBMASK += "meta-oe/recipes-qt5.14/"
```

## meta-brands/meta-gigablue/conf/machine/gb72604.conf
```bitbake
#@TYPE: Machine
#@NAME: Gigablue 72604 series
#@DESCRIPTION: Machine configuration for the Gigablue 72604 series

SOC_FAMILY = "bcm72604"

# eMMC has 4 GB in total, but one image gets only 1 GB of that (Partitioned eMMC)
FLASHSIZE = "1024"

require conf/machine/include/gigablue-arm.inc

MTD_BOOTFS = "mmcblk0p1"
MTD_BLACK  = "mmcblk0"

SRCDATE_BOLT = "\
${@bb.utils.contains('MACHINEBUILD', 'gbx34k', '20190926' , '', d)}\
"

MACHINE_FEATURES += "ci dvb-c gigabluearmbootvideo nexusplatform blindscan-dvbs blindscan-dvbc mountboot kodi19 qtegls gb-qthbbtv"

#fixme 
# chromiumos gbbluetooth

### Logitech keyboard ###
KERNEL_MODULE_AUTOLOAD += "hid-logitech"
KERNEL_MODULE_AUTOLOAD += "hid-logitech-dj"

DVBSKYPROVIDER = "kernel"

PREFERRED_VERSION_linux-gigablue = "4.1.20"

OEM_ARCH = "${MACHINEBUILD}"

BBMASK = "meta-vuplus/recipes-graphics/"
BBMASK += "meta-fulan/recipes-graphics/"
BBMASK += "meta-vuplus/recipes-webkit/"
BBMASK += "meta-oe/recipes-qt5.14/"
```

## meta-brands/meta-gigablue/conf/machine/gb7325.conf
```bitbake
#@TYPE: Machine
#@NAME: GigaBlue 7325 serie
#@DESCRIPTION: Machine configuration for the GigaBlue 7325 serie

SOC_FAMILY = "bcm7325"

FLASHSIZE=128

require conf/machine/include/gigablue-mips.inc

MACHINE_FEATURES += "singlecore no-cl-svr blindscan-dvbc ci blindscan-dvbs smallflash \
    ${@bb.utils.contains('MACHINEBUILD', 'gb800ue', 'colorlcd220 gigabluelcd gigabluelcd220' , '', d)} \
"

PREFERRED_VERSION_linux-gigablue = "3.9.6"
PREFERRED_VERSION_linux-libc-headers = "3.9"

IMAGE_FSTYPES ?= "ubi"
UBI_VOLNAME = "rootfs"
MKUBIFS_ARGS = "-m 2048 -e 126976 -c 4096"
UBINIZE_ARGS = "-m 2048 -p 128KiB"

OEM_ARCH = "${MACHINEBUILD}"
```

## meta-brands/meta-gigablue/conf/machine/gb7356.conf
```bitbake
#@TYPE: Machine
#@NAME: GigaBlue 7356 serie
#@DESCRIPTION: Machine configuration for the GigaBlue 7356 serie

SOC_FAMILY = "bcm7356"

FLASHSIZE=512

require conf/machine/include/gigablue-mips.inc

MACHINE_FEATURES += "gigabluelcd blindscan-dvbc transcoding ci directfb gigabluemipsbootvideo osdanimation blindscan-dvbs \
    ${@bb.utils.contains('MACHINEBUILD', 'gbquad', ' colorlcd220 gbsoftwol gigabluelcd220' , '', d)} \
    ${@bb.utils.contains('MACHINEBUILD', 'gbquadplus', ' colorlcd400 gbwol gigabluelcd400' , '', d)} \
"

### Logitech keyboard ###
KERNEL_MODULE_AUTOLOAD += "hid-logitech"
KERNEL_MODULE_AUTOLOAD += "hid-logitech-dj"

DVBSKYPROVIDER = "kernel"

PREFERRED_VERSION_linux-gigablue = "4.8.3"
PREFERRED_VERSION_linux-libc-headers = "4.8"

IMAGE_FSTYPES ?= "ubi"
UBI_VOLNAME = "rootfs"
MKUBIFS_ARGS = "-m 2048 -e 126976 -c 4096 -F"
UBINIZE_ARGS = "-m 2048 -p 128KiB"

OEM_ARCH = "${MACHINEBUILD}"
```

## meta-brands/meta-gigablue/conf/machine/gb7358.conf
```bitbake
#@TYPE: Machine
#@NAME: GigaBlue 7358 serie
#@DESCRIPTION: Machine configuration for the GigaBlue 7358 serie

SOC_FAMILY = "bcm7358"

# V2 has 256MB, but the images are supposed to work on both, so use the smaller value from V1:
FLASHSIZE = "128"

require conf/machine/include/gigablue-mips.inc

MACHINE_FEATURES += "videoenhancement gbsoftwol osdanimation smallflash \
    ${@bb.utils.contains('MACHINEBUILD', 'gb800ueplus', 'colorlcd220 gigabluelcd blindscan-dvbc ci singlecore no-cl-svr gigabluelcd220 blindscan-dvbs' , '', d)} \
    ${@bb.utils.contains('MACHINEBUILD', 'gbipbox', 'dvbc-only' , '', d)} \
    ${@bb.utils.contains('MACHINEBUILD', 'gb800seplus', 'blindscan-dvbc ci singlecore no-cl-svr blindscan-dvbs' , '', d)} \
"

### Logitech keyboard ###
KERNEL_MODULE_AUTOLOAD += "hid-logitech"
KERNEL_MODULE_AUTOLOAD += "hid-logitech-dj"

DVBSKYPROVIDER = "kernel"

PREFERRED_VERSION_linux-gigablue = "4.8.3"
PREFERRED_VERSION_linux-libc-headers = "4.8"

IMAGE_FSTYPES ?= "ubi"
UBI_VOLNAME = "rootfs"
MKUBIFS_ARGS = "-m 2048 -e 126976 -c 4096"
UBINIZE_ARGS = "-m 2048 -p 128KiB"

OEM_ARCH = "${MACHINEBUILD}"
```

## meta-brands/meta-gigablue/conf/machine/gb7362.conf
```bitbake
#@TYPE: Machine
#@NAME: Gigablue 7362 Serie
#@DESCRIPTION: Machine configuration for the Gigablue 7362 Serie

SOC_FAMILY = "bcm7362"

# Actually the box has 256MB, but cfe can only flash up to 100MB
# As this variable is used to determine the acceptable preload, use the lower value
FLASHSIZE=128

require conf/machine/include/gigablue-mips.inc

MACHINE_FEATURES += "gbsoftwol directfb osdanimation blindscan-dvbs \
    ${@bb.utils.contains('MACHINEBUILD', 'gbultraue', 'ci blindscan-dvbc colorlcd220 gigabluelcd gigabluelcd220' , '', d)} \
    ${@bb.utils.contains('MACHINEBUILD', 'gbultrase', 'blindscan-dvbc ci' , '', d)} \
    ${@bb.utils.contains('MACHINEBUILD', 'gbx3', 'blindscan-dvbc ci' , '', d)} \
"

### Logitech keyboard ###
KERNEL_MODULE_AUTOLOAD += "hid-logitech"
KERNEL_MODULE_AUTOLOAD += "hid-logitech-dj"

DVBSKYPROVIDER = "kernel"

PREFERRED_VERSION_linux-gigablue = "4.8.3"
PREFERRED_VERSION_linux-libc-headers = "4.8"

IMAGE_FSTYPES ?= "ubi"
UBI_VOLNAME = "rootfs"
MKUBIFS_ARGS = "-m 2048 -e 126976 -c 4096"
UBINIZE_ARGS = "-m 2048 -p 128KiB"

OEM_ARCH = "${MACHINEBUILD}"
```

## meta-brands/meta-gigablue/conf/machine/gb73625.conf
```bitbake
#@TYPE: Machine
#@NAME: Gigablue 73625 Serie
#@DESCRIPTION: Machine configuration for the Gigablue 73625 Serie

SOC_FAMILY = "bcm73625"

# Actually the box has 256MB, but cfe can only flash up to 100MB
# As this variable is used to determine the acceptable preload, use the lower value
FLASHSIZE = "100"

require conf/machine/include/gigablue-mips.inc

MACHINE_FEATURES += "gbsoftwol directfb osdanimation blindscan-dvbs \
    ${@bb.utils.contains('MACHINEBUILD', 'gbx2', 'blindscan-dvbc' , '', d)} \
    ${@bb.utils.contains('MACHINEBUILD', 'gbx3h', 'blindscan-dvbc ci' , '', d)} \
    ${@bb.utils.contains('MACHINEBUILD', 'gbultraueh', 'ci blindscan-dvbc colorlcd220 gigabluelcd gigabluelcd220' , '', d)} \
"

### Logitech keyboard ###
KERNEL_MODULE_AUTOLOAD += "hid-logitech"
KERNEL_MODULE_AUTOLOAD += "hid-logitech-dj"

DVBSKYPROVIDER = "kernel"

PREFERRED_VERSION_linux-gigablue = "4.8.3"
PREFERRED_VERSION_linux-libc-headers = "4.8"

IMAGE_FSTYPES ?= "ubi"
UBI_VOLNAME = "rootfs"
MKUBIFS_ARGS = "-m 2048 -e 126976 -c 4096"
UBINIZE_ARGS = "-m 2048 -p 128KiB"

OEM_ARCH = "${MACHINEBUILD}"
```

## meta-brands/meta-gigablue/conf/machine/gb800se.conf
```bitbake
#@TYPE: Machine
#@NAME: GigaBlue HD 800 SE
#@DESCRIPTION: Machine configuration for the GigaBlue HD 800 SE

MACHINE_NAME = "800 SE"

require conf/machine/include/gigablue.inc

EXTRA_IMAGEDEPENDS += "\
    gigablue-initrd-${MACHINE} \
    enigma2-plugin-systemplugins-vfdcontrol \
    "

MACHINE_EXTRA_RDEPENDS = "\
    enigma2-plugin-systemplugins-vfdcontrol \
    "

MACHINE_FEATURES += "blindscan-dvbc blindscan-dvbs gbprogress singlecore ci"

PREFERRED_VERSION_linux-gigablue = "3.9.6"
PREFERRED_VERSION_linux-libc-headers = "3.9"

CHIPSET = "bcm7325"

MACHINE_KERNEL_PR = "r5"

IMAGE_FSTYPES ?= "ubi"

UBI_VOLNAME = "rootfs"
MKUBIFS_ARGS = "-m 2048 -e 126976 -c 4096"
UBINIZE_ARGS = "-m 2048 -p 128KiB"

IMAGEDIR ?= "gigablue/se"

IMAGE_CMD_ubi_prepend = " \
    rm -rf ${IMAGE_ROOTFS}/boot/*; \
    rm -rf ${IMAGE_ROOTFS}/tmp/*; \
    "

IMAGE_CMD_ubi_append = " \
    mkdir -p ${DEPLOY_DIR_IMAGE}/${IMAGEDIR}; \
    cp ${DEPLOY_DIR_IMAGE}/splash.bin ${DEPLOY_DIR_IMAGE}/${IMAGEDIR}/splash.bin; \
    cp ${DEPLOY_DIR_IMAGE}/initrd.bin ${DEPLOY_DIR_IMAGE}/${IMAGEDIR}/initrd.bin; \
    cp ${DEPLOY_DIR_IMAGE}/initrd.bat ${DEPLOY_DIR_IMAGE}/${IMAGEDIR}/initrd.bat; \
    cp ${DEPLOY_DIR_IMAGE}/dvb.tar.gz ${DEPLOY_DIR_IMAGE}/${IMAGEDIR}/dvb.tar.gz; \
    mv ${DEPLOY_DIR_IMAGE}/${IMAGE_NAME}.rootfs.ubi ${DEPLOY_DIR_IMAGE}/${IMAGEDIR}/${ROOTFS_FILE}; \
    gzip -f -c ${DEPLOY_DIR_IMAGE}/vmlinux-${MACHINE}.bin > ${DEPLOY_DIR_IMAGE}/${IMAGEDIR}/${KERNEL_FILE}; \
    echo ${DISTRO_NAME}-${DISTRO_VERSION}-${DATE} > ${DEPLOY_DIR_IMAGE}/${IMAGEDIR}/imageversion; \
    echo "rename this file to 'force' to force an update without confirmation" > ${DEPLOY_DIR_IMAGE}/${IMAGEDIR}/noforce; \
    cd ${DEPLOY_DIR_IMAGE}; \
    zip -r ${IMAGE_NAME}_usb.zip burn.bat gigablue/*; \
    rm -f ${DEPLOY_DIR_IMAGE}/*.ubifs; \
    rm -rf ${DEPLOY_DIR_IMAGE}/gigablue; \
    "
```

## meta-brands/meta-gigablue/conf/machine/gb800seplus.conf
```bitbake
#@TYPE: Machine
#@NAME: Gigablue SE Plus
#@DESCRIPTION: Machine configuration for the Gigablue SE Plus

MACHINE_NAME = "800 SE Plus"

CHIPSET = "bcm7358"

require conf/machine/include/gigablue.inc

EXTRA_IMAGEDEPENDS += "\
    gigablue-initrd-${MACHINE} \
    enigma2-plugin-systemplugins-vfdcontrol \
    "

MACHINE_EXTRA_RDEPENDS = "\
    enigma2-plugin-systemplugins-vfdcontrol \
    enigma2-plugin-systemplugins-audioeffect \
    "

MACHINE_FEATURES += "blindscan-dvbc blindscan-dvbs extrakernelwifi kernelrt2800 gbplusprogress videoenhancement singlecore ci gbsoftwol"

KERNEL_MODULE_AUTOLOAD = "hid-logitech"
KERNEL_MODULE_AUTOLOAD = "hid-logitech-dj"

PREFERRED_VERSION_linux-gigablue = "3.14.2"
PREFERRED_VERSION_linux-libc-headers = "3.13"
DVBMEDIASINK_CONFIG += " --with-wma --with-pcm --with-eac3 --with-wmv"

GLIBC_EXTRA_OECONF += " --with-__thread"


MACHINE_KERNEL_PR = "r1"

IMAGE_FSTYPES ?= "ubi"

UBI_VOLNAME = "rootfs"
MKUBIFS_ARGS = "-m 2048 -e 126976 -c 4096"
UBINIZE_ARGS = "-m 2048 -p 128KiB"

IMAGEDIR ?= "gigablue/seplus"

IMAGE_CMD_ubi_prepend = " \
    rm -rf ${IMAGE_ROOTFS}/boot/*; \
    rm -rf ${IMAGE_ROOTFS}/tmp/*; \
    "

IMAGE_CMD_ubi_append = " \
    mkdir -p ${DEPLOY_DIR_IMAGE}/${IMAGEDIR}; \
    cp ${DEPLOY_DIR_IMAGE}/splash.bin ${DEPLOY_DIR_IMAGE}/${IMAGEDIR}/splash.bin; \
    cp ${DEPLOY_DIR_IMAGE}/initrd.bin ${DEPLOY_DIR_IMAGE}/${IMAGEDIR}/initrd.bin; \
    cp ${DEPLOY_DIR_IMAGE}/warning.bin ${DEPLOY_DIR_IMAGE}/${IMAGEDIR}/warning.bin; \
    cp ${DEPLOY_DIR_IMAGE}/dvb.tar.gz ${DEPLOY_DIR_IMAGE}/${IMAGEDIR}/dvb.tar.gz; \
    mv ${DEPLOY_DIR_IMAGE}/${IMAGE_NAME}.rootfs.ubi ${DEPLOY_DIR_IMAGE}/${IMAGEDIR}/${ROOTFS_FILE}; \
    gzip -f -c ${DEPLOY_DIR_IMAGE}/vmlinux-${MACHINE}.bin > ${DEPLOY_DIR_IMAGE}/${IMAGEDIR}/${KERNEL_FILE}; \
    echo ${DISTRO_NAME}-${DISTRO_VERSION}.${BUILD_VERSION} > ${DEPLOY_DIR_IMAGE}/${IMAGEDIR}/imageversion; \
    echo "rename this file to 'force' to force an update without confirmation" > ${DEPLOY_DIR_IMAGE}/${IMAGEDIR}/noforce; \
    cd ${DEPLOY_DIR_IMAGE}; \
    zip -r ${IMAGE_NAME}_usb.zip gigablue/*; \
    rm -f ${DEPLOY_DIR_IMAGE}/*.ubifs; \
    rm -rf ${DEPLOY_DIR_IMAGE}/gigablue; \
    "
```

## meta-brands/meta-gigablue/conf/machine/gb800solo.conf
```bitbake
#@TYPE: Machine
#@NAME: GigaBlue 7325 serie
#@DESCRIPTION: Machine configuration for the GigaBlue 7325 serie

SOC_FAMILY = "bcm7325"

FLASHSIZE = "128"

require conf/machine/include/gigablue-mips.inc

MACHINE_FEATURES += "singlecore blindscan-dvbc ci smallflash omb"

PREFERRED_VERSION_linux-gigablue = "3.9.6"

IMAGE_FSTYPES = "jffs2"

KERNEL_EXTRA_CMD = "--disable-compressor=lzo "

MKUBIFS_ARGS = " -e131072 -l -p125829120"
EXTRA_IMAGECMD:jffs2 = " -e131072 -l -p125829120"
```

## meta-brands/meta-gigablue/conf/machine/gbipbox.conf
```bitbake
#@TYPE: Machine
#@NAME: Gigablue IPBox
#@DESCRIPTION: Machine configuration for the Gigablue IPBox

MACHINE_NAME = "IPBox"

CHIPSET = "bcm7358"

require conf/machine/include/gigablue.inc

#EXTRA_IMAGEDEPENDS += "\
#    gigablue-initrd-${MACHINE} \
#    "

MACHINE_EXTRA_RDEPENDS = "\
    enigma2-plugin-systemplugins-audioeffect \
    "

MACHINE_FEATURES += "videoenhancement singlecore"

module_autoload_rt5370sta = "rt5370sta"
module_autoload_hid-logitech = "hid-logitech"
module_autoload_hid-logitech-dj = "hid-logitech-dj"

PREFERRED_VERSION_linux-gigablue = "3.12.1"
PREFERRED_VERSION_linux-libc-headers = "3.12.1"
DVBMEDIASINK_CONFIG += " --with-wma --with-pcm --with-eac3 --with-wmv"

GLIBC_EXTRA_OECONF += " --with-__thread"


MACHINE_KERNEL_PR = "r3"

IMAGE_FSTYPES ?= "ubi"

UBI_VOLNAME = "rootfs"
MKUBIFS_ARGS = "-m 2048 -e 126976 -c 4096"
UBINIZE_ARGS = "-m 2048 -p 128KiB"

IMAGEDIR ?= "gigablue/ipbox"

IMAGE_CMD_ubi_prepend = " \
    rm -rf ${IMAGE_ROOTFS}/boot/*; \
    rm -rf ${IMAGE_ROOTFS}/tmp/*; \
    "

IMAGE_CMD_ubi_append = " \
    mkdir -p ${DEPLOY_DIR_IMAGE}/${IMAGEDIR}; \
    cp ${DEPLOY_DIR_IMAGE}/splash.bin ${DEPLOY_DIR_IMAGE}/${IMAGEDIR}/splash.bin; \
    mv ${DEPLOY_DIR_IMAGE}/${IMAGE_NAME}.rootfs.ubi ${DEPLOY_DIR_IMAGE}/${IMAGEDIR}/${ROOTFS_FILE}; \
    gzip -f -c ${DEPLOY_DIR_IMAGE}/vmlinux-${MACHINE}.bin > ${DEPLOY_DIR_IMAGE}/${IMAGEDIR}/${KERNEL_FILE}; \
    echo ${DISTRO_NAME}-${DISTRO_VERSION}.${BUILD_VERSION} > ${DEPLOY_DIR_IMAGE}/${IMAGEDIR}/imageversion; \
    echo "rename this file to 'force' to force an update without confirmation" > ${DEPLOY_DIR_IMAGE}/${IMAGEDIR}/noforce; \
    cd ${DEPLOY_DIR_IMAGE}; \
    zip -r ${IMAGE_NAME}_usb.zip gigablue/*; \
    rm -f ${DEPLOY_DIR_IMAGE}/*.ubifs; \
    rm -rf ${DEPLOY_DIR_IMAGE}/gigablue; \
    "
```

## meta-brands/meta-gigablue/conf/machine/gbmv200.conf
```bitbake
#@TYPE: Machine
#@NAME: gbmv200
#@DESCRIPTION: Machine configuration for the gbmv200

EXTRA_OECONF:append:pn-enigma2 = " --with-lcddev=/dev/null --with-alphablendingacceleration=always --with-blitaccelerationthreshold=250  --with-fillaccelerationthreshold=190000"

MACHINE_FEATURES += " no-subssupport multitranscoding \
    ${@bb.utils.contains('MACHINEBUILD', 'gbtrio4kpro', 'inibt' , '', d)} \
"

SOC_FAMILY = "hisi3798mv200"
HICHIPSET = "3798mv200"

require conf/machine/include/gigablue-mv200.inc
```

## meta-brands/meta-gigablue/conf/machine/gbquadplus.conf
```bitbake
#@TYPE: Machine
#@NAME: GigaBlue 7356 serie
#@DESCRIPTION: Machine configuration for the GigaBlue 7356 serie

CHIPSET = "bcm7356"

require conf/machine/include/gigablue-oem.inc

MACHINE_FEATURES += "gigabluelcd blindscan-dvbc transcoding ci colorlcd400 gbwol gigabluelcd400 directfb sdl"

### Logitech keyboard ###
KERNEL_MODULE_AUTOLOAD += "hid-logitech"
KERNEL_MODULE_AUTOLOAD += "hid-logitech-dj"

### GigaBlue Wifi ###
KERNEL_MODULE_AUTOLOAD += "8192cu"

### GigaBlue USB-Gigabitlan ###
#KERNEL_MODULE_AUTOLOAD += "smsc75xx"

PREFERRED_VERSION_linux-gigablue = "3.14.2"
PREFERRED_VERSION_linux-libc-headers = "3.13"
DVBMEDIASINK_CONFIG += " --with-wma --with-pcm --with-eac3 --with-wmv"

GLIBC_EXTRA_OECONF += " --with-__thread"

IMAGE_FSTYPES ?= "ubi"

UBI_VOLNAME = "rootfs"
MKUBIFS_ARGS = "-m 2048 -e 126976 -c 4096 -F"
UBINIZE_ARGS = "-m 2048 -p 128KiB"
```
