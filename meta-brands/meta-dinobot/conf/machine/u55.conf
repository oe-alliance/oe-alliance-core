## meta-brands/meta-dream/conf/machine/dreamtwo.conf
```bitbake
#@TYPE: Machine
#@NAME: Dreambox DREAMBOX TWO
#@DESCRIPTION: Machine configuration for the Dreambox DREAMBOX TWO

MACHINE_NAME = "dreamtwo"
RCNAME = "dmm3"

MTD_ROOTFS = "mmcblk0p7"
MTD_KERNEL = "mmcblk0p6"
KERNEL_FILE = "kernel.bin"
ROOTFS_FILE = "rootfs.tar.bz2"
MTD_BLACK  = "mmcblk0"
BOARD = "two"

SOC_FAMILY = "meson64"

PREFERRED_PROVIDER_virtual/egl ?= "meson-mali"
PREFERRED_PROVIDER_virtual/libgles2 ?= "meson-mali"
PREFERRED_PROVIDER_virtual/libgl ?= "mesa-gl"
PREFERRED_PROVIDER_virtual/mesa ?= "mesa-gl"

SERIAL_CONSOLES = "1000000;ttyS0"
UBOOT_ENTRYPOINT = "0x1080000"
UBOOT_MACHINE = "dreamtwo_defconfig"

KERNEL_CLASSES = "kernel-fitimage"
KERNEL_IMAGETYPE = "Image.gz"

MACHINE_FEATURES = "colorlcd240 hdmicec cec fb usbconsole serial usbgadget usbhost vfat ext2 rtc alsa screen ci usbconsole dreamboxv2 skins1080 recovery blindscan-tbs mmc emmc HDMI sbc nogamma alsa-utils pulseaudio alsamixer"

require conf/machine/include/dreambox-meson64.inc

IMAGE_ROOTFS_SIZE_ext4 = "524288"

IMAGE_FSTYPES =+ "tar.bz2"
IMAGEDIR = "${MACHINE}"

do_image_tar[depends] += " mkbootimg-native:do_populate_sysroot"

IMAGE_CMD:tar:prepend = " \
	mkdir -p ${IMAGE_ROOTFS}/usr/lib; \
	if [ "${PACKAGE_LIST}" = "1" ]; then \
        cp ${IMAGE_MANIFEST} ${IMAGE_ROOTFS}/usr/lib/package.lst; \
    fi; \
    mkdir -p ${IMAGE_ROOTFS}/tmp; \
    mkdir -p ${IMAGE_ROOTFS}/var/lib/opkg/info; \
    echo "#!/bin/sh" > ${IMAGE_ROOTFS}/var/lib/opkg/info/kernel-image.postinst; \
    echo "[ -n \"$D\" ] || flash-kernel -c 'console=ttyS0,1000000 root=/dev/mmcblk0p7 rootwait rootfstype=ext4 no_console_suspend' /boot/Image.gz-4.9" >> ${IMAGE_ROOTFS}/var/lib/opkg/info/kernel-image.postinst; \
    chmod 777 ${IMAGE_ROOTFS}/var/lib/opkg/info/kernel-image.postinst; \
    mkdir -p ${DEPLOY_DIR_IMAGE}/${IMAGEDIR}; \
    mkbootimg --base 0 --kernel_offset 0x1080000 --second_offset 0x1000000 -o ${DEPLOY_DIR_IMAGE}/${IMAGEDIR}/${KERNEL_FILE} --kernel ${DEPLOY_DIR_IMAGE}/Image.gz --second ${DEPLOY_DIR_IMAGE}/${MACHINE}.dtb --board ${BOARD} --cmdline "logo=osd0,loaded,0x7f800000 vout=1080p60hz,enable hdmimode=1080p60hz fb_width=1280 fb_height=720  console=ttyS0,1000000 root=/dev/mmcblk0p7 rootwait rootfstype=ext4 no_console_suspend"; \
    echo ${DISTRO_NAME}-${DISTRO_VERSION}.${BUILD_VERSION} > ${DEPLOY_DIR_IMAGE}/${IMAGEDIR}/imageversion; \
    echo "To update with the webbrowser select rootfs.tar.bz2" > ${DEPLOY_DIR_IMAGE}/${IMAGEDIR}/${MACHINE}_READ.ME; \
    cd ${IMAGE_ROOTFS}; \
    tar -cvf ${DEPLOY_DIR_IMAGE}/rootfs.tar -C ${IMAGE_ROOTFS} .; \
    mv ${DEPLOY_DIR_IMAGE}/rootfs.tar ${DEPLOY_DIR_IMAGE}/${IMAGEDIR}/rootfs.tar; \
    bzip2 ${DEPLOY_DIR_IMAGE}/${IMAGEDIR}/rootfs.tar; \
    cd ${DEPLOY_DIR_IMAGE}; \
    zip ${IMAGE_NAME}_mmc.zip ${IMAGEDIR}/*; \
    rm -f ${DEPLOY_DIR_IMAGE}/*.rootfs.tar.bz2; \
    rm -f ${DEPLOY_DIR_IMAGE}/.tar.bz2; \
    rm -f ${DEPLOY_DIR_IMAGE}/*.manifest; \
    rm -f ${DEPLOY_DIR_IMAGE}/.manifest; \
    rm -Rf ${IMAGEDIR}; \
    "

IMAGE_CMD:tar:append = " ; \
    cd ${DEPLOY_DIR_IMAGE}; \
    rm -f *.rootfs.manifest; \
    rm -f .manifest; \
    "

BBMASK = "meta-vuplus/recipes-graphics/"
BBMASK += "meta-vuplus/recipes-webkit/"
BBMASK += "modutils-initscripts.*\.bbappend"
```

## meta-brands/meta-dream/conf/machine/include/dreambox-arm.inc
```bitbake
# dreambox-arm.inc
# We know about rtc
include conf/machine/include/build-extras.inc

BRAND_OEM = "dreambox"
MACHINE_BRAND = "Dreambox"

DVBSKYPROVIDER = "kernel"

GLIBC_EXTRA_OECONF = "--with-tls --with-__thread"

DVBMEDIASINK_CONFIG = "--with-dreambox --with-pcm --with-wma --with-wmv --with-dts=no --with-dtsdownmix --with-eac3 --with-vb6 --with-vb8 --with-vb9 --with-spark --with-h265"

include conf/machine/include/autoload-filesystems.inc
require conf/machine/include/soc-family.inc
require conf/machine/include/tune-cortexa15.inc

MACHINE_EXTRA_RRECOMMENDS = " \
    gstreamer1.0-plugin-dvbmediasink \
    gstreamer1.0-libav \
    ntfs-3g \
    kernel-module-cifs \
    kernel-module-autofs4 \
    kernel-module-hmac \
    kernel-module-md4 \
    kernel-module-ecb \
    kernel-module-fuse \
    kernel-module-nfsd \
    kernel-module-exportfs \
    kernel-module-snd-oss \
    kernel-module-snd-pcm-oss \
    "

MACHINE_ESSENTIAL_EXTRA_RDEPENDS += "\
    dreambox-dvb-modules-${MACHINE} \
    "
    
MACHINE_FEATURES += "dreambox alsa usbhost 3dtv switchoff blindscan-dvbs boxmodel"
# Add "dreambox" override for recipes
MACHINEOVERRIDES .= ":dreambox"

PREFERRED_PROVIDER_virtual/kernel = "linux-dreambox"

PREFERRED_PROVIDER_virtual/blindscan-dvbs = "dreambox-blindscan-utils"
PREFERRED_PROVIDER_virtual/blindscan-dvbc = "dreambox-blindscan-utils"

PREFERRED_VERSION_linux-dreambox ?= "3.14"
PREFERRED_VERSION_linux-libc-headers = "3.14"
PREFERRED_VERSION_nfs-utils ?= "1.2.8"
TARGET_ARCH = "arm"
DEFAULTTUNE = "cortexa15hf-neon-vfpv4"
OLDEST_KERNEL = "3.14"

MACHINE_FEATURES_BACKFILL_CONSIDERED = "rtc gobject-introspection-data"

# Add "MACHINEBUILD" override for recipes
MACHINEOVERRIDES =. "${@['', '${MACHINEBUILD}:']['${MACHINEBUILD}' != '']}"
```

## meta-brands/meta-dream/conf/machine/include/dreambox-mips32el-nf.inc
```bitbake
# dreambox-mips32el.inc

TARGET_ARCH = "mipsel"
DEFAULTTUNE = "mips32el-nf"

MTD_KERNEL = "mtd2"
KERNEL_FILE = "kernel.bin"
ROOTFS_FILE = "rootfs.bin"

EXTRA_IMAGEDEPENDS += "dreambox-secondstage-${MACHINE}"

GLIBC_EXTRA_OECONF = "--with-tls --with-__thread"

DVBMEDIASINK_CONFIG = "--with-dreambox --with-dts=no"

MACHINE_ESSENTIAL_EXTRA_RDEPENDS ?= ""

MACHINE_ESSENTIAL_EXTRA_RDEPENDS += "\
    dreambox-dvb-modules-${MACHINE} \
    kernel-module-dvb-core \
    kernel-module-stv0299 \
"

include conf/machine/include/autoload-usbserial.inc

MACHINE_EXTRA_RRECOMMENDS += " \
    gstreamer1.0-plugin-dvbmediasink \
    ntfs-3g \
    kernel-module-hmac \
    kernel-module-md4 \
    tpmd \
"

MACHINE_ESSENTIAL_EXTRA_RRECOMMENDS += "\
    kernel-module-cifs \
    kernel-module-ntfs \
    kernel-module-iso9660 \
    kernel-module-udf \
    kernel-module-nls-cp850 \
    kernel-module-fuse \
    kernel-module-nfsd \
    kernel-module-exportfs \
    kernel-module-snd-oss \
    kernel-module-snd-pcm-oss \
    "

KERNEL_MODULE_AUTOLOAD += "cifs"
KERNEL_MODULE_AUTOLOAD += "iso9660"
KERNEL_MODULE_AUTOLOAD += "udf"
KERNEL_MODULE_AUTOLOAD += "ntfs"

MACHINE_FEATURES += "dreambox alsa usbhost tpm kernel26-legacy"

PREFERRED_PROVIDER_virtual/bootloader = "dreambox-secondstage-${MACHINE}"
PREFERRED_PROVIDER_virtual/kernel = "linux-dreambox"

PREFERRED_PROVIDER_virtual/blindscan-dvbs = "dreambox-blindscan-utils"
PREFERRED_PROVIDER_virtual/blindscan-dvbc = "dreambox-blindscan-utils"

PREFERRED_VERSION_linux-dreambox = "2.6.18"
PREFERRED_VERSION_linux-libc-headers = "2.6.18"
OLDEST_KERNEL = "2.6.18"

PREFERRED_VERSION_wpa-supplicant = "0.5.8"

KERNEL_IMAGETYPE = "vmlinux"
KERNEL_OUTPUT = "${KERNEL_IMAGETYPE}"
KERNEL_CONSOLE = "${@bb.utils.contains('MACHINE_FEATURES', 'usbconsole', 'ttyS0,115200', 'null', d)}"

MKUBIFS_ARGS = "-m 2048 -e 129024 -c 1996 -x favor_lzo -X 1"
UBINIZE_ARGS = "-m 2048 -p 128KiB -s 512"

DREAMBOX_BUILDIMAGE = "buildimage --arch ${MACHINE} ${EXTRA_BUILDCMD} \
    --erase-block-size ${DREAMBOX_ERASE_BLOCK_SIZE} \
    --flash-size ${DREAMBOX_FLASH_SIZE} \
    --sector-size ${DREAMBOX_SECTOR_SIZE}"

IMAGE_FSTYPES ?= "jffs2nfi"

require conf/machine/include/tune-mips32.inc
```

## meta-brands/meta-dream/conf/machine/include/dreambox-mips32el.inc
```bitbake
# dreambox-mips32el.inc

TARGET_ARCH = "mipsel"
DEFAULTTUNE = "mips32el"

IMAGEDIR ?= "${MACHINE}"

require conf/machine/include/dreambox.inc
require conf/machine/include/tune-mips32.inc

MACHINE_ESSENTIAL_EXTRA_RDEPENDS += "\
    dreambox-dvb-modules-${MACHINE} \
    kernel-module-stv0299 \
    "
```

## meta-brands/meta-dream/conf/machine/include/dreambox-nand-1024mb-2k.inc
```bitbake
DREAMBOX_ERASE_BLOCK_SIZE = "0x20000"
DREAMBOX_SECTOR_SIZE = "2048"
MKUBIFS_ARGS = "-m 2048 -e 124KiB -c 3320 -x favor_lzo -F"
UBINIZE_ARGS = "-m 2048 -p 128KiB -s 2048"
UBINIZE_VOLSIZE = "402MiB"
UBINIZE_DATAVOLSIZE = "1MiB"
```

## meta-brands/meta-dream/conf/machine/include/dreambox-nand-64mb.inc
```bitbake
DREAMBOX_ERASE_BLOCK_SIZE = "0x4000"
DREAMBOX_FLASH_SIZE = "0x4000000"
DREAMBOX_SECTOR_SIZE = "512"
MKUBIFS_ARGS = "-m 512 -e 15KiB -c 3798 -x favor_lzo -X 1 -F -j 4MiB"
UBINIZE_ARGS = "-m 512 -p 16KiB -s 512"
```

## meta-brands/meta-dream/conf/machine/include/dreambox-part-256mb.inc
```bitbake
DREAMBOX_IMAGE_SIZE = "256"
DREAMBOX_PART0_SIZE = "0x100000"
DREAMBOX_PART1_SIZE = "0x700000"
DREAMBOX_PART2_SIZE = "0xF800000"
```

## meta-brands/meta-dream/conf/machine/include/dreambox-part-64mb.inc
```bitbake
DREAMBOX_IMAGE_SIZE = "64"
DREAMBOX_PART0_SIZE = "0x40000"
DREAMBOX_PART1_SIZE = "0x3C0000"
DREAMBOX_PART2_SIZE = "0x3C00000"
```

## meta-brands/meta-dream/conf/machine/include/dreambox-tar.inc
```bitbake
IMAGE_FSTYPES =+ "tar.bz2"
IMAGEDIR = "${MACHINE}"

MTD_KERNEL = "mtd3"
MTD_ROOTFS = "sda3"
KERNEL_FILE = "N/A"
ROOTFS_FILE = "rootfs.tar.bz2"

IMAGE_CMD:tar:prepend = " ; \
	mkdir -p ${IMAGE_ROOTFS}/usr/lib; \
	if [ "${PACKAGE_LIST}" = "1" ]; then \
        cp ${IMAGE_MANIFEST} ${IMAGE_ROOTFS}/usr/lib/package.lst; \
    fi; \
    "

IMAGE_CMD:tar:append = " ; \
    cd ${DEPLOY_DIR_IMAGE}; \
    rm -f *.rootfs.manifest; \
    rm -f .manifest; \
    "

CONVERSION_CMD:bz2:append = ";\
	cd ${DEPLOY_DIR_IMAGE}; \
	mkdir -p ${DEPLOY_DIR_IMAGE}/${IMAGEDIR}; \
	mv ${IMGDEPLOYDIR}/${IMAGE_NAME}.rootfs.tar.bz2 ${DEPLOY_DIR_IMAGE}/${IMAGEDIR}/rootfs.tar.bz2; \
	echo ${DISTRO_NAME}-${DISTRO_VERSION}.${BUILD_VERSION} > ${DEPLOY_DIR_IMAGE}/${IMAGEDIR}/imageversion; \
	echo "dummy file dont delete" > ${DEPLOY_DIR_IMAGE}/${IMAGEDIR}/kernel.bin; \
	zip ${IMAGE_NAME}_flash.zip ${IMAGEDIR}/*; \
	rm -Rf ${IMAGEDIR}; \
	cd ${IMGDEPLOYDIR}; \
"
```

## meta-brands/meta-dream/conf/machine/include/dreambox-ubi.inc
```bitbake
inherit image_types_nfi

IMAGE_FSTYPES ?= "ubinfi"
UBI_VOLNAME = "rootfs"
UBINIZE_VOLSIZE ?= "0"
UBINIZE_DATAVOL ?= "0"

MTD_KERNEL = "mtd3"
MTD_ROOTFS = "mtd3"
KERNEL_FILE = "N/A"
ROOTFS_FILE = "rootfs.bin"
```

## meta-brands/meta-dream/conf/machine/include/dreambox.inc
```bitbake
# dreambox.inc
# We know about rtc
include conf/machine/include/build-extras.inc

BRAND_OEM = "dreambox"
MACHINE_BRAND = "Dreambox"

EXTRA_IMAGEDEPENDS += "dreambox-secondstage-${MACHINE}"

GLIBC_EXTRA_OECONF = "--with-tls --with-__thread"

DVBMEDIASINK_CONFIG = "--with-dreambox --with-pcm --with-wma --with-wmv --with-dtsdownmix --with-eac3 --with-dts"
DVBMEDIASINK_CONFIG_dm7080 = "--with-dreambox --with-pcm --with-wma --with-wmv --with-dtsdownmix --with-eac3 --with-dts --with-vb6 --with-vb8 --with-spark"
DVBMEDIASINK_CONFIG_dm820 = "--with-dreambox --with-pcm --with-wma --with-wmv --with-dtsdownmix --with-eac3 --with-dts --with-vb6 --with-vb8 --with-spark"
DVBMEDIASINK_CONFIG_dm520 = "--with-dreambox --with-pcm --with-wma --with-wmv --with-dtsdownmix --with-eac3 --with-dts --with-vb6 --with-vb8 --with-spark --with-h265"

include conf/machine/include/autoload-filesystems.inc
require conf/machine/include/soc-family.inc

MACHINE_EXTRA_RRECOMMENDS = " \
    gstreamer1.0-plugin-dvbmediasink \
    kernel-module-cifs \
    kernel-module-autofs4 \
    kernel-module-hmac \
    kernel-module-md4 \
    kernel-module-ecb \
    tpmd \
    kernel-module-fuse \
    kernel-module-nfsd \
    kernel-module-exportfs \
    kernel-module-snd-oss \
    kernel-module-snd-pcm-oss \
    ${@bb.utils.contains('MACHINE_FEATURES', 'v3d', 'libvc5dream', '',d)} \
    "
    
MACHINE_FEATURES += "dreambox alsa usbhost 3dtv switchoff tpm blindscan-dvbs boxmodel feature1 feature2"
# Add "dreambox" override for recipes
MACHINEOVERRIDES .= ":dreambox"

PREFERRED_PROVIDER_virtual/bootloader = "dreambox-secondstage-${MACHINE}"
PREFERRED_PROVIDER_virtual/kernel = "linux-dreambox"
PREFERRED_PROVIDER_virtual/kodi = "stb-kodi-${MACHINE}"

PREFERRED_PROVIDER_virtual/blindscan-dvbs = "dreambox-blindscan-utils"
PREFERRED_PROVIDER_virtual/blindscan-dvbc = "dreambox-blindscan-utils"

PREFERRED_VERSION_linux-dreambox ?= "3.2"
PREFERRED_VERSION_linux-libc-headers = "3.2"
PREFERRED_VERSION_nfs-utils ?= "1.2.8"
PREFERRED_VERSION_rt8812au = "4.3.14"

DREAMBOX_BUILDIMAGE = "buildimage --arch ${MACHINE} ${EXTRA_BUILDCMD} \
    --erase-block-size ${DREAMBOX_ERASE_BLOCK_SIZE} \
    --sector-size ${DREAMBOX_SECTOR_SIZE}"

# Add "MACHINEBUILD" override for recipes
MACHINEOVERRIDES =. "${@['', '${MACHINEBUILD}:']['${MACHINEBUILD}' != '']}"
```
