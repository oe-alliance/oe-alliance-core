## meta-brands/meta-dinobot/conf/machine/u55.conf
```bitbake
#@TYPE: Machine
#@NAME: u55
#@DESCRIPTION: Machine configuration for the u55

EXTRA_OECONF:append:pn-enigma2 = " --with-lcddev=/dev/null --with-alphablendingacceleration=always"

SOC_FAMILY = "hisi3798mv200"

SDCARD = "no"

MACHINE_FEATURES += " multitranscoding hiaccel RCA blindscan-dvbs kodi22 7segment skins1080"

KERNEL_MODULE_AUTOLOAD += "rt8188fu"

VER = "-nochip"

require conf/machine/include/dinobot-cortexa15.inc
require conf/machine/include/dinobot-ubi.inc
```

## meta-brands/meta-dream/conf/layer.conf
```bitbake
# We have a conf and classes directory, append to BBPATH
BBPATH .= ":${LAYERDIR}"

# We have a recipes directory, add to BBFILES
BBFILES += "${LAYERDIR}/recipes-*/*.bb ${LAYERDIR}/recipes-*/*.bbappend \
            ${LAYERDIR}/recipes-*/*/*.bb ${LAYERDIR}/recipes-*/*/*.bbappend"

BBFILE_COLLECTIONS += "dream-layer"
BBFILE_PATTERN_brands-layer := "^${LAYERDIR}/"
BBFILE_PRIORITY_brands-layer = "7"

OEA-META-VENDOR-BASE := '${@os.path.normpath("${LAYERDIR}/../")}'
```

## meta-brands/meta-dream/conf/machine/dm500hd.conf
```bitbake
#@TYPE: Machine
#@NAME: Dreambox DM500HD
#@DESCRIPTION: Machine configuration for the Dreambox DM500HD

MACHINE_NAME = "DM500HD"
RCNAME = "dmm1"

FLASHSIZE = "64"

MACHINE_FEATURES += "dvb-c blindscan-dvbc hdmicec fan libpassthrough usbconsole smallflash dreamboxv1 omb HDMI SCART"

require conf/machine/include/dreambox-brcmnand.inc
require conf/machine/include/dreambox-nand-64mb.inc
require conf/machine/include/dreambox-part-64mb.inc
require conf/machine/include/dreambox-jffs2.inc
require conf/machine/include/dreambox-mips32el.inc

SOC_FAMILY = "bcm7405"

# Add "dreamboxv1" override for recipes
MACHINEOVERRIDES .= ":dreamboxv1"
```

## meta-brands/meta-dream/conf/machine/dm500hdv2.conf
```bitbake
#@TYPE: Machine
#@NAME: Dreambox DM500HDv2
#@DESCRIPTION: Machine configuration for the Dreambox DM500HDv2

MACHINE_NAME = "DM500HDV2"

FLASHSIZE = "96"

MACHINE_FEATURES += "dvb-c blindscan-dvbc hdmicec fan libpassthrough usbconsole dreamboxv1 omb HDMI SCART"

require conf/machine/include/dreambox-hw-ecc.inc
require conf/machine/include/dreambox-nand-1024mb-2k.inc
require conf/machine/include/dreambox-part-1024mb.inc
require conf/machine/include/dreambox-ubi.inc
require conf/machine/include/dreambox-mips32el.inc

SOC_FAMILY = "bcm7405"

# Add "dreamboxv1" override for recipes
MACHINEOVERRIDES .= ":dreamboxv1"
```

## meta-brands/meta-dream/conf/machine/dm520.conf
```bitbake
#@TYPE: Machine
#@NAME: Dreambox DM520
#@DESCRIPTION: Machine configuration for the Dreambox DM520

MACHINE_NAME = "DM520"
RCNAME = "dmm2"

FLASHSIZE = "512"

PREFERRED_PROVIDER_virtual/egl ?= "libvc5dream"
PREFERRED_PROVIDER_virtual/libgl ?= "mesa-gl"
PREFERRED_PROVIDER_virtual/libgles1 ?= "libvc5dream"
PREFERRED_PROVIDER_virtual/libgles2 ?= "libvc5dream"
PREFERRED_PROVIDER_virtual/mesa ?= "mesa-gl"

MACHINE_FEATURES += "ci dvb-c blindscan-dvbc hdmicec dvd libpassthrough usbconsole dreamboxv2 recovery HDMI oem-info"

SOC_FAMILY = "bcm73625"

MTD_KERNEL = "mtd2"
MTD_ROOTFS = "mtd0"
KERNEL_FILE = "kernel.bin"
ROOTFS_FILE = "rootfs.bin"

UBI_VOLNAME = "dreambox-rootfs"
MKUBIFS_ARGS = "-m 2048 -e 126976 -c 4008"
UBINIZE_ARGS = "-m 2048 -p 128KiB"

PREFERRED_VERSION_linux-dreambox = "3.4"

DISTRO_FEATURES_GFX:mipsel ?= " opengl"

PACKAGECONFIG:pn-glmark2 = "gles2"

PACKAGECONFIG:pn-cogl-1.0 = "egl-kms egl-null \
        ${@bb.utils.contains('DISTRO_FEATURES', 'opengl', 'gles2', '', d)}"

PACKAGECONFIG:pn-weston = "${@bb.utils.contains('DISTRO_FEATURES', 'opengl', 'gles', '', d)}"

DREAMBOX_IMAGE_SIZE ??= "1024"

IMAGE_FSTYPES = "tar.xz ubi"

require conf/machine/include/dreambox-mips32el.inc

IMAGE_CMD:tar:prepend = "\
	mkdir -p ${IMAGE_ROOTFS}/usr/lib; \
	if [ "${PACKAGE_LIST}" = "1" ]; then \
        cp ${IMAGE_MANIFEST} ${IMAGE_ROOTFS}/usr/lib/package.lst; \
    fi; \
	mkdir -p ${IMAGE_ROOTFS}/tmp; \
	mkdir -p ${IMAGE_ROOTFS}/var/lib/opkg/info; \
	echo "#!/bin/sh" > ${IMAGE_ROOTFS}/var/lib/opkg/info/dreambox-secondstage.postinst; \
	echo "[ -n \"$D\" ] || flash-ssbl /usr/share/dreambox-secondstage/ssbl.bin" >> ${IMAGE_ROOTFS}/var/lib/opkg/info/dreambox-secondstage.postinst; \
	chmod 777 ${IMAGE_ROOTFS}/var/lib/opkg/info/dreambox-secondstage.postinst; \
	echo "#!/bin/sh" > ${IMAGE_ROOTFS}/var/lib/opkg/info/kernel-image.postinst; \
	echo "[ -n \"$D\" ] || flash-kernel /boot/vmlinux.gz-3.4-4.0-${MACHINE}" >> ${IMAGE_ROOTFS}/var/lib/opkg/info/kernel-image.postinst; \
	chmod 777 ${IMAGE_ROOTFS}/var/lib/opkg/info/kernel-image.postinst; \
	rm -Rf ${DEPLOY_DIR_IMAGE}/*.ubifs; \
	rm -Rf ${DEPLOY_DIR_IMAGE}/*.tar.xz; \
	"

CONVERSION_CMD:xz:append = ";\
	cd ${DEPLOY_DIR_IMAGE}; \
	mv ${IMGDEPLOYDIR}/${IMAGE_NAME}.tar.xz ${DEPLOY_DIR_IMAGE}/${IMAGE_NAME}.rootfs.tar.xz; \
	echo ${DISTRO_NAME}-${DISTRO_VERSION}.${BUILD_VERSION} > ${DEPLOY_DIR_IMAGE}/imageversion; \
	echo "Image for WebBrowser Update" >> ${DEPLOY_DIR_IMAGE}/imageversion; \
	zip ${IMAGE_NAME}_web.zip ${IMAGE_NAME}.rootfs.tar.xz imageversion; \
	cd ${IMGDEPLOYDIR}; \
"

IMAGE_CMD:ubi:append = "\
	cd ${DEPLOY_DIR_IMAGE}; \
	mkdir -p ${DEPLOY_DIR_IMAGE}/${IMAGEDIR}; \
	mv ${IMGDEPLOYDIR}/${IMAGE_NAME}.ubi ${DEPLOY_DIR_IMAGE}/${IMAGEDIR}/${ROOTFS_FILE}; \
	cp ${DEPLOY_DIR_IMAGE}/vmlinux.gz ${DEPLOY_DIR_IMAGE}/${IMAGEDIR}/${KERNEL_FILE}; \
	echo ${DISTRO_NAME}-${DISTRO_VERSION}.${BUILD_VERSION} > ${DEPLOY_DIR_IMAGE}/${IMAGEDIR}/imageversion; \
	echo "Flash Online Image" >> ${DEPLOY_DIR_IMAGE}/${IMAGEDIR}/imageversion; \
	zip ${IMAGE_NAME}_flash.zip ${IMAGEDIR}/*; \
	rm -Rf ${IMAGEDIR}; \
	"
```

## meta-brands/meta-dream/conf/machine/dm7020hdv2.conf
```bitbake
#@TYPE: Machine
#@NAME: Dreambox DM7020HD
#@DESCRIPTION: Machine configuration for the Dreambox DM7020HDV2

MACHINE_NAME = "DM7020HDV2"

FLASHSIZE = "96"

MACHINE_FEATURES += "dvb-c blindscan-dvbc hdmicec ci dvd libpassthrough usbconsole colorlcd128 dreamboxv1 omb grautec HDMI SCART RCA BootloaderMax110"

require conf/machine/include/dreambox-hw-ecc.inc
require conf/machine/include/dreambox-nand-1024mb-2k.inc
require conf/machine/include/dreambox-part-1024mb.inc
require conf/machine/include/dreambox-ubi.inc
require conf/machine/include/dreambox-mips32el.inc

SOC_FAMILY = "bcm7405"

MACHINE_EXTRA_RRECOMMENDS += "dreambox-enigma2-config"

# Add "dreamboxv1" override for recipes
MACHINEOVERRIDES .= ":dreamboxv1"
```

## meta-brands/meta-dream/conf/machine/dm800.conf
```bitbake
#@TYPE: Machine
#@NAME: Dreambox DM 800 HD PVR
#@DESCRIPTION: Machine configuration for the Dreambox DM 800 HD PVR

MACHINE_NAME = "DM800HD"
BRAND_OEM = "dreambox"
MACHINE_BRAND = "Dreambox"

FLASHSIZE=64

MACHINE_ESSENTIAL_EXTRA_RDEPENDS += " dm800-shutdown"

MACHINE_FEATURES += "nowifi dvb-c blindscan-dvbc dvbapi5 wifiusblegacy smallflash wifi61 colorlcd128 legacykernel singlecore no-cl-svr no-nmap dreamboxv1 omb"

require conf/machine/include/dreambox-brcmnand.inc
require conf/machine/include/dreambox-nand-64mb.inc
require conf/machine/include/dreambox-part-64mb.inc
require conf/machine/include/dreambox-jffs2.inc
require conf/machine/include/dreambox-mips32el-nf.inc
require conf/machine/include/build-extras.inc

SOC_FAMILY = "bcm7401"

DVBPROVIDER = "v4l-dvb"    

PREFERRED_VERSION_rtl8192cu = "3.3.0"
PREFERRED_VERSION_libnl = "3.2.24"

# Add "dreamboxv1" override for recipes
MACHINEOVERRIDES .= ":dreamboxv1"
```

## meta-brands/meta-dream/conf/machine/dm8000.conf
```bitbake
#@TYPE: Machine
#@NAME: Dreambox DM 8000 HD PVR
#@DESCRIPTION: Machine configuration for the Dreambox DM 8000 HD PVR

MACHINE_NAME = "DM8000HD"

FLASHSIZE = "96"

MACHINE_FEATURES += "pci dvb-c blindscan-dvbc frontprocessor ci dvd libpassthrough colorlcd128 omb dreamboxv1 grautec singlecore no-cl-svr smallflash DVI SCART YUV RCA"

require conf/machine/include/dreambox-nand-256mb.inc
require conf/machine/include/dreambox-part-256mb.inc
require conf/machine/include/dreambox-ubi.inc
require conf/machine/include/dreambox-mips32el.inc

DVBMEDIASINK_CONFIG += " --with-limited-mpeg4v2 "

SOC_FAMILY = "bcm7400"

EXTRA_IMAGEDEPENDS += " \
    enigma2-plugin-extensions-fancontrol2 \
    "

MACHINE_EXTRA_RDEPENDS = " \
    enigma2-plugin-extensions-fancontrol2 \
    "

MACHINE_EXTRA_RRECOMMENDS += "dreambox-enigma2-config"

# Add "dreamboxv1" override for recipes
MACHINEOVERRIDES .= ":dreamboxv1"
```

## meta-brands/meta-dream/conf/machine/dm800sev2.conf
```bitbake
#@TYPE: Machine
#@NAME: Dreambox DM800seV2
#@DESCRIPTION: Machine configuration for the Dreambox DM800seV2

MACHINE_NAME = "DM800SEV2"

FLASHSIZE = "96"

MACHINE_FEATURES += "dvb-c blindscan-dvbc colorlcd bwlcd96 hdmicec fan libpassthrough usbconsole dreamboxv1 omb HDMI SCART"

require conf/machine/include/dreambox-hw-ecc.inc
require conf/machine/include/dreambox-nand-1024mb-2k.inc
require conf/machine/include/dreambox-part-1024mb.inc
require conf/machine/include/dreambox-ubi.inc
require conf/machine/include/dreambox-mips32el.inc

SOC_FAMILY = "bcm7405"

# Add "dreamboxv1" override for recipes
MACHINEOVERRIDES .= ":dreamboxv1"
```

## meta-brands/meta-dream/conf/machine/dm820.conf
```bitbake
#@TYPE: Machine
#@NAME: Dreambox DM7080
#@DESCRIPTION: Machine configuration for the Dreambox DM820

MACHINE_NAME = "DM820"
RCNAME = "dmm2"

FLASHSIZE = "4096"

PREFERRED_PROVIDER_virtual/egl ?= "libvc5dream"
PREFERRED_PROVIDER_virtual/libgl ?= "mesa-gl"
PREFERRED_PROVIDER_virtual/libgles1 ?= "libvc5dream"
PREFERRED_PROVIDER_virtual/libgles2 ?= "libvc5dream"
PREFERRED_PROVIDER_virtual/mesa ?= "mesa-gl"

MACHINE_FEATURES += "dvb-c blindscan-dvbc hdmicec ci dvd libpassthrough usbconsole colorlcd bwlcd96 dreamboxv2 recovery v3d HDMI HDMI-IN-FHD"

MTD_ROOTFS = "mmcblk0p1"
MTD_KERNEL = "mmcblk0p1"
KERNEL_FILE = "kernel.bin"
ROOTFS_FILE = "rootfs.tar.bz2"
MTD_BLACK  = "mmcblk0"

SOC_FAMILY = "bcm7435"

PREFERRED_VERSION_linux-dreambox = "3.4"

DISTRO_FEATURES_GFX:mipsel ?= " opengl"

PACKAGECONFIG:pn-glmark2 = "gles2"

PACKAGECONFIG:pn-cogl-1.0 = "egl-kms egl-null \
        ${@bb.utils.contains('DISTRO_FEATURES', 'opengl', 'gles2', '', d)}"

PACKAGECONFIG:pn-weston = "${@bb.utils.contains('DISTRO_FEATURES', 'opengl', 'gles', '', d)}"

DREAMBOX_IMAGE_SIZE ??= "1024"

IMAGE_FSTYPES =+ "tar.bz2"
IMAGEDIR = "${MACHINE}"

EXTRA_IMAGEDEPENDS += " enigma2-plugin-extensions-fancontrol2"
MACHINE_EXTRA_RDEPENDS = " enigma2-plugin-extensions-fancontrol2"

require conf/machine/include/dreambox-mips32el.inc

IMAGE_CMD:tar:prepend = "\
	mkdir -p ${IMAGE_ROOTFS}/tmp; \
	mkdir -p ${IMAGE_ROOTFS}/var/lib/opkg/info; \
	echo "#!/bin/sh" > ${IMAGE_ROOTFS}/var/lib/opkg/info/dreambox-secondstage.postinst; \
	echo "[ -n \"$D\" ] || flash-ssbl /usr/share/dreambox-secondstage/ssbl.bin" >> ${IMAGE_ROOTFS}/var/lib/opkg/info/dreambox-secondstage.postinst; \
	chmod 777 ${IMAGE_ROOTFS}/var/lib/opkg/info/dreambox-secondstage.postinst; \
	echo "#!/bin/sh" > ${IMAGE_ROOTFS}/var/lib/opkg/info/kernel-image.postinst; \
	echo "[ -n \"$D\" ] || flash-kernel /boot/vmlinux.gz-3.4-4.0-${MACHINE}" >> ${IMAGE_ROOTFS}/var/lib/opkg/info/kernel-image.postinst; \
	chmod 777 ${IMAGE_ROOTFS}/var/lib/opkg/info/kernel-image.postinst; \
"

CONVERSION_CMD:bz2:append = ";\
	cd ${DEPLOY_DIR_IMAGE}; \
	mkdir -p ${DEPLOY_DIR_IMAGE}/${IMAGEDIR}; \
	mv ${IMGDEPLOYDIR}/${IMAGE_NAME}.rootfs.tar.bz2 ${DEPLOY_DIR_IMAGE}/${IMAGEDIR}/rootfs.tar.bz2; \
	echo ${DISTRO_NAME}-${DISTRO_VERSION}.${BUILD_VERSION} > ${DEPLOY_DIR_IMAGE}/${IMAGEDIR}/imageversion; \
	echo "dummy file dont delete" > ${DEPLOY_DIR_IMAGE}/${IMAGEDIR}/kernel.bin; \
	zip ${IMAGE_NAME}_flash.zip ${IMAGEDIR}/*; \
	rm -Rf ${IMAGEDIR}; \
	cd ${IMGDEPLOYDIR}; \
"
```

## meta-brands/meta-dream/conf/machine/dm900.conf
```bitbake
#@TYPE: Machine
#@NAME: Dreambox DM900
#@DESCRIPTION: Machine configuration for the Dreambox DM900

MACHINE_NAME = "DM900"
MTD_ROOTFS = "mmcblk0p2"
MTD_KERNEL = "mmcblk0p1"
KERNEL_FILE = "kernel.bin"
ROOTFS_FILE = "rootfs.tar.bz2"

PREFERRED_PROVIDER_virtual/egl ?= "libvc5driver"
PREFERRED_PROVIDER_virtual/libgles1 ?= "libvc5driver"
PREFERRED_PROVIDER_virtual/libgles2 ?= "libvc5driver"

PREFERRED_PROVIDER_virtual/libgl ?= "mesa-gl"
PREFERRED_PROVIDER_virtual/mesa ?= "mesa-gl"

MACHINE_FEATURES += "dvb-c blindscan-dvbc hdmicec ci dvd libpassthrough usbconsole colorlcd400 dreamboxv2 skins1080 recovery blindscan-tbs"

SOC_FAMILY = "bcm7252s"

PREFERRED_VERSION_linux-dreambox = "3.14"

DISTRO_FEATURES_GFX_mipsel ?= " opengl"

PACKAGECONFIG_pn-glmark2 = "gles2"

PACKAGECONFIG_pn-cogl-1.0 = "egl-kms egl-null \
        ${@bb.utils.contains('DISTRO_FEATURES', 'opengl', 'gles2', '', d)}"

PACKAGECONFIG_pn-weston = "${@bb.utils.contains('DISTRO_FEATURES', 'opengl', 'gles', '', d)}"

DREAMBOX_IMAGE_SIZE ??= "1024"

PREFERRED_VERSION_gnupg ?= "1.4.7"

IMAGE_FSTYPES =+ "tar.bz2"
IMAGEDIR = "${MACHINE}"

require conf/machine/include/dreambox-arm.inc

IMAGE_CMD_tar_prepend = " \
    mkdir -p ${IMAGE_ROOTFS}/tmp; \
    mkdir -p ${IMAGE_ROOTFS}/var/lib/opkg/info; \
    mkdir -p ${DEPLOY_DIR_IMAGE}/${IMAGEDIR}; \
    cp ${DEPLOY_DIR_IMAGE}/zImage ${DEPLOY_DIR_IMAGE}/${IMAGEDIR}/${KERNEL_FILE}; \
    echo ${DISTRO_NAME}-${DISTRO_VERSION}.${BUILD_VERSION} > ${DEPLOY_DIR_IMAGE}/${IMAGEDIR}/imageversion; \
    cd ${IMAGE_ROOTFS}; \
    tar -cvf ${DEPLOY_DIR_IMAGE}/rootfs.tar -C ${IMAGE_ROOTFS} .; \
    mv ${DEPLOY_DIR_IMAGE}/rootfs.tar ${DEPLOY_DIR_IMAGE}/${IMAGEDIR}/rootfs.tar; \
    bzip2 ${DEPLOY_DIR_IMAGE}/${IMAGEDIR}/rootfs.tar; \
    cd ${DEPLOY_DIR_IMAGE}; \
    zip ${IMAGE_NAME}_web.zip ${IMAGEDIR}/*; \
    rm -f ${DEPLOY_DIR_IMAGE}/*.rootfs.tar.bz2; \
    rm -f ${DEPLOY_DIR_IMAGE}/.tar.bz2; \
    rm -f ${DEPLOY_DIR_IMAGE}/*.manifest; \
    rm -f ${DEPLOY_DIR_IMAGE}/.manifest; \
    rm -Rf ${IMAGEDIR}; \
    "

IMAGE_CMD_tar_append = " ; \
    cd ${DEPLOY_DIR_IMAGE}; \
    rm -f *.rootfs.manifest; \
    rm -f .manifest; \
    "

BBMASK = "meta-vuplus/recipes-graphics/"
BBMASK += "meta-vuplus/recipes-webkit/"
```
