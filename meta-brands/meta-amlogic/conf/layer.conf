## meta-brands/meta-amlogic/conf/layer.conf
```bitbake
BBPATH .= ":${LAYERDIR}"
BBFILES += "${LAYERDIR}/recipes-*/*/*.bb ${LAYERDIR}/recipes-*/*/*.bbappend"

BBFILE_COLLECTIONS += "amlogic-layer"
BBFILE_PATTERN_amlogic-layer := "^${LAYERDIR}/"
BBFILE_PRIORITY_amlogic-layer = "7"
LAYERSERIES_COMPAT_amlogic-layer = "blacksail"
LAYERDEPENDS_amlogic-layer = "core oe-alliance-layer"
```

## meta-brands/meta-amlogic/conf/machine/gtxcombo.conf
```bitbake
#@TYPE: Machine
#@NAME: GTMedia GTX Combo
#@DESCRIPTION: Amlogic SM1 receiver with USB and internal eMMC multiboot

MACHINE_NAME = "gtxcombo"
RCNAME = "gtxcombo"
MTD_BLACK = "mmcblk0"
require conf/machine/include/gtmedia-sm1.inc

# Local image assembly: multiboot, standalone recovery and USB/eMMC.
# Applied only to the two distribution image recipes, not the recovery ramfs.
GTX_IMAGE_CLASS = "gtxcombo-images"
BOOTLOGO_FILENAME = "splash-${DISTRO_NAME}.bin"
MACHINE_EXTRA_RDEPENDS += "linux-firmware-rtl-nic"
MACHINE_EXTRA_RDEPENDS += "gtx-multiboot gtx-rc-keymap gtx-media-modules gtx-dvb-frontends gtx-cimax-usb kernel-module-amsmc"

PREFERRED_PROVIDER_virtual/kernel = "linux-gtx"
PREFERRED_PROVIDER_virtual/egl = "gtx-mali-fbdev"
PREFERRED_PROVIDER_virtual/libgles2 = "gtx-mali-fbdev"
RETROARCH_GLES_RDEPENDS = "gtx-mali-fbdev"
PREFERRED_VERSION_linux-gtx = "5.15.196"
KERNEL_DEVICETREE = "amlogic/sm1_s905x3_gtxcombo.dtb"
SERIAL_CONSOLES = "115200;ttyS0"
MACHINE_FEATURES = "7segment alsa ci ext2 serial usbhost vfat AV_JACK HDMI bootsplash"
MACHINE_FEATURES += "fb skins1080 mmc emmc switchoff wifiusbmodule"
MACHINE_FEATURES += "skins1440 ${E2EGL_MACHINE_FEATURE} mali hdmicec cec rtc dvb-c wifi bluetooth inibt"
VIRTUAL-RUNTIME_blindscan_dvbs = "blindscan-s2"
MACHINE_FEATURES += "blindscan-dvbs"
MACHINE_FEATURES += "alsa-utils alsamixer pulseaudio sbc nogamma multitranscoding"
MACHINE_FEATURES += "retrogaming kodi22 hbbtv2"
PREFERRED_PROVIDER_virtual/kodi = "stb-kodi-gtxcombo"
PREFERRED_RPROVIDER_virtual-kodi = "stb-kodi-gtxcombo"
PREFERRED_VERSION_enigma2-plugin-extensions-chromium2 = "1.0+20261112"
PREFERRED_VERSION_enigma2-plugin-extensions-chromium2-hbbtv = "1.0+20261112"

MACHINE_EXTRA_RRECOMMENDS += "gtx-sat-firmware"
KERNEL_MODULE_AUTOLOAD += "amsmc"
MACHINE_EXTRA_RRECOMMENDS += "gtx-unisoc bluez5 kernel-module-hci-uart gtx-bt-keymap enigma2-plugin-extensions-btdevicesmanager"
MACHINE_EXTRA_RRECOMMENDS += "gstreamer1.0-plugin-dvbmediasink enigma2-plugin-systemplugins-serviceapp"

# oea-wifi-driver searches defconfig files; the GTX fetches its pinned config.
INTREE_WIFI:append:gtxcombo = " mt7601u mt76x0u rt2800usb rtl8192cu rtl8xxxu"

MACHINE_EXTRA_RRECOMMENDS += "gtx-mosaic gtx-player-video enigma2-plugin-extensions-quadpip"
MACHINE_EXTRA_RRECOMMENDS += "gtx-vtuner satipclient"
DVBSKYPROVIDER = "kernel"
# T680CI probes its Si2168, Si2157 and SP2 over I2C at runtime.
MACHINE_EXTRA_RRECOMMENDS += "kernel-module-dvb-usb-dvbsky kernel-module-si2168 kernel-module-si2157 kernel-module-sp2 kernel-module-rc-dvbsky firmware-dvb-fe-si2168"
MACHINE_EXTRA_RRECOMMENDS += "gtx-mali-fbdev"
```
