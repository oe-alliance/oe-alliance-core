## meta-oe/conf/machine/formuler1.conf
```bitbake
#@TYPE: Machine
#@NAME: Formuler F1
#@DESCRIPTION: Machine configuration for the Formuler F1

MACHINE_NAME = "F1"

PREFERRED_VERSION_linux-formuler = "3.14.2"
PREFERRED_VERSION_linux-libc-headers = "3.13"

CHIPSET = "bcm7356"

UBI_VOLNAME = "rootfs"
MKUBIFS_ARGS = "-m 2048 -e 126976 -c 8192"
UBINIZE_ARGS = "-m 2048 -p 128KiB"

require conf/machine/include/formuler.inc

MACHINE_FEATURES += "dvb-c ci extrakernelwifi kernelrt2800 textlcd videoenhancement"

MACHINE_KERNEL_PR = "r0"
```

## meta-oe/conf/machine/gb800solo.conf
```bitbake
#@TYPE: Machine
#@NAME: GigaBlue HD 800 Solo
#@DESCRIPTION: Machine configuration for the GigaBlue HD 800 Solo

MACHINE_NAME = "800 Solo"

require conf/machine/include/gigablue.inc

EXTRA_IMAGEDEPENDS += "\
    enigma2-plugin-systemplugins-vfdcontrol \
    gigablue-vfdctl \
    "

MACHINE_EXTRA_RDEPENDS = " \
    enigma2-plugin-systemplugins-vfdcontrol \
    mtd-utils-jffs2 \
    "

PREFERRED_VERSION_linux-gigablue = "3.1.1"
PREFERRED_VERSION_linux-libc-headers = "3.1"
PREFERRED_VERSION_nfs-utils ?= "1.2.8"

MACHINE_FEATURES += " blindscan-dvbs gbprogress singlecore"

CHIPSET = "bcm7325"

MACHINE_KERNEL_PR = "r5"

IMAGE_FSTYPES ?= "jffs2"

KERNEL_EXTRA_CMD = "--disable-compressor=lzo "

IMAGEDIR ?= "gigablue/solo"

EXTRA_IMAGECMD_jffs2 = " -e131072 -l -p125829120"
IMAGE_CMD_jffs2_prepend = " \
    rm -rf ${IMAGE_ROOTFS}/boot/*; \
    rm -rf ${IMAGE_ROOTFS}/tmp/*; \
    "

IMAGE_CMD_jffs2_append = "; \
    mkdir -p ${DEPLOY_DIR_IMAGE}/${IMAGEDIR}; \
    cp ${DEPLOY_DIR_IMAGE}/splash.bin ${DEPLOY_DIR_IMAGE}/${IMAGEDIR}/splash.bin; \
    mv ${DEPLOY_DIR_IMAGE}/${IMAGE_NAME}.rootfs.jffs2 ${DEPLOY_DIR_IMAGE}/${IMAGEDIR}/${ROOTFS_FILE}; \
    gzip -f -c ${DEPLOY_DIR_IMAGE}/vmlinux-${MACHINE}.bin > ${DEPLOY_DIR_IMAGE}/${IMAGEDIR}/${KERNEL_FILE}; \
    echo ${DISTRO_NAME}-${DISTRO_VERSION}-${DATE} > ${DEPLOY_DIR_IMAGE}/${IMAGEDIR}/imageversion; \
    echo "rename this file to 'force' to force an update without confirmation" > ${DEPLOY_DIR_IMAGE}/${IMAGEDIR}/noforce; \
    cd ${DEPLOY_DIR_IMAGE}; \
    zip -r ${IMAGE_NAME}_usb.zip gigablue/*; \
    zip ${IMAGE_NAME}_usb.zip burn.bat; \
    rm -f ${DEPLOY_DIR_IMAGE}/*.jffs2; \
    rm -rf ${DEPLOY_DIR_IMAGE}/gigablue; \
    "
```

## meta-oe/conf/machine/include/dreambox-mips32el-nf.inc
```bitbake
# dreambox-mips32el.inc

TARGET_ARCH = "mipsel"
DEFAULTTUNE = "mips32el-nf"

EXTRA_IMAGEDEPENDS += "dreambox-secondstage-${MACHINE}"

GLIBC_EXTRA_OECONF = "--with-tls --with-__thread"

MACHINE_ESSENTIAL_EXTRA_RDEPENDS ?= ""

MACHINE_ESSENTIAL_EXTRA_RDEPENDS += "\
    dreambox-dvb-modules-${MACHINE} \
    ${@base_conditional('MACHINE', 'dm800', 'kernel-module-dvb-core', 'v4l-dvb-module-dvb-core', d)} \
    ${@base_conditional('MACHINE', 'dm800', 'kernel-module-stv0299', 'v4l-dvb-module-stv0299', d)} \
"

include conf/machine/include/autoload-usbserial.inc

MACHINE_EXTRA_RRECOMMENDS = " \
    gst-plugin-dreambox-dvbmediasink \
    ntfs-3g \
    kernel-module-hmac \
    kernel-module-md4 \
    tpmd \
"

MACHINE_ESSENTIAL_EXTRA_RRECOMMENDS = "\
    kernel-module-cifs \
    kernel-module-ntfs \
    kernel-module-iso9660 \
    kernel-module-udf \
    kernel-module-nls-cp850 \
    "
module_autoload_cifs = "cifs"
module_autoload_iso9660 = "iso9660"
module_autoload_udf = "udf"
module_autoload_ntfs = "ntfs"

MACHINE_FEATURES += "dreambox alsa usbhost tpm kernel26-legacy"

PREFERRED_PROVIDER_virtual/bootloader = "dreambox-secondstage-${MACHINE}"
PREFERRED_PROVIDER_virtual/kernel = "linux-dreambox"

PREFERRED_PROVIDER_virtual/blindscan-dvbs = "dreambox-blindscan-utils"
PREFERRED_PROVIDER_virtual/blindscan-dvbc = "dreambox-blindscan-utils"

PREFERRED_VERSION_linux-dreambox = "2.6.18"
PREFERRED_VERSION_linux-libc-headers = "2.6.18"

PREFERRED_VERSION_wpa-supplicant = "0.5.8"

KERNEL_IMAGETYPE = "vmlinux"
KERNEL_OUTPUT = "${KERNEL_IMAGETYPE}"
KERNEL_CONSOLE = "${@base_contains('MACHINE_FEATURES', 'usbconsole', 'ttyS0,115200', 'null', d)}"

MKUBIFS_ARGS = "-m 2048 -e 129024 -c 1996 -x favor_lzo -X 1"
UBINIZE_ARGS = "-m 2048 -p 128KiB -s 512"

DREAMBOX_BUILDIMAGE = "buildimage --arch ${MACHINE} ${EXTRA_BUILDCMD} \
    --erase-block-size ${DREAMBOX_ERASE_BLOCK_SIZE} \
    --flash-size ${DREAMBOX_FLASH_SIZE} \
    --sector-size ${DREAMBOX_SECTOR_SIZE}"

IMAGE_FSTYPES ?= "jffs2.nfi"

require conf/machine/include/tune-mips32.inc
```

## meta-oe/conf/machine/include/dreambox-nand-256mb.inc
```bitbake
DREAMBOX_ERASE_BLOCK_SIZE = "0x20000"
DREAMBOX_FLASH_SIZE = "0x10000000"
DREAMBOX_SECTOR_SIZE = "2048"
MKUBIFS_ARGS = "-m 2048 -e 126KiB -c 1961 -x favor_lzo -F"
UBINIZE_ARGS = "-m 2048 -p 128KiB -s 512"
```

## meta-oe/conf/machine/include/dreambox-part-1024mb.inc
```bitbake
DREAMBOX_IMAGE_SIZE = "1024"
DREAMBOX_PART0_SIZE = "0x100000"
DREAMBOX_PART1_SIZE = "0x700000"
DREAMBOX_PART2_SIZE = "0x3F800000"
```

## meta-oe/conf/machine/ixussone.conf
```bitbake
#@TYPE: Machine
#@NAME: Ixuss One
#@DESCRIPTION: Machine configuration for the Ixuss One

MACHINE_NAME = "One"

IMAGEDIR ?= "medialink/ixussone"

require conf/machine/include/ixuss.inc

MACHINE_KERNEL_PR = "r2"
```

## meta-oe/conf/machine/multilib.inc
```bitbake
# Define multilib target
require conf/multilib.conf
MULTILIBS = "multilib:lib32"
DEFAULTTUNE_virtclass-multilib-lib32 = "armv7ahf-neon"
 
# Specify the 32-bit libraries to be added to the image
IMAGE_INSTALL_append = " lib32-glibc lib32-libgcc lib32-libstdc++ lib32-libcrypto0.9.8 lib32-libssl0.9.8 lib32-libcrypto lib32-libssl lib32-libcrypto-compat-0.9.7 lib32-libcrypto-compat-1.0.0 lib32-libxcrypt lib32-libxcrypt-compat"

OEM_ARCH = "armv7ahf-neon"
```

## meta-oe/recipes-multimedia/gst-fluendo-mpegdemux/gst-fluendo-mpegdemux/Config.in
```kconfig
config BR2_PACKAGE_GST_FLUENDO_MPEGDEMUX
	bool "gst-fluendo-mpegdemux"
	depends on BR2_PACKAGE_GSTREAMER 
	
	help
	  open source http://core.fluendo.com/gstreamer/src/gst-fluendo-mpegdemux/
```

## meta-openpli/conf/distro/include/openpli-unstable-versions.inc
```bitbake
# git
SRCREV_pn-enigma2-plugin-skins-magic ?= "${AUTOREV}"
SRCREV_pn-enigma2 ?= "${AUTOREV}"
SRCREV_pn-aio-grab ?= "${AUTOREV}"
SRCREV_pn-ambx ?= "${AUTOREV}"
SRCREV_pn-python-pyambx ?= "${AUTOREV}"
SRCREV_pn-enigma2-plugin-extensions-ambx ?= "${AUTOREV}"
SRCREV_pn-enigma2-pliplugins ?= "${AUTOREV}"
SRCREV_pn-enigma2-plugin-extensions-xmltvimport ?= "${AUTOREV}"
SRCREV_pn-enigma2-plugins ?= "${AUTOREV}"
SRCREV_pn-enigma2-skins ?= "${AUTOREV}"
SRCREV_pn-hotplug-e2-helper ?= "${AUTOREV}"
SRCREV_pn-libdreamdvd ?= "${AUTOREV}"
SRCREV_pn-usbtunerhelper ?= "${AUTOREV}"
SRCREV_pn-gst-plugin-dvbmediasink ?= "${AUTOREV}"
SRCREV_pn-libtuxtxt ?= "${AUTOREV}"
SRCREV_pn-tuxtxt-enigma2 ?= "${AUTOREV}"
SRCREV_pn-libdvbsi++ ?= "bf0c2bb7b326b93713629dbf74f63a0a54ffe59d"
SRCREV_pn-gst-plugin-subsink ?= "${AUTOREV}"
SRCREV_pn-librtmp ?= "${AUTOREV}"

# svn
SRCREV_pn-tuxbox-common ?= "${AUTOREV}"
SRCREV_pn-tuxterm ?= "${AUTOREV}"
SRCREV_pn-enigma2-plugin-extensions-tuxcom ?= "${AUTOREV}"
SRCREV_pn-enigma2-plugin-extensions-tuxterm ?= "${AUTOREV}"
```

## meta-openpli/conf/layer.conf
```bitbake
# We have a conf and classes directory, append to BBPATH
BBPATH .= ":${LAYERDIR}"

# We have a recipes directory, add to BBFILES
BBFILES += "${LAYERDIR}/recipes-*/*/*.bb ${LAYERDIR}/recipes-*/*/*.bbappend"

BBFILE_COLLECTIONS += "openpli-layer"
BBFILE_PATTERN_openpli-layer := "^${LAYERDIR}/"
BBFILE_PRIORITY_openpli-layer = "7"

OPENPLI_BASE := '${@os.path.normpath("${LAYERDIR}/../")}'
```

## meta-openpli/conf/machine/dm500hd.conf
```bitbake
#@TYPE: Machine
#@NAME: Dreambox DM500HD
#@DESCRIPTION: Machine configuration for the Dreambox DM500HD

DREAMBOX_FEATURES = "fan libpassthrough usbconsole xvid"
MACHINE_FEATURES += "modem"

require conf/machine/include/dreambox-brcmnand.inc
require conf/machine/include/dreambox-nand-64mb.inc
require conf/machine/include/dreambox-part-64mb.inc
require conf/machine/include/dreambox-jffs2.inc
require conf/machine/include/dreambox-mips32el.inc
require conf/machine/include/dreambox-legacy-wlan.inc

DVBMEDIASINK_CONFIG = "--with-dtsdownmix"
```

## meta-openpli/conf/machine/dm7020hd.conf
```bitbake
#@TYPE: Machine
#@NAME: Dreambox DM7020HD
#@DESCRIPTION: Machine configuration for the Dreambox DM7020HD

DREAMBOX_FEATURES = "ci dvd libpassthrough usbconsole xvid"
MACHINE_FEATURES += "modem wifi dvb-c blindscan-dvbc"

require conf/machine/include/dreambox-hw-ecc.inc
require conf/machine/include/dreambox-nand-1024mb.inc
require conf/machine/include/dreambox-part-256mb.inc
require conf/machine/include/dreambox-jffs2-sum.inc
require conf/machine/include/dreambox-mips32el.inc

DVBMEDIASINK_CONFIG = "--with-dtsdownmix"

CHIPSET = "bcm7405"
```

## meta-openpli/conf/machine/dm8000.conf
```bitbake
#@TYPE: Machine
#@NAME: Dreambox DM 8000 HD PVR
#@DESCRIPTION: Machine configuration for the Dreambox DM 8000 HD PVR

DREAMBOX_FEATURES = "ci dvd libpassthrough xvid"
MACHINE_FEATURES += "pci wifi nl80211 dvb-c blindscan-dvbc frontprocessor"

require conf/machine/include/dreambox-nand-256mb.inc
require conf/machine/include/dreambox-part-256mb.inc
require conf/machine/include/dreambox-jffs2-sum.inc
require conf/machine/include/dreambox-mips32el.inc

DVBMEDIASINK_CONFIG = "--with-dtsdownmix --with-limited-mpeg4v2"

CHIPSET = "bcm7400"
```

## meta-openpli/conf/machine/dm800se.conf
```bitbake
#@TYPE: Machine
#@NAME: Dreambox DM800se
#@DESCRIPTION: Machine configuration for the Dreambox DM800se

DREAMBOX_FEATURES = "fan libpassthrough usbconsole xvid"
MACHINE_FEATURES += "modem wifi dvb-c blindscan-dvbc colorlcd"

require conf/machine/include/dreambox-brcmnand.inc
require conf/machine/include/dreambox-nand-64mb.inc
require conf/machine/include/dreambox-part-64mb.inc
require conf/machine/include/dreambox-jffs2.inc
require conf/machine/include/dreambox-mips32el.inc

DVBMEDIASINK_CONFIG = "--with-dtsdownmix"

CHIPSET = "bcm7405"
```

## meta-openpli/conf/machine/et5x00.conf
```bitbake
#@TYPE: Machine
#@NAME: Xtrend et5x00
#@DESCRIPTION: Machine configuration for the Xtrend et5x00

require conf/machine/include/etxx00.inc
```

## meta-openpli/conf/machine/et6x00.conf
```bitbake
#@TYPE: Machine
#@NAME: Xtrend et6x00
#@DESCRIPTION: Machine configuration for the Xtrend et6x00

require conf/machine/include/etxx00.inc
```

## meta-openpli/conf/machine/include/autoload-usbserial.inc
```bitbake
module_autoload_usbserial = "usbserial"
module_autoload_ftdi-sio = "ftdi-sio"
module_autoload_pl2303 = "pl2303"
module_autoload_belkin-sa = "belkin-sa"
module_autoload_keyspan = "keyspan"
```

## meta-openpli/conf/machine/include/dreambox-legacy-wlan.inc
```bitbake
PREFERRED_VERSION_wpa-supplicant ?= "${@base_version_less_or_equal('DREAMBOX_KERNEL_VERSION', '2.6.18', '0.5.10', '0.7.3', d)}"
```

## meta-openpli/conf/machine/include/dreambox-mips32el-nf.inc
```bitbake
# dreambox-mips32el-nf.inc

DREAMBOX_KERNEL_VERSION = "2.6.18"
LINUXLIBCVERSION = "2.6.18"
OLDEST_KERNEL = "2.6.18"

TARGET_ARCH = "mipsel"
DEFAULTTUNE = "mips32el-nf"

require conf/machine/include/dreambox.inc
require conf/machine/include/tune-mips32.inc
```

## meta-openpli/conf/machine/include/dreambox-mips32el.inc
```bitbake
# dreambox-mips32el.inc

DREAMBOX_KERNEL_VERSION = "3.2"
LINUXLIBCVERSION = "3.2"
OLDEST_KERNEL = "3.2"

TARGET_ARCH = "mipsel"
DEFAULTTUNE = "mips32el"

require conf/machine/include/dreambox.inc
require conf/machine/include/tune-mips32.inc
```

## meta-openpli/conf/machine/include/dreambox-nand-256mb.inc
```bitbake
DREAMBOX_ERASE_BLOCK_SIZE = "0x20000"
DREAMBOX_FLASH_SIZE = "0x10000000"
DREAMBOX_SECTOR_SIZE = "2048"
```
