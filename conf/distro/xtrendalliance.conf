## conf/machine/dm7020hd.conf
```bitbake
#@TYPE: Machine
#@NAME: Dreambox DM7020HD
#@DESCRIPTION: Machine configuration for the Dreambox DM7020HD

MACHINE_FEATURES += "modem wifi dvb-c blindscan-dvbc hdmicec ci libpassthrough usbconsole"

require conf/machine/include/dreambox-hw-ecc.inc
require conf/machine/include/dreambox-nand-1024mb.inc
require conf/machine/include/dreambox-part-256mb.inc
require conf/machine/include/dreambox-jffs2-sum.inc
require conf/machine/include/dreambox-mips32el.inc

DVBMEDIASINK_CONFIG = "--with-dtsdownmix"

CHIPSET = "bcm7405"

MACHINE_EXTRA_RRECOMMENDS += "dreambox-enigma2-config"

MACHINE_KERNEL_PR = "r1"
```

## conf/machine/dm800.conf
```bitbake
#@TYPE: Machine
#@NAME: Dreambox DM 800 HD PVR
#@DESCRIPTION: Machine configuration for the Dreambox DM 800 HD PVR

MACHINE_NAME = "DM800HD"

MACHINE_ESSENTIAL_EXTRA_RDEPENDS += " dm800-shutdown"

MACHINE_FEATURES += "wifi dvb-c blindscan-dvbc dvbapi5 wifiusblegacy smallflash wifi61 colorlcd128 legacykernel"

require conf/machine/include/dreambox-brcmnand.inc
require conf/machine/include/dreambox-nand-64mb.inc
require conf/machine/include/dreambox-part-64mb.inc
require conf/machine/include/dreambox-jffs2.inc
require conf/machine/include/dreambox-mips32el-nf.inc

DVBMEDIASINK_CONFIG = "--without-mpeg4v2 --without-dts --without-lpcm"

CHIPSET = "bcm7401"

DVBPROVIDER = "v4l-dvb"	

MACHINE_KERNEL_PR = "r2"

PREFERRED_VERSION_rtl8192cu = "3.3.0"
```

## conf/machine/dm8000.conf
```bitbake
#@TYPE: Machine
#@NAME: Dreambox DM 8000 HD PVR
#@DESCRIPTION: Machine configuration for the Dreambox DM 8000 HD PVR

OPENPLI_FEATURES = "ci dvd libpassthrough"
MACHINE_FEATURES += "pci wifi dvb-c blindscan-dvbc frontprocessor"

require conf/machine/include/dreambox-nand-256mb.inc
require conf/machine/include/dreambox-part-256mb.inc
require conf/machine/include/dreambox-jffs2-sum.inc
require conf/machine/include/dreambox-mips32el.inc

DVBMEDIASINK_CONFIG = "--with-dtsdownmix --with-limited-mpeg4v2"

CHIPSET = "bcm7400"

EXTRA_IMAGEDEPENDS += " \
	enigma2-plugin-extensions-fancontrol2 \
	"

MACHINE_EXTRA_RDEPENDS = " \
	enigma2-plugin-extensions-fancontrol2 \
	"
```

## conf/machine/e3hd.conf
```bitbake
require conf/machine/include/odin-oem.inc

CHIPSET = "bcm7358"
MACHINE_FEATURES += " videoenhancement singlecore"

MACHINE_KERNEL_PR = "r1"
```

## conf/machine/ebox5100.conf
```bitbake
#@TYPE: Machine
#@NAME: EBox 5000
#@DESCRIPTION: Machine configuration for the EBox 5000

require conf/machine/include/ebox.inc

DVBPROVIDER = "v4l-dvb"

MACHINE_ESSENTIAL_EXTRA_RRECOMMENDS = "\
	kernel-module-cdfs \
	kernel-module-i2c-core \
	kernel-module-evdev \
	kernel-module-sr-mod \
	v4l-dvb-module-dvb-core \
	"
	
module_autoload_sr-mod = "sr-mod"
module_autoload_evdev = "evdev"
module_autoload_i2c-core = "i2c-core"
	
PREFERRED_VERSION_linux-ebox = "2.6.18"
PREFERRED_VERSION_linux-libc-headers = "2.6.18"

PREFERRED_VERSION_wpa-supplicant = "0.5.8"
PREFERRED_VERSION_rtl8192cu = "3.3.0"

CHIPSET = "bcm7403"
TARGET_FPU = "soft"

MACHINE_FEATURES += "wifiusblegacy textlcd wifi61 legacykernel"

DVBMEDIASINK_CONFIG += " --with-limited-mpeg4v2"

MACHINE_KERNEL_PR = "r3"

IMAGE_FSTYPES ?= "jffs2"

KERNEL_EXTRA_CMD = "--disable-compressor=lzo "

IMAGEDIR ?= "ebox/7403"

EXTRA_IMAGECMD_jffs2 = " --eraseblock=0x20000 -n -l "
IMAGE_CMD_jffs2_prepend = " \
	rm -rf ${IMAGE_ROOTFS}/boot/*; \
	rm -rf ${IMAGE_ROOTFS}/tmp/*; \
	"

IMAGE_CMD_jffs2_append = "; \
	mkdir -p ${DEPLOY_DIR_IMAGE}/${IMAGEDIR}; \
	gzip -f -c ${DEPLOY_DIR_IMAGE}/vmlinux-${MACHINE}.bin > ${DEPLOY_DIR_IMAGE}/${IMAGEDIR}/kernel_cfe_auto.bin; \
	mv ${DEPLOY_DIR_IMAGE}/${IMAGE_NAME}.rootfs.jffs2 ${DEPLOY_DIR_IMAGE}/${IMAGEDIR}/root_cfe_auto.bin; \
	echo ${DISTRO_NAME}-${DISTRO_VERSION}-${DATE} > ${DEPLOY_DIR_IMAGE}/${IMAGEDIR}/imageversion; \
	cd ${DEPLOY_DIR_IMAGE}; \
	zip -r ${IMAGE_NAME}_usb.zip ebox/*; \
	rm -f ${DEPLOY_DIR_IMAGE}/*.jffs2; \
	rm -rf ${DEPLOY_DIR_IMAGE}/ebox; \
	"
```

## conf/machine/ebox7358.conf
```bitbake
require conf/machine/include/ebox-oem.inc

CHIPSET = "bcm7358"
TARGET_FPU = "soft"
MACHINE_FEATURES += " videoenhancement"

MACHINE_KERNEL_PR = "r1"
```

## conf/machine/eboxlumi.conf
```bitbake
require conf/machine/include/ebox-oem.inc

CHIPSET = "bcm7403"
TARGET_FPU = "soft"

MACHINE_KERNEL_PR = "r2"
```

## conf/machine/enfinity.conf
```bitbake
#@TYPE: Machine
#@NAME: EVO ENfinity
#@DESCRIPTION: Machine configuration for the EVO ENfinity

MACHINE_NAME = "ENfinity"

CHIPSET = "bcm7358"

MACHINE_FEATURES += " videoenhancement singlecore"

require conf/machine/include/evo.inc

MACHINE_KERNEL_PR = "r0"

EXTRA_IMAGEDEPENDS += "\
    enigma2-plugin-systemplugins-vfdcontrol \
    gigablue-vfdctl \
    "

MACHINE_EXTRA_RDEPENDS = "\
    enigma2-plugin-systemplugins-vfdcontrol \
    gigablue-vfdctl \
    "
```

## conf/machine/et10000.conf
```bitbake
#@TYPE: Machine
#@NAME: Xtrend et10000
#@DESCRIPTION: Machine configuration for the Xtrend et10000

MACHINE_NAME = "ET10000"

PREFERRED_VERSION_linux-etxx00 = "3.13.8"
PREFERRED_VERSION_linux-libc-headers = "3.13"

CHIPSET = "bcm7425"
TARGET_FPU = "hard"

UBI_VOLNAME = "rootfs"
MKUBIFS_ARGS = "-m 2048 -e 126976 -c 8192"
UBINIZE_ARGS = "-m 2048 -p 128KiB"

require conf/machine/include/etxx00.inc

MACHINE_FEATURES += "dvb-c ci fanctrl extrakernelwifi bwlcd128 videoenhancement"

MACHINE_KERNEL_PR = "r9"
```

## conf/machine/et4x00.conf
```bitbake
#@TYPE: Machine
#@NAME: Xtrend et4x00
#@DESCRIPTION: Machine configuration for the Xtrend et4x00

MACHINE_NAME = "ET4X00"

PREFERRED_VERSION_linux-etxx00 = "3.8.7"
PREFERRED_VERSION_linux-libc-headers = "3.8"

CHIPSET = "bcm7358"

MACHINE_FEATURES += " videoenhancement"

UBI_VOLNAME = "rootfs"
MKUBIFS_ARGS = "-m 2048 -e 126976 -c 4096"
UBINIZE_ARGS = "-m 2048 -p 128KiB"

require conf/machine/include/etxx00.inc

MACHINE_KERNEL_PR = "r9"
```

## conf/machine/et5x00.conf
```bitbake
#@TYPE: Machine
#@NAME: Xtrend et5x00
#@DESCRIPTION: Machine configuration for the Xtrend et5x00

MACHINE_NAME = "ET5X00"

CHIPSET = "bcm7413"
TARGET_FPU = "hard"

require conf/machine/include/etxx00.inc

MACHINE_KERNEL_PR = "r8"
```

## conf/machine/et6x00.conf
```bitbake
#@TYPE: Machine
#@NAME: Xtrend et6x00
#@DESCRIPTION: Machine configuration for the Xtrend et6x00

MACHINE_NAME = "ET6X00"

PREFERRED_VERSION_linux-etxx00 = "3.8.7"
PREFERRED_VERSION_linux-libc-headers = "3.8"

CHIPSET = "bcm7413"

UBI_VOLNAME = "rootfs"
MKUBIFS_ARGS = "-m 2048 -e 126976 -c 4096"
UBINIZE_ARGS = "-m 2048 -p 128KiB"

MACHINE_FEATURES += "textlcd"

require conf/machine/include/etxx00.inc

MACHINE_KERNEL_PR = "r9"
```

## conf/machine/et8000.conf
```bitbake
#@TYPE: Machine
#@NAME: Xtrend et8000
#@DESCRIPTION: Machine configuration for the Xtrend et8000

MACHINE_NAME = "ET8000"

PREFERRED_VERSION_linux-etxx00 = "3.13.6"
PREFERRED_VERSION_linux-libc-headers = "3.13"

CHIPSET = "bcm7241"
TARGET_FPU = "hard"

UBI_VOLNAME = "rootfs"
MKUBIFS_ARGS = "-m 2048 -e 126976 -c 8192"
UBINIZE_ARGS = "-m 2048 -p 128KiB"

require conf/machine/include/etxx00.inc

MACHINE_FEATURES += "dvb-c ci fanctrl extrakernelwifi textlcd videoenhancement"

MACHINE_KERNEL_PR = "r9"
```

## conf/machine/et9x00.conf
```bitbake
#@TYPE: Machine
#@NAME: Xtrend et9x00
#@DESCRIPTION: Machine configuration for the Xtrend et9x00

MACHINE_NAME = "ET9X00"

CHIPSET = "bcm7413"
TARGET_FPU = "hard"

require conf/machine/include/etxx00.inc

MACHINE_FEATURES += "ci fanctrl"

MACHINE_KERNEL_PR = "r8"
```

## conf/machine/force1.conf
```bitbake
#@TYPE: Machine
#@NAME: DAGS
#@DESCRIPTION: Machine configuration for the iqon force1

MACHINE_NAME  = "Force 1"
MACHINE_BRAND  = "iqon"

IMAGEDIR ?= "update/force1/cfe"

require conf/machine/include/iqon2.inc

MACHINE_FEATURES += "textlcd fan ci"

CHIPSET = "bcm7356"

MACHINE_KERNEL_PR = "r3"
```
