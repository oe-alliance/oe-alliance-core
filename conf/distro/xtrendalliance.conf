## conf/distro/xtrendalliance.conf
```bitbake
#@TYPE: Distribution
#@NAME: Xtrend-Alliance
#@DESCRIPTION: Embedded Linux Distribution Configuration for STB's

OE_TERMINAL ?= "auto"
DISTRO_FEATURES_BACKFILL_CONSIDERED += "pulseaudio"

DISTRO_NAME ?= "xtrendalliance"
DISTRO_VERSION = "4.0"
DISTRO_TYPE ?= "release"
BUILD_VERSION = "007"

# default Enigma2 skin.
E2DEFAULTSKIN = "enigma2-plugin-skins-lava"

ENIGMA2_URI ?= "git://github.com/xtrend-boss/stbgui-new.git;protocol=git"
ENIGMA2_PLUGINS_URI ?= "git://github.com/oe-alliance/enigma2-plugins.git;protocol=git"
ENIGMA2_SKINS_URI ?= "git://github.com/OpenViX/enigma2-skins.git;protocol=git"
#THIRDPARTY_EXTRA_PLUGINS ?= ""

IPKG_VARIANT = "opkg"

FEED_NAME ?= "${DISTRO_NAME}-${DISTRO_VERSION}"
DISTRO_FEED_URI ?= "http://feed.xtrend-support-source.com/xtrend4/${MACHINE}"
DISTRO_FEED_PREFIX ?= "xtrend-alliance"

IMAGE_VERSION = "${DISTRO_VERSION}"
IMAGE_NAME = "${DISTRO_NAME}-${IMAGE_VERSION}-${MACHINEBUILD}-${BUILD_VERSION}-${DATE}"
IMAGE_ROOTFS = "${TMPDIR}/rootfs/${MACHINE}"
IMAGE_LINK_NAME = ""
CACHE ?= "${TMPDIR}/cache/${LIBC}/${MACHINE}"
DEPLOY_DIR ?= "${TMPDIR}/deploy/${LIBC}"
DEPLOY_DIR_IMAGE = "${DEPLOY_DIR}/images/${MACHINE}"

#USER_CLASSES += "image-prelink"
# SANITY_REQUIRED_UTILITIES = "patch diffstat texi2html makeinfo svn bzip2 tar gzip gawk chrpath wget cpio sshpass"
# INHERIT += "buildhistory recipe_sanity testlab"
# BUILDHISTORY_COMMIT = "1"

require conf/distro/include/unstable-versions.inc

VIRTUAL-RUNTIME_dev_manager = "busybox-mdev"
VIRTUAL-RUNTIME_login_manager = "busybox"
VIRTUAL-RUNTIME_init_manager = "sysvinit"
VIRTUAL-RUNTIME_initscripts = "initscripts"

PREFERRED_PROVIDER_enigma2-plugin-skins-technihd = "xtrendalliance-technihd"

PREFERRED_PROVIDERS += "virtual/${TARGET_PREFIX}gcc-initial:gcc-cross-initial"
PREFERRED_PROVIDERS += "virtual/${TARGET_PREFIX}gcc-intermediate:gcc-cross-intermediate"
PREFERRED_PROVIDERS += "virtual/${TARGET_PREFIX}gcc:gcc-cross"
PREFERRED_PROVIDERS += "virtual/${TARGET_PREFIX}g++:gcc-cross"

LICENSE_FLAGS_WHITELIST = "commercial_gst-plugins-ugly commercial_lame commercial_libmad commercial_mpeg2dec"
COMMERCIAL_AUDIO_PLUGINS ?= "gst-plugins-ugly-mad gst-plugins-ugly-mpegaudioparse"
COMMERCIAL_VIDEO_PLUGINS ?= "gst-plugins-ugly-mpeg2dec gst-plugins-ugly-mpegstream gst-plugins-bad-mpegvideoparse"

# OE optimization defaults to -O2 which makes for much larger binaries.
# Override here to use -Os instead, resulting in smaller images.
FULL_OPTIMIZATION = "-Os -pipe ${DEBUG_FLAGS}"
# build some core libs with better compiler optimization for better performance
O3_OPT = "-O3 -pipe ${DEBUG_FLAGS}"
FULL_OPTIMIZATION_pn-flac = "${O3_OPT}"
FULL_OPTIMIZATION_pn-jpeg = "${O3_OPT}"
FULL_OPTIMIZATION_pn-lame = "${O3_OPT}"
FULL_OPTIMIZATION_pn-liba52 = "${O3_OPT}"
FULL_OPTIMIZATION_pn-libdca = "${O3_OPT}"
FULL_OPTIMIZATION_pn-libgcrypt = "${O3_OPT}"
FULL_OPTIMIZATION_pn-libmad = "${O3_OPT}"
FULL_OPTIMIZATION_pn-libogg = "${O3_OPT}"
FULL_OPTIMIZATION_pn-libpng = "${O3_OPT}"
FULL_OPTIMIZATION_pn-libsamplerate = "${O3_OPT}"
FULL_OPTIMIZATION_pn-libvorbis = "${O3_OPT}"
FULL_OPTIMIZATION_pn-tremor = "${O3_OPT}"
FULL_OPTIMIZATION_pn-zlib = "${O3_OPT}"

PYTHON_BASEVERSION ?= "2.7"
PREFERRED_VERSION_python ?= "2.7.3"
PREFERRED_VERSION_python-native ?= "2.7.3"

# qtwebkit
PREFERRED_VERSION_qt4-native ?= "4.8.1"
PREFERRED_VERSION_qt4-tools-sdk ?= "4.8.1"
PREFERRED_VERSION_qt4-embedded ?= "4.8.1"
PREFERRED_VERSION_qt4-embedded-gles ?= "4.8.1"
PREFERRED_VERSION_qt4-x11-free = "4.8.1"
PREFERRED_VERSION_qt4-x11-free-gles ?= "4.8.1"
PREFERRED_PROVIDER_qt4-tools-native = "qt4-native"

# Force the older version of liberation-fonts until we fix the fontforge issue
PREFERRED_VERSION_liberation-fonts ?= "1.04"

PREFERRED_VERSION_udev ?= "182"

PREFERRED_VERSION_netatalk ?= "2.2.3"

DISTRO_FEATURES ?= "pli x11 alsa argp bluetooth ext2 irda largefile pcmcia wifi wifi-extra xattr nfs appletalk smbfs zeroconf pci ${DISTRO_FEATURES_LIBC}"

QA_LOG = "1"
QA_LOGFILE = "${TMPDIR}/qa.log"

OEINCLUDELOGS ?= "yes"
KERNEL_CONSOLE ?= "ttyS0,115200n8"

BB_GENERATE_MIRROR_TARBALLS ??= "0"

NO32LIBS ??= "1"

# Missing checksums should raise an error
BB_STRICT_CHECKSUM = "0"

TCLIBC = "eglibc"
TCLIBCAPPEND = ""

# Drop unused PACKAGE_EXTRA_ARCHS
PACKAGE_EXTRA_ARCHS = "${TUNE_PKGARCH}"

# add support for extra feeds
PACKAGE_ARCHS += " 3rdparty ${MACHINE}_3rdparty private"

LICENSE_FLAGS_WHITELIST = "commercial_gst-plugins-ugly commercial_lame commercial_libmad commercial_mpeg2dec commercial_ffmpeg commercial_libav commercial_x264"
COMMERCIAL_AUDIO_PLUGINS ?= "gst-plugins-ugly-mad gst-plugins-ugly-mpegaudioparse"
COMMERCIAL_VIDEO_PLUGINS ?= "gst-plugins-ugly-mpeg2dec gst-plugins-ugly-mpegstream gst-plugins-bad-mpegvideoparse"
```

## conf/layer.conf
```bitbake
# We have a conf and classes directory, append to BBPATH
BBPATH .= ":${LAYERDIR}"

# We have a recipes directory, add to BBFILES
BBFILES += "${LAYERDIR}/recipes-*/*/*.bb ${LAYERDIR}/recipes-*/*/*.bbappend"
BBFILES += "${LAYERDIR}/recipes-*/*/*/*.bb ${LAYERDIR}/recipes-*/*/*/*.bbappend"

BBFILE_COLLECTIONS += "oe-alliance-layer"
BBFILE_PATTERN_oe-alliance-layer := "^${LAYERDIR}/"
BBFILE_PRIORITY_oe-alliance-layer = "8"

OE-ALLIANCE_BASE := "${@os.path.normpath("${LAYERDIR}/../")}"

MIRRORS += "\
ftp://.*/.*    http://source.mynonpublic.com/ \n \
http://.*/.*   http://source.mynonpublic.com/ \n \
https://.*/.*  http://source.mynonpublic.com/ \n \
ftp://.*/.*    http://enigma2.world-of-satellite.com/sources-mirror/ \n \
http://.*/.*   http://enigma2.world-of-satellite.com/sources-mirror/ \n \
https://.*/.*  http://enigma2.world-of-satellite.com/sources-mirror/ \n \
"

PREMIRRORS ?= "\
bzr://.*/.*   http://source.mynonpublic.com/ \n \
cvs://.*/.*   http://source.mynonpublic.com/ \n \
git://.*/.*   http://source.mynonpublic.com/ \n \
hg://.*/.*    http://source.mynonpublic.com/ \n \
osc://.*/.*   http://source.mynonpublic.com/ \n \
p4://.*/.*    http://source.mynonpublic.com/ \n \
svk://.*/.*   http://source.mynonpublic.com/ \n \
svn://.*/.*   http://source.mynonpublic.com/ \n \
"

OE_TERMINAL ?= "auto"
FETCHCOMMAND_wget = "/usr/bin/env wget -T 10 -t 5 -nv --passive-ftp --no-check-certificate -P ${DL_DIR} '${URI}'"

PREFERRED_PROVIDER_font-valis-enigma = "font-valis-enigma"
PREFERRED_PROVIDER_enigma2-plugin-systemplugins-blindscan = "enigma2-oe-alliance-plugins"
PREFERRED_PROVIDER_enigma2-plugin-systemplugins-remotecontrolcode = "enigma2-oe-alliance-plugins"
PREFERRED_PROVIDER_enigma2-plugin-systemplugins-fpgaupgrade = "enigma2-oe-alliance-plugins"
PREFERRED_PROVIDER_enigma2-plugin-systemplugins-firmwareupgrade = "enigma2-oe-alliance-plugins"
PREFERRED_PROVIDER_enigma2-plugin-systemplugins-vuplusevent = "enigma2-oe-alliance-plugins"
PREFERRED_PROVIDER_enigma2-plugin-extensions-hbbtv = "enigma2-oe-alliance-plugins"

PREFERRED_PROVIDER_jpeg = "jpeg"
PREFERRED_PROVIDER_jpeg-native = "jpeg-native"
PREFERRED_PROVIDER_libfribidi = "libfribidi"
PREFERRED_PROVIDER_openssl = "openssl"
PREFERRED_PROVIDER_libcrypto = "openssl"
PREFERRED_PROVIDER_libssl = "openssl"
PREFERRED_PROVIDER_ntp = "ntp"
PREFERRED_PROVIDER_gmp = "gmp"
PREFERRED_PROVIDER_mpfr = "mpfr"
PREFERRED_PROVIDER_libusb-compat = "libusb-compat"
```

## conf/machine/azboxhd.conf
```bitbake
#@TYPE: Machine
#@NAME: AZBox HD
#@DESCRIPTION: Machine configuration for the AZBox HD

MACHINE_NAME = "HD"

MACHINE_KERNEL_PR = "r2"

require conf/machine/include/azbox-331.inc

MACHINE_ESSENTIAL_EXTRA_RRECOMMENDS = " \
    azbox-hd-buildimage \
    kernel-module-rt61pci \
    kernel-module-rt2x00pci \
    kernel-module-rt2x00lib \
    kernel-module-mac80211 \
    kernel-module-eeprom_93cx6 \
    rt61-firmware \
    domextender \
    "
	
EXTRA_IMAGEDEPENDS += " \
	kmod-native \
    "	

MACHINE_FEATURES += "ci smallflash"

###  Wifi ###
module_autoload_rt61pci = "rt61pci"
module_autoload_rt2x00pci = "rt2x00pci"
module_autoload_rt2x00lib = "rt2x00lib"
module_autoload_mac80211 = "mac80211"
module_autoload_eeprom_93cx6 = "eeprom_93cx6"

IMAGE_FSTYPES = "azboxcramfs"

IMAGE_CMD_azboxcramfs_append = "\
    cp ${IMAGE_ROOTFS}/boot/zbimage-linux-xload ${DEPLOY_DIR_IMAGE}; \
    rm -- ${IMAGE_ROOTFS}/boot/zbimage-linux-xload; \
    rm -rf ${IMAGE_ROOTFS}/boot/*; \
    mkfs.cramfs ${IMAGE_ROOTFS} ${DEPLOY_DIR_IMAGE}/azboxhd.cramfs; \
    pack_e2 -t OE-A \
    -d Alliance \
    -a Enigma2 \
    -v ${AZVERSION}.${AZREVISION} \
    -i ${DEPLOY_DIR_IMAGE}/azboxhd.cramfs \
    -k ${DEPLOY_DIR_IMAGE}/zbimage-linux-xload -K ULK-3.3.1 \
    -p ${DEPLOY_DIR_IMAGE}/patch.e2; \
    rm -f ${DEPLOY_DIR_IMAGE}/*.bin; \
    rm -f ${DEPLOY_DIR_IMAGE}/*.tgz; \
    rm -f ${DEPLOY_DIR_IMAGE}/*.cramfs; \
    cd ${DEPLOY_DIR_IMAGE}; \
    zip ${IMAGE_NAME}_azup.zip patch.e2; \
    rm -f ${DEPLOY_DIR_IMAGE}/*.e2; \
"

TARGET_ARCH = "mipsel"
DEFAULTTUNE = "mips32el"
```

## conf/machine/azboxme.conf
```bitbake
#@TYPE: Machine
#@NAME: Azbox Me
#@DESCRIPTION: Machine configuration for the Azbox Me

MACHINE_NAME = "Me"

#take care when you do changes on MACHINE_ESSENTIAL_EXTRA_RDEPENDS/RRECOMMENDS you have to increment the recipes/tasks/task-boot.bb PR
MACHINE_ESSENTIAL_EXTRA_RDEPENDS += " \
	azbox-dvb-modules \
	"

DVBPROVIDER = "kernel"

MACHINE_EXTRA_RRECOMMENDS += " \
	gst-plugin-dvbmediasink \
	azbox-mrua \
	azbox-compat \
	"

DVBMEDIASINK_CONFIG = "--with-wma --with-wmv --with-pcm"

KERNEL_EXTRA_CMD = "--disable-compressor=lzo "

IMAGE_FSTYPES ?= "jffs2"

EXTRA_IMAGECMD_jffs2 = " -p 0x800 -e 0x20000 -n -l"
IMAGE_CMD_jffs2_append = ";\
	mkdir -p ${DEPLOY_DIR_IMAGE}/USB; \
	mkdir -p ${DEPLOY_DIR_IMAGE}/WEBIF; \
	cp ${IMAGE_ROOTFS}/boot/zbimage-linux-xload ${DEPLOY_DIR_IMAGE}; \
	rm -- ${IMAGE_ROOTFS}/boot/zbimage-linux-xload; \
	rm -rf ${IMAGE_ROOTFS}/boot/*; \
	mkfs.jffs2 \
		--root=${IMAGE_ROOTFS} \
		--faketime \
		${KERNEL_EXTRA_CMD} \
		--compression-mode=size \
		--output=${DEPLOY_DIR_IMAGE}/image0.jffs2 \
		${EXTRA_IMAGECMD}; \
	rm -f ${DEPLOY_DIR_IMAGE}/*.bin; \
	rm -f ${DEPLOY_DIR_IMAGE}/*.tgz; \
	cp ${DEPLOY_DIR_IMAGE}/zbimage-linux-xload ${DEPLOY_DIR_IMAGE}/WEBIF/; \
	cp ${DEPLOY_DIR_IMAGE}/image0.jffs2 ${DEPLOY_DIR_IMAGE}/WEBIF/flash.jffs2; \
	tar -C ${DEPLOY_DIR_IMAGE}/WEBIF/ -cf ${DEPLOY_DIR_IMAGE}/WEBIF/webif-update.tar . ; \
	cd ${DEPLOY_DIR_IMAGE}/WEBIF && zip ${IMAGE_NAME}_webif.zip webif-update.tar; \
	rm -f ${DEPLOY_DIR_IMAGE}/WEBIF/*.jffs2; \
	rm -f ${DEPLOY_DIR_IMAGE}/WEBIF/zbimage-linux-xload; \
	wget -nc -P ${DEPLOY_DIR_IMAGE}/USB/ http://azbox-enigma2-project.googlecode.com/files/update.ext; \
	cp ${DEPLOY_DIR_IMAGE}/zbimage-linux-xload ${DEPLOY_DIR_IMAGE}/USB/; \
	cp ${DEPLOY_DIR_IMAGE}/image0.jffs2 ${DEPLOY_DIR_IMAGE}/USB/; \
	rm -f ${DEPLOY_DIR_IMAGE}/*.jffs2; \
	rm -f ${DEPLOY_DIR_IMAGE}/zbimage-linux-xload \
	cd ${DEPLOY_DIR_IMAGE}/USB && zip ${IMAGE_NAME}_usb.zip *; \
	"

TARGET_FPU = "hard"
TARGET_ARCH = "mipsel"
DEFAULTTUNE = "mips32el"

MACHINE_FEATURES += "kernel26 alsa usbhost wifi nl80211 3dtv switchoff lpcm textlcd 32bpp hdtv dvbapi5 dvb-c blindscan-dvbs"

MACHINE_KERNEL_PR = "r2"

PREFERRED_VERSION_linux-libc-headers = "3.3"

PREFERRED_VERSION_mtd-utils = "1.4.9"
PREFERRED_VERSION_mtd-utils-native = "1.4.9"

GLIBC_EXTRA_OECONF = "--with-tls"

PREFERRED_PROVIDER_virtual/kernel = "linux-azbox"
PREFERRED_PROVIDER_virtual/showiframe = "azbox-dvb-tools"
PREFERRED_PROVIDER_virtual/blindscan-dvbs = "azbox-blindscan-dvbs-utils"

require conf/machine/include/tune-mips32.inc

SYSVINIT_ENABLED_GETTYS = ""

EXTRA_IMAGEDEPENDS += " \
	enigma2-plugin-systemplugins-rtisys \
	enigma2-plugin-systemplugins-videosettingssetup \
	enigma2-plugin-extensions-azplay \
	enigma2-plugin-extensions-aziptv \
	"

MACHINE_EXTRA_RDEPENDS = " \
	enigma2-plugin-systemplugins-rtisys \
	enigma2-plugin-systemplugins-videosettingssetup \
	enigma2-plugin-extensions-azplay \
	enigma2-plugin-extensions-aziptv \
	"
```

## conf/machine/azboxminime.conf
```bitbake
#@TYPE: Machine
#@NAME: AZBox MiniMe
#@DESCRIPTION: Machine configuration for the AZBox MiniMe

MACHINE_NAME = "MiniMe"

MACHINE_KERNEL_PR = "r2"

require conf/machine/include/azbox.inc

EXTRA_IMAGEDEPENDS += " \
    azbox-minime-packer \
	kmod-native \
    "
    
MACHINE_FEATURES += "smallflash"    

KERNEL_EXTRA_CMD = "--disable-compressor=lzo "

IMAGE_FSTYPES ?= "jffs2"

EXTRA_IMAGECMD_jffs2 = " -p 0x800 -e 0x20000 -n -l"

IMAGE_CMD_jffs2_prepend = " \
    mkdir -p ${DEPLOY_DIR_IMAGE}/USB; \
    mkdir -p ${DEPLOY_DIR_IMAGE}/WEBIF; \
    cp ${IMAGE_ROOTFS}/boot/zbimage-linux-xload ${DEPLOY_DIR_IMAGE}; \
    rm -- ${IMAGE_ROOTFS}/boot/zbimage-linux-xload; \
    rm -rf ${IMAGE_ROOTFS}/boot/*; \
    mkfs.jffs2 \
        --root=${IMAGE_ROOTFS} \
        --faketime \
        ${KERNEL_EXTRA_CMD} \
        --compression-mode=size \
        --output=${DEPLOY_DIR_IMAGE}/image0.jffs2 \
        ${EXTRA_IMAGECMD}; \
    "

IMAGE_CMD_jffs2_append = " \
    rm -f ${DEPLOY_DIR_IMAGE}/*.bin; \
    rm -f ${DEPLOY_DIR_IMAGE}/*.tgz; \
    rm -f ${DEPLOY_DIR_IMAGE}/WEBIF/*.zip; \
    cp ${DEPLOY_DIR_IMAGE}/zbimage-linux-xload ${DEPLOY_DIR_IMAGE}/WEBIF/; \
    cp ${DEPLOY_DIR_IMAGE}/image0.jffs2 ${DEPLOY_DIR_IMAGE}/WEBIF/flash.jffs2; \
    pack_minime_image ${DEPLOY_DIR_IMAGE}/WEBIF/zbimage-linux-xload ${DEPLOY_DIR_IMAGE}/WEBIF/flash.jffs2 ${DEPLOY_DIR_IMAGE}/WEBIF/webif-update.img; \
    cd ${DEPLOY_DIR_IMAGE}/WEBIF && zip ${IMAGE_NAME}_webif.zip webif-update.img; \
    rm -f ${DEPLOY_DIR_IMAGE}/WEBIF/*.img; \
    rm -f ${DEPLOY_DIR_IMAGE}/WEBIF/*.jffs2; \
    rm -f ${DEPLOY_DIR_IMAGE}/WEBIF/zbimage-linux-xload; \
    wget -nc -P ${DEPLOY_DIR_IMAGE}/USB/ http://azbox-enigma2-project.googlecode.com/files/update.ext; \
    cp ${DEPLOY_DIR_IMAGE}/zbimage-linux-xload ${DEPLOY_DIR_IMAGE}/USB/; \
    cp ${DEPLOY_DIR_IMAGE}/image0.jffs2 ${DEPLOY_DIR_IMAGE}/USB/; \
    rm -f ${DEPLOY_DIR_IMAGE}/*.jffs2; \
    rm -f ${DEPLOY_DIR_IMAGE}/zbimage-linux-xload \
    rm -f ${DEPLOY_DIR_IMAGE}/USB/*.zip; \
    cd ${DEPLOY_DIR_IMAGE}; \
    zip -j ${IMAGE_NAME}_usb.zip USB/*; \
    rm -f ${DEPLOY_DIR_IMAGE}/USB/*.jffs2; \
    rm -f ${DEPLOY_DIR_IMAGE}/USB/zbimage-linux-xload; \
    mv ${DEPLOY_DIR_IMAGE}/${IMAGE_NAME}_usb.zip ${DEPLOY_DIR_IMAGE}/USB/; \
    "

TARGET_ARCH = "mipsel"
DEFAULTTUNE = "mips32el"
```

## conf/machine/blackbox7405.conf
```bitbake
require conf/machine/include/blackbox-oem.inc

MACHINE_FEATURES += "kernel32 textlcd ci dvb-c"

CHIPSET = "bcm7413"

TARGET_FPU = "hard"

MACHINE_KERNEL_PR = "r3"

MACHINE_ESSENTIAL_EXTRA_RDEPENDS = "\
    blackbox-dvb-modules-blackbox7405 \
    "
```

## conf/machine/cn7405.conf
```bitbake
require conf/machine/include/cn-oem.inc

MACHINE_FEATURES += "kernel32 textlcd ci dvb-c"

CHIPSET = "bcm7413"

TARGET_FPU = "hard"

MACHINE_KERNEL_PR = "r3"

MACHINE_ESSENTIAL_EXTRA_RDEPENDS = "\
    cn-dvb-modules-cn7405 \
    "
```

## conf/machine/cube.conf
```bitbake
#@TYPE: Machine
#@NAME: E2BMC Cube
#@DESCRIPTION: Machine configuration for the E2BMC Cube

MACHINE_NAME = "Cube"

MACHINE_KERNEL_PR = "r0"

include conf/machine/include/pnx8492.inc
```

## conf/machine/dags2.conf
```bitbake
MACHINE_ESSENTIAL_EXTRA_RDEPENDS = " \
    dags-dvb-modules-7335-ci \
	"

include conf/machine/include/dags-oem.inc

PREFERRED_VERSION_linux-dags = "3.9.7"
PREFERRED_VERSION_linux-libc-headers = "3.9.7"

MACHINE_KERNEL_PR = "r1"

CHIPSET = "bcm7335"
```

## conf/machine/dm500hd.conf
```bitbake
#@TYPE: Machine
#@NAME: Dreambox DM500HD
#@DESCRIPTION: Machine configuration for the Dreambox DM500HD

OPENPLI_FEATURES = "fan libpassthrough usbconsole"
MACHINE_FEATURES += "modem wifi dvb-c blindscan-dvbc hdmicec"

require conf/machine/include/dreambox-brcmnand.inc
require conf/machine/include/dreambox-nand-64mb.inc
require conf/machine/include/dreambox-part-64mb.inc
require conf/machine/include/dreambox-jffs2.inc
require conf/machine/include/dreambox-mips32el.inc

DVBMEDIASINK_CONFIG = "--with-dtsdownmix"

CHIPSET = "bcm7405"
```
