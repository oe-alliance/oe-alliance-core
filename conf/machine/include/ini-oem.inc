## conf/machine/include/vuplus.inc
```bitbake
MACHINE_BRAND = "Vu+"

MACHINE_ESSENTIAL_EXTRA_RDEPENDS = " \
	vuplus-dvb-modules-${MACHINE} \
	"

DVBPROVIDER = "kernel"

MACHINE_ESSENTIAL_EXTRA_RRECOMMENDS = "\
	kernel-module-cdfs \
	"

MACHINE_EXTRA_RRECOMMENDS = " \
	vuplus-shutdown \
	vuplus-gst-plugin-dvbmediasink \
	"

include conf/machine/include/autoload-filesystems.inc

TARGET_ARCH = "mipsel"
DEFAULTTUNE = "mips32el"

GLIBC_EXTRA_OECONF = "--with-tls"

PREFERRED_PROVIDER_virtual/kernel = "linux-vuplus"

PREFERRED_PROVIDER_virtual/blindscan-dvbc = "vuplus-blindscan-utils"
PREFERRED_PROVIDER_virtual/blindscan-dvbs = "vuplus-blindscan-utils"

KERNEL_IMAGETYPE = "vmlinux"
KERNEL_OUTPUT = "${KERNEL_IMAGETYPE}"
KERNEL_CONSOLE = "ttyS0,115200n8"

IMAGE_FSTYPES ?= "ubi"

UBI_VOLNAME = "rootfs"
MKUBIFS_ARGS = "-m 2048 -e 126976 -c 4096 -F"
UBINIZE_ARGS = "-m 2048 -p 128KiB"

IMAGEDIR ?= "vuplus/${UPDATE_DIR}"

IMAGE_CMD_ubi_prepend = " \
	rm -rf ${IMAGE_ROOTFS}/boot/*; \
	rm -rf ${IMAGE_ROOTFS}/tmp/*; \
	"

TARGET_FPU = "hard"

MACHINE_FEATURES += "3dtv alsa hdmicec switchoff wifi bootsplash"

BOOTLOGO_FILENAME = "splash_cfe_auto.bin"

require conf/machine/include/tune-mips32.inc
```

## conf/machine/include/vuplus2.inc
```bitbake
MACHINE_ESSENTIAL_EXTRA_DEPENDS = " \
	vuplus-opera-browser-util \
	"

MACHINE_ESSENTIAL_EXTRA_RDEPENDS = " \
	vuplus-dvb-modules-${MACHINE} \
	"

DVBPROVIDER = "kernel"

MACHINE_ESSENTIAL_EXTRA_RRECOMMENDS = "\
	kernel-module-cdfs \
	"

MACHINE_EXTRA_RRECOMMENDS = " \
	vuplus-shutdown \
	gst-plugin-dvbmediasink \
	"

include conf/machine/include/autoload-wifi.inc
include conf/machine/include/autoload-dvb-usb.inc
include conf/machine/include/autoload-usbserial.inc

TARGET_ARCH = "mipsel"
DEFAULTTUNE = "mips32el"

GLIBC_EXTRA_OECONF = "--disable-profile --with-tls --without-fp --with-__thread"

PREFERRED_PROVIDER_virtual/kernel = "linux-vuplus"

PREFERRED_PROVIDER_virtual/blindscan-dvbc = "vuplus-blindscan-utils-${MACHINE}"
PREFERRED_PROVIDER_virtual/blindscan-dvbs = "vuplus-blindscan-utils-${MACHINE}"

KERNEL_IMAGETYPE = "vmlinux"
KERNEL_OUTPUT = "${KERNEL_IMAGETYPE}"
KERNEL_CONSOLE = "ttyS0,115200n8"

IMAGE_FSTYPES ?= "ubi"

UBI_VOLNAME = "rootfs"
MKUBIFS_ARGS = "-m 2048 -e 126976 -c 4096 -F"
UBINIZE_ARGS = "-m 2048 -p 128KiB"

IMAGEDIR ?= "vuplus/${UPDATE_DIR}"

IMAGE_CMD_ubi_prepend = " \
	rm -rf ${IMAGE_ROOTFS}/boot/*; \
	rm -rf ${IMAGE_ROOTFS}/tmp/*; \
	"

TARGET_FPU = "hard"

MACHINE_FEATURES += "3dtv alsa hdmicec switchoff wifi"

require conf/machine/include/tune-mips32.inc
```

## conf/machine/inihde.conf
```bitbake
#@TYPE: Machine
#@NAME: INI HDe
#@DESCRIPTION: Machine configuration for the INI HDe

MACHINE_BRAND = "INI"

MACHINE_NAME = "HDe"

require conf/machine/include/ini.inc

MACHINE_ESSENTIAL_EXTRA_RDEPENDS = "\
	ini-dvb-modules-inihde \
	"
	
PREFERRED_VERSION_linux-${MACHINE} = "3.6.0"
PREFERRED_VERSION_linux-libc-headers = "3.6"

MACHINE_FEATURES += "textlcd ci dvb-c blindscan-dvbc blindscan-dvbs"

CHIPSET = "bcm7358"

TARGET_FPU = "soft"

MACHINE_KERNEL_PR = "r4"

IMAGEDIR ?= "hde"

UBI_VOLNAME = "rootfs"
MKUBIFS_ARGS = "-m 2048 -e 126976 -c 4096"
UBINIZE_ARGS = "-m 2048 -p 128KiB"

IMAGE_CMD_ubi_append = " \
	mkdir -p ${DEPLOY_DIR_IMAGE}/${IMAGEDIR}; \
	cp ${DEPLOY_DIR_IMAGE}/splash.bin ${DEPLOY_DIR_IMAGE}/${IMAGEDIR}/splash.bin; \
	mv ${DEPLOY_DIR_IMAGE}/${IMAGE_NAME}.rootfs.ubi ${DEPLOY_DIR_IMAGE}/${IMAGEDIR}/rootfs.bin; \
	gzip -f -9c ${DEPLOY_DIR_IMAGE}/vmlinux-${MACHINE}.bin > ${DEPLOY_DIR_IMAGE}/${IMAGEDIR}/kernel.bin; \
	echo ${DISTRO_NAME}-${IMAGE_VERSION}-${MACHINE}-${DATE}_usb > ${DEPLOY_DIR_IMAGE}/${IMAGEDIR}/imageversion; \
	echo "rename this file to 'force' to force an update without confirmation" > ${DEPLOY_DIR_IMAGE}/${IMAGEDIR}/noforce; \
	cd ${DEPLOY_DIR_IMAGE}; \
	zip ${IMAGE_NAME}_usb.zip ${IMAGEDIR}/*; \
	mv ${IMAGEDIR} hde; \
	echo ${DISTRO_NAME}-${IMAGE_VERSION}-sezam-hd1000-${DATE}_usb > hde/imageversion; \
	zip ${DISTRO_NAME}-${IMAGE_VERSION}-sezam-hd1000-${DATE}_usb.zip hde/*; \
	mv hde xpeedlx; \
	echo ${DISTRO_NAME}-${IMAGE_VERSION}-xpeedlx-${DATE}_usb > xpeedlx/imageversion; \
	zip ${DISTRO_NAME}-${IMAGE_VERSION}-xpeedlx-${DATE}_usb.zip xpeedlx/*; \
	mkdir -p miraclebox/mini; \
	cp -a xpeedlx/* miraclebox/mini/; \
	echo ${DISTRO_NAME}-${IMAGE_VERSION}-mbmini-${DATE}_usb > miraclebox/mini/imageversion; \
	zip ${DISTRO_NAME}-${IMAGE_VERSION}-mbmini-${DATE}_usb.zip miraclebox/mini/*; \
	rm -f ${DEPLOY_DIR_IMAGE}/*.ubifs; \
	rm -rf ${IMAGEDIR}; \
	rm -rf hde; \
	rm -rf xpeedlx; \
	rm -rf miraclebox; \
	"

EXTRA_IMAGEDEPENDS += "\
	enigma2-plugin-systemplugins-vfdcontrol \
	gigablue-vfdctl \	
	"

MACHINE_EXTRA_RDEPENDS = "\
	enigma2-plugin-systemplugins-vfdcontrol \
	gigablue-vfdctl \	
	"
```

## conf/machine/inihdp.conf
```bitbake
include conf/machine/include/ini-oem.inc

EXTRA_IMAGEDEPENDS = "\
	vuplus-transtreamproxy \
	"
	
PREFERRED_VERSION_linux-ini = "3.3.8"
PREFERRED_VERSION_linux-libc-headers = "3.3"

MACHINE_FEATURES += "bwlcd255 fanctrl fan transcoding iniwol"

CHIPSET = "bcm7425"
TARGET_FPU = "hard"

MACHINE_KERNEL_PR = "r0"

MTD_ROOTFS = "mtd0"
MTD_KERNEL = "mtd2"

UBI_VOLNAME = "rootfs"
MKUBIFS_ARGS = "-m 4096 -e 1040384 -c 1984"
UBINIZE_ARGS = "-m 4096 -p 1024KiB"

IMAGE_CMD_ubi_append = " \
	mkdir -p ${DEPLOY_DIR_IMAGE}/${IMAGEDIR}; \
	cp ${DEPLOY_DIR_IMAGE}/splash.bin ${DEPLOY_DIR_IMAGE}/${IMAGEDIR}/splash.bin; \
	mv ${DEPLOY_DIR_IMAGE}/${IMAGE_NAME}.rootfs.ubi ${DEPLOY_DIR_IMAGE}/${IMAGEDIR}/${ROOTFS_FILE}; \
	gzip -f -9c ${DEPLOY_DIR_IMAGE}/vmlinux-${MACHINE}.bin > ${DEPLOY_DIR_IMAGE}/${IMAGEDIR}/${KERNEL_FILE}; \
	echo ${DISTRO_NAME}-${IMAGE_VERSION}-${MACHINE}-${DATE}_usb > ${DEPLOY_DIR_IMAGE}/${IMAGEDIR}/imageversion; \
	echo "rename this file to 'force' to force an update without confirmation" > ${DEPLOY_DIR_IMAGE}/${IMAGEDIR}/noforce; \
	cd ${DEPLOY_DIR_IMAGE}; \
	zip ${IMAGE_NAME}_usb.zip ${IMAGEDIR}/*; \
	rm -f ${DEPLOY_DIR_IMAGE}/*.ubifs; \
	rm -rf ${IMAGEDIR}; \
	"
	
EXTRA_IMAGEDEPENDS = "\
	enigma2-plugin-systemplugins-micomupgrade \
	"

MACHINE_EXTRA_RDEPENDS = "\
	enigma2-plugin-systemplugins-micomupgrade \
	ini-coldboot \
	ini-ethwol \
	"
```

## conf/machine/inihdx.conf
```bitbake
include conf/machine/include/ini-oem.inc

MACHINE_OEM = "inihdx"

MACHINE_ESSENTIAL_EXTRA_RDEPENDS = "\
	ini-dvb-modules-inihdx \
	"
	
PREFERRED_VERSION_linux-${MACHINE} = "3.6.0"
PREFERRED_VERSION_linux-libc-headers = "3.6"

MACHINE_FEATURES += "textlcd ci"

CHIPSET = "bcm7413"

MACHINE_KERNEL_PR = "r1"

UBI_VOLNAME = "rootfs"
MKUBIFS_ARGS = "-m 2048 -e 126976 -c 4096"
UBINIZE_ARGS = "-m 2048 -p 128KiB"

IMAGE_CMD_ubi_append = " \
    mkdir -p ${DEPLOY_DIR_IMAGE}/${IMAGEDIR}; \
    cp ${DEPLOY_DIR_IMAGE}/splash.bmp ${DEPLOY_DIR_IMAGE}/${IMAGEDIR}/splash.bmp; \
    mv ${DEPLOY_DIR_IMAGE}/${IMAGE_NAME}.rootfs.ubi ${DEPLOY_DIR_IMAGE}/${IMAGEDIR}/oe_rootfs.bin; \
    gzip -f -9c ${DEPLOY_DIR_IMAGE}/vmlinux-${MACHINE}.bin > ${DEPLOY_DIR_IMAGE}/${IMAGEDIR}/oe_kernel.bin; \
    echo ${DISTRO_NAME}-${DISTRO_VERSION}.${BUILD_VERSION} > ${DEPLOY_DIR_IMAGE}/${IMAGEDIR}/imageversion; \
    cd ${DEPLOY_DIR_IMAGE}; \
    zip ${IMAGE_NAME}_usb.zip ${IMAGEDIR}/*; \
    rm -f ${DEPLOY_DIR_IMAGE}/*.ubifs; \
    rm -Rf update; \
    "

EXTRA_IMAGEDEPENDS = "\
	enigma2-plugin-systemplugins-micomupgrade \
	"

MACHINE_EXTRA_RDEPENDS = "\
	enigma2-plugin-systemplugins-micomupgrade \
	"
```

## conf/machine/iqonios100hd.conf
```bitbake
#@TYPE: Machine
#@NAME: DAGS
#@DESCRIPTION: Machine configuration for the iqon IOS 100HD

MACHINE_NAME = "IOS 100HD"
MACHINE_BRAND = "iQON"

MACHINE_ESSENTIAL_EXTRA_RDEPENDS = " \
    iqon-dvb-modules \
    "

IMAGEDIR ?= "update/ios100/cfe"

require conf/machine/include/iqon.inc

MACHINE_FEATURES += "textlcd fan ci"

CHIPSET = "bcm7335"

MACHINE_KERNEL_PR = "r1"
```

## conf/machine/iqonios200hd.conf
```bitbake
#@TYPE: Machine
#@NAME: DAGS
#@DESCRIPTION: Machine configuration for the iqon IOS 200HD

MACHINE_NAME = "IOS 200HD"
MACHINE_BRAND = "iQON"

MACHINE_ESSENTIAL_EXTRA_RDEPENDS = " \
    iqon-dvb-modules-ci \
    "

IMAGEDIR ?= "update/ios200/cfe"

require conf/machine/include/iqon.inc

MACHINE_FEATURES += "textlcd fan ci"

CHIPSET = "bcm7335"

MACHINE_KERNEL_PR = "r1"
```

## conf/machine/iqonios300hd.conf
```bitbake
#@TYPE: Machine
#@NAME: DAGS
#@DESCRIPTION: Machine configuration for the iqon IOS 300HD

MACHINE_NAME = "IOS 300HD"
MACHINE_BRAND = "iQON"

MACHINE_ESSENTIAL_EXTRA_RDEPENDS = " \
    iqon-dvb-modules \
    "

IMAGEDIR ?= "update/ios300/cfe"

require conf/machine/include/iqon.inc

MACHINE_FEATURES += "textlcd fan ci"

CHIPSET = "bcm7335"

MACHINE_KERNEL_PR = "r1"
```

## conf/machine/ixussduo.conf
```bitbake
#@TYPE: Machine
#@NAME: Ixuss Duo
#@DESCRIPTION: Machine configuration for the Ixuss Duo

MACHINE_NAME = "Duo"

IMAGEDIR ?= "medialink/ixussduo"

require conf/machine/include/ixuss.inc

MACHINE_KERNEL_PR = "r1"
```

## conf/machine/ixussone.conf
```bitbake
#@TYPE: Machine
#@NAME: Ixuss One
#@DESCRIPTION: Machine configuration for the Ixuss One

IMAGEDIR ?= "medialink/ixussone"

require conf/machine/include/ixuss.inc

MACHINE_KERNEL_PR = "r0"
```

## conf/machine/ixusszero.conf
```bitbake
#@TYPE: Machine
#@NAME: Ixuss Zero
#@DESCRIPTION: Machine configuration for the Ixuss Zero

IMAGEDIR ?= "medialink/ixusszero"

require conf/machine/include/ixuss.inc

MACHINE_KERNEL_PR = "r1"
```

## conf/machine/maram9.conf
```bitbake
#@TYPE: Machine
#@NAME: Mara M9
#@DESCRIPTION: Machine configuration for the Mara M9

require conf/machine/include/mara.inc

EXTRA_IMAGEDEPENDS += "\
	mara-backup \
	"

MACHINE_EXTRA_RDEPENDS = "\
	mara-backup \
	"

MACHINE_FEATURES += "ci fanctrl"

MACHINE_KERNEL_PR = "r5"
```

## conf/machine/mediabox.conf
```bitbake
#@TYPE: Machine
#@NAME: DAGS
#@DESCRIPTION: Machine configuration for the jepssen MediaBox HD LX

MACHINE_NAME = "MediaBox HD LX"
MACHINE_BRAND = "jepssen"

MACHINE_ESSENTIAL_EXTRA_RDEPENDS = " \
    iqon-dvb-modules \
    "

IMAGEDIR ?= "update/mediabox/cfe"

require conf/machine/include/iqon.inc

MACHINE_FEATURES += "textlcd fan ci"

CHIPSET = "bcm7335"

MACHINE_KERNEL_PR = "r1"
```

## conf/machine/odinm7.conf
```bitbake
require conf/machine/include/odin-oem.inc

EXTRA_IMAGEDEPENDS += "\
    enigma2-plugin-systemplugins-vfdcontrol \
    odin-backup \
    gigablue-vfdctl \
    "

MACHINE_EXTRA_RDEPENDS = "\
    enigma2-plugin-systemplugins-vfdcontrol \
    odin-backup \
    gigablue-vfdctl \
    "

MACHINE_FEATURES += " boxmodel videoenhancement singlecore"
	
CHIPSET = "bcm7358"
TARGET_FPU = "soft"

MACHINE_KERNEL_PR = "r3"
```

## conf/machine/odinm9.conf
```bitbake
require conf/machine/include/odin-oem.inc

EXTRA_IMAGEDEPENDS += "\
    odin-backup \
    "

MACHINE_EXTRA_RDEPENDS = "\
    odin-backup \
    "
	
MACHINE_FEATURES += " boxmodel"

CHIPSET = "bcm7413"

MACHINE_FEATURES += "ci fanctrl textlcd"

MACHINE_KERNEL_PR = "r7"
```

## conf/machine/optimussos1.conf
```bitbake
#@TYPE: Machine
#@NAME: DAGS
#@DESCRIPTION: Machine configuration for the Edision Optimuss OS1

MACHINE_NAME = "Optimuss OS1"
MACHINE_BRAND = "Edision"

MACHINE_ESSENTIAL_EXTRA_RDEPENDS = " \
    iqon-dvb-modules \
    "

IMAGEDIR ?= "update/optimussos1/cfe"

require conf/machine/include/iqon.inc

MACHINE_FEATURES += "textlcd fan ci"

CHIPSET = "bcm7335"

MACHINE_KERNEL_PR = "r1"
```
