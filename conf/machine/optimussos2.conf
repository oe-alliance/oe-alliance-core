## conf/machine/optimussos2.conf
```bitbake
#@TYPE: Machine
#@NAME: DAGS
#@DESCRIPTION: Machine configuration for the Edision Optimuss OS2

MACHINE_NAME = "Optimuss OS2"
MACHINE_BRAND = "Edision"

MACHINE_ESSENTIAL_EXTRA_RDEPENDS = " \
    iqon-dvb-modules-ci \
    "

IMAGEDIR ?= "update/optimussos2/cfe"

require conf/machine/include/iqon.inc

MACHINE_FEATURES += "textlcd fan ci"

CHIPSET = "bcm7335"

MACHINE_KERNEL_PR = "r1"
```

## conf/machine/sogno8800hd.conf
```bitbake
#@TYPE: Machine
#@NAME: Sogno 8800 HD
#@DESCRIPTION: Machine configuration for the Sogno

require conf/machine/include/sogno.inc

MACHINE_NAME = "8800HD"

MACHINE_FEATURES += "kernel32 textlcd ci dvb-c"

CHIPSET = "bcm7413"

TARGET_FPU = "hard"

MACHINE_KERNEL_PR = "r2"

IMAGEDIR ?= "sogno/8800hd"
```

## conf/machine/tm2t.conf
```bitbake
#@TYPE: Machine
#@NAME: Technomate 2T
#@DESCRIPTION: Machine configuration for the Technomate 2T

MACHINE_NAME = "2T-OE"
MACHINE_BRAND = "Technomate"

MACHINE_ESSENTIAL_EXTRA_RDEPENDS = " \
    iqon-dvb-modules \
    "

IMAGEDIR ?= "update/tm2toe/cfe"

require conf/machine/include/iqon.inc

MACHINE_FEATURES += "textlcd fan ci"

CHIPSET = "bcm7335"

MACHINE_KERNEL_PR = "r1"
```

## conf/machine/tmnano.conf
```bitbake
#@TYPE: Machine
#@NAME: DAGS
#@DESCRIPTION: Machine configuration for the Technomate Nano

MACHINE_NAME = "Nano-OE"
MACHINE_BRAND = "Technomate"

MACHINE_ESSENTIAL_EXTRA_RDEPENDS = " \
    iqon-dvb-modules \
    "

IMAGEDIR ?= "update/tmnanooe/cfe"

require conf/machine/include/iqon.inc

MACHINE_FEATURES += "textlcd fan ci"

CHIPSET = "bcm7335"

MACHINE_KERNEL_PR = "r1"
```

## conf/machine/tmnano2t.conf
```bitbake
#@TYPE: Machine
#@NAME: DAGS
#@DESCRIPTION: Machine configuration for theTechnomate Nano 2T

MACHINE_NAME = "Nano 2T"
MACHINE_BRAND = "Technomate"

MACHINE_ESSENTIAL_EXTRA_RDEPENDS = " \
    iqon-dvb-modules \
    "

IMAGEDIR ?= "update/tmnano2t/cfe"

require conf/machine/include/iqon.inc

MACHINE_FEATURES += "textlcd fan ci"

CHIPSET = "bcm7335"

MACHINE_KERNEL_PR = "r1"
```

## conf/machine/tmsingle.conf
```bitbake
#@TYPE: Machine
#@NAME: Technomate Single
#@DESCRIPTION: Machine configuration for the Technomate Single

MACHINE_NAME = "Single"
MACHINE_BRAND = "Technomate"

IMAGEDIR ?= "update/tmsingle/cfe"

require conf/machine/include/iqon.inc

MACHINE_FEATURES += "textlcd fan ci"

CHIPSET = "bcm7335"

MACHINE_KERNEL_PR = "r0"
```

## conf/machine/tmtwin.conf
```bitbake
#@TYPE: Machine
#@NAME: Technomate Twin
#@DESCRIPTION: Machine configuration for the Technomate Twin

MACHINE_NAME = "Twin-OE"
MACHINE_BRAND = "Technomate"

MACHINE_ESSENTIAL_EXTRA_RDEPENDS = " \
    iqon-dvb-modules \
    "

IMAGEDIR ?= "update/tmtwinoe/cfe"

require conf/machine/include/iqon.inc

MACHINE_FEATURES += "textlcd fan ci"

CHIPSET = "bcm7335"

MACHINE_KERNEL_PR = "r1"
```

## conf/machine/ventonhde.conf
```bitbake
#@TYPE: Machine
#@NAME: Venton HDe
#@DESCRIPTION: Machine configuration for the Venton HDe

MACHINE_BRAND = "Venton"

MACHINE_NAME = "HDe"

require conf/machine/include/ini.inc

MACHINE_ESSENTIAL_EXTRA_RDEPENDS = "\
	ini-dvb-modules-inihde \
	"
	
PREFERRED_VERSION_linux-${MACHINE} = "3.6.0"
PREFERRED_VERSION_linux-libc-headers = "3.6"

MACHINE_FEATURES += "textlcd ci"

CHIPSET = "bcm7358"

TARGET_FPU = "soft"

MACHINE_KERNEL_PR = "r4"

IMAGEDIR ?= "venton-hde"

UBI_VOLNAME = "rootfs"
MKUBIFS_ARGS = "-m 2048 -e 126976 -c 4096"
UBINIZE_ARGS = "-m 2048 -p 128KiB"

IMAGE_CMD_ubi_append = " \
	mkdir -p ${DEPLOY_DIR_IMAGE}/${IMAGEDIR}; \
	cp ${DEPLOY_DIR_IMAGE}/splash.bin ${DEPLOY_DIR_IMAGE}/${IMAGEDIR}/splash.bin; \
	mv ${DEPLOY_DIR_IMAGE}/${IMAGE_NAME}.rootfs.ubi ${DEPLOY_DIR_IMAGE}/${IMAGEDIR}/rootfs.bin; \
	gzip -f -9c ${DEPLOY_DIR_IMAGE}/vmlinux-${MACHINE}.bin > ${DEPLOY_DIR_IMAGE}/${IMAGEDIR}/kernel.bin; \
	echo ${DISTRO_NAME}-${IMAGE_VERSION}-${MACHINE}-${DATE}_usb > ${DEPLOY_DIR_IMAGE}/${IMAGEDIR}/imageversion; \
	echo "rename this file to 'force' to force an update without confirmation" > ${DEPLOY_DIR_IMAGE}/${IMAGEDIR}/noforce; \
	cd ${DEPLOY_DIR_IMAGE}; \
	zip ${IMAGE_NAME}_usb.zip ${IMAGEDIR}/*; \
	rm -f ${DEPLOY_DIR_IMAGE}/*.ubifs; \
	rm -rf ${IMAGEDIR}; \
	"
```

## conf/machine/ventonhdx.conf
```bitbake
#@TYPE: Machine
#@NAME: Venton HDx
#@DESCRIPTION: Machine configuration for the Venton HDx


require conf/machine/include/ini.inc

MACHINE_BRAND = "Venton"

MACHINE_NAME = "HDx"

MACHINE_ESSENTIAL_EXTRA_RDEPENDS = "\
	ini-dvb-modules-inihdx \
	"
	
PREFERRED_VERSION_linux-${MACHINE} = "3.6.0"
PREFERRED_VERSION_linux-libc-headers = "3.6"

MACHINE_FEATURES += "kernel32 textlcd fanctrl ci dvb-c blindscan-dvbc blindscan-dvbs"

CHIPSET = "bcm7413"

TARGET_FPU = "hard"

MACHINE_KERNEL_PR = "r3"

IMAGEDIR ?= "venton-hdx"

UBI_VOLNAME = "rootfs"
MKUBIFS_ARGS = "-m 2048 -e 126976 -c 4096"
UBINIZE_ARGS = "-m 2048 -p 128KiB"

IMAGE_CMD_ubi_append = " \
	mkdir -p ${DEPLOY_DIR_IMAGE}/${IMAGEDIR}; \
	cp ${DEPLOY_DIR_IMAGE}/splash.bin ${DEPLOY_DIR_IMAGE}/${IMAGEDIR}/splash.bin; \
	mv ${DEPLOY_DIR_IMAGE}/${IMAGE_NAME}.rootfs.ubi ${DEPLOY_DIR_IMAGE}/${IMAGEDIR}/rootfs.bin; \
	gzip -f -9c ${DEPLOY_DIR_IMAGE}/vmlinux-${MACHINE}.bin > ${DEPLOY_DIR_IMAGE}/${IMAGEDIR}/kernel.bin; \
	echo ${DISTRO_NAME}-${IMAGE_VERSION}-${MACHINE}-${DATE}_usb > ${DEPLOY_DIR_IMAGE}/${IMAGEDIR}/imageversion; \
	echo "rename this file to 'force' to force an update without confirmation" > ${DEPLOY_DIR_IMAGE}/${IMAGEDIR}/noforce; \
	cd ${DEPLOY_DIR_IMAGE}; \
	zip ${IMAGE_NAME}_usb.zip ${IMAGEDIR}/*; \
	rm -f ${DEPLOY_DIR_IMAGE}/*.ubifs; \
	rm -rf ${IMAGEDIR}; \
	"

EXTRA_IMAGEDEPENDS = "\
	enigma2-plugin-systemplugins-micomupgrade \
	"

MACHINE_EXTRA_RDEPENDS = "\
	enigma2-plugin-systemplugins-micomupgrade \
	"
```

## conf/machine/vuduo.conf
```bitbake
#@TYPE: Machine
#@NAME: Vu+ Duo
#@DESCRIPTION: Machine configuration for the Vu+ Duo

UPDATE_DIR = "duo"

require conf/machine/include/vuplus.inc

PREFERRED_VERSION_linux-vuplus = "3.1.1"
PREFERRED_VERSION_linux-libc-headers = "3.1"

MACHINE_FEATURES += "textlcd ci fanctrl"

CHIPSET = "bcm7335"

MACHINE_KERNEL_PR = "r2"
```

## conf/machine/vuduo2.conf
```bitbake
#@TYPE: Machine
#@NAME: Vu+ Duo2
#@DESCRIPTION: Machine configuration for the Vu+ Duo2

MACHINE_NAME = "Duo²"
MTD_ROOTFS = "mtd0"
MTD_KERNEL = "mtd2"
KERNEL_FILE = "kernel_cfe_auto.bin"
ROOTFS_FILE = "root_cfe_auto.bin"

UPDATE_DIR = "duo2"

require conf/machine/include/vuplus.inc

IMAGE_CMD_ubi_append = " \
    mkdir -p ${DEPLOY_DIR_IMAGE}/${IMAGEDIR}; \
    ${@base_contains("MACHINE_FEATURES", "bootsplash", "cp ${DEPLOY_DIR_IMAGE}/splash_cfe_auto.bin ${DEPLOY_DIR_IMAGE}/${IMAGEDIR}/splash_cfe_auto.bin;" , "", d)} \
    cp ${DEPLOY_DIR_IMAGE}/initrd_cfe_auto.bin ${DEPLOY_DIR_IMAGE}/${IMAGEDIR}/initrd_cfe_auto.bin; \
    mv ${DEPLOY_DIR_IMAGE}/${IMAGE_NAME}.rootfs.ubi ${DEPLOY_DIR_IMAGE}/${IMAGEDIR}/${ROOTFS_FILE}; \
    gzip -f -9c ${DEPLOY_DIR_IMAGE}/vmlinux-${MACHINE}.bin > ${DEPLOY_DIR_IMAGE}/${IMAGEDIR}/${KERNEL_FILE}; \
    echo ${DISTRO_NAME}-${DISTRO_VERSION}.${BUILD_VERSION} > ${DEPLOY_DIR_IMAGE}/${IMAGEDIR}/imageversion; \
    echo "This file forces a reboot after the update." > ${DEPLOY_DIR_IMAGE}/${IMAGEDIR}/reboot.update; \
    cd ${DEPLOY_DIR_IMAGE}; \
    zip ${IMAGE_NAME}_usb.zip ${IMAGEDIR}/*; \
    rm -f ${DEPLOY_DIR_IMAGE}/*.ubifs; \
    rm -Rf vuplus; \
    "

EXTRA_IMAGEDEPENDS = "\
    vuplus-displayvfd \
    vuplus-checkvfd \
    vuplus-initrd-cfe-vuduo2"

MACHINE_EXTRA_RDEPENDS = "\
    vuplus-coldboot \
    vuplus-ethwol \
    vuplus-displayvfd \
    vuplus-initrd-cfe-vuduo2 \
    enigma2-plugin-systemplugins-firmwareupgrade \
    enigma2-plugin-systemplugins-remotecontrolcode \
    enigma2-plugin-extensions-lcd4linux \
    enigma2-plugin-systemplugins-audioeffect \
    "

PREFERRED_VERSION_linux-vuplus = "3.3.8"
PREFERRED_VERSION_linux-libc-headers = "3.3"
MKFS_UBI_MAX_ERASE_BLK_COUNT = "8192"

MACHINE_FEATURES += "vuprogress bwlcd140 fullgraphiclcd ci dvb-c fan blindscan-dvbc blindscan-dvbs transcoding wol"

CHIPSET = "bcm7425"

MACHINE_KERNEL_PR = "r1"
```

## conf/machine/vusolo.conf
```bitbake
#@TYPE: Machine
#@NAME: Vu+ Solo
#@DESCRIPTION: Machine configuration for the Vu+ Solo

UPDATE_DIR = "solo"

require conf/machine/include/vuplus.inc

PREFERRED_VERSION_linux-vuplus = "3.1.1"
PREFERRED_VERSION_linux-libc-headers = "3.1"

MACHINE_FEATURES += "textlcd ci"

CHIPSET = "bcm7325"

MACHINE_KERNEL_PR = "r2"
```

## conf/machine/vusolo2.conf
```bitbake
#@TYPE: Machine
#@NAME: Vu+ Solo2
#@DESCRIPTION: Machine configuration for the Vu+ Solo2

UPDATE_DIR = "solo2"

require conf/machine/include/vuplus2.inc

IMAGE_CMD_ubi_prepend = " \
        cp ${IMAGE_ROOTFS}/boot/vmlinux.gz ${DEPLOY_DIR_IMAGE}/${IMAGE_NAME}.vmlinux.gz; \
        cp ${IMAGE_ROOTFS}/boot/initrd_cfe_auto.bin ${DEPLOY_DIR_IMAGE}/${IMAGE_NAME}.initrd_cfe_auto.bin; \
        cp ${IMAGE_ROOTFS}/boot/splash_cfe_auto.bin ${DEPLOY_DIR_IMAGE}/${IMAGE_NAME}.splash_cfe_auto.bin; \
        "

IMAGE_CMD_ubi_append = " \
	mkdir -p ${DEPLOY_DIR_IMAGE}/${IMAGEDIR}; \
	${@base_contains("MACHINE_FEATURES", "bootsplash", "cp ${DEPLOY_DIR_IMAGE}/splash_cfe_auto.bin ${DEPLOY_DIR_IMAGE}/${IMAGEDIR}/splash_cfe_auto.bin;" , "", d)} \
	mv ${DEPLOY_DIR_IMAGE}/${IMAGE_NAME}.rootfs.ubi ${DEPLOY_DIR_IMAGE}/${IMAGEDIR}/root_cfe_auto.jffs2; \
	gzip -f -9c ${DEPLOY_DIR_IMAGE}/vmlinux-${MACHINE}.bin > ${DEPLOY_DIR_IMAGE}/${IMAGEDIR}/kernel_cfe_auto.bin; \
	cp ${DEPLOY_DIR_IMAGE}/${IMAGE_NAME}.initrd_cfe_auto.bin ${DEPLOY_DIR_IMAGE}/${IMAGEDIR}/initrd_cfe_auto.bin; \
	echo ${DISTRO_NAME}-${DISTRO_VERSION}.${BUILD_VERSION} > ${DEPLOY_DIR_IMAGE}/${IMAGEDIR}/imageversion; \
	echo "This file forces a reboot after the update." > ${DEPLOY_DIR_IMAGE}/${IMAGEDIR}/reboot.update; \
	cd ${DEPLOY_DIR_IMAGE}; \
	zip ${IMAGE_NAME}_usb.zip ${IMAGEDIR}/*; \
	rm -f ${DEPLOY_DIR_IMAGE}/*.ubifs; \
	rm -Rf vuplus; \
	"

PREFERRED_VERSION_linux-vuplus = "3.3.6"
PREFERRED_VERSION_linux-libc-headers = "3.3"

MACHINE_FEATURES += "textlcd ci fanctrl"

CHIPSET = "bcm7356"

MACHINE_KERNEL_PR = "r2"
```

## conf/machine/vuultimo.conf
```bitbake
#@TYPE: Machine
#@NAME: Vu+ Ultimo
#@DESCRIPTION: Machine configuration for the Vu+ Ultimo

MACHINE_NAME = "Ultimo"
MTD_ROOTFS = "mtd0"
MTD_KERNEL = "mtd1"
KERNEL_FILE = "kernel_cfe_auto.bin"
ROOTFS_FILE = "root_cfe_auto.jffs2"

UPDATE_DIR = "ultimo"

require conf/machine/include/vuplus.inc

IMAGE_CMD_ubi_append = " \
    mkdir -p ${DEPLOY_DIR_IMAGE}/${IMAGEDIR}; \
    ${@base_contains("MACHINE_FEATURES", "bootsplash", "cp ${DEPLOY_DIR_IMAGE}/splash_cfe_auto.bin ${DEPLOY_DIR_IMAGE}/${IMAGEDIR}/splash_cfe_auto.bin;" , "", d)} \
    mv ${DEPLOY_DIR_IMAGE}/${IMAGE_NAME}.rootfs.ubi ${DEPLOY_DIR_IMAGE}/${IMAGEDIR}/${ROOTFS_FILE}; \
    gzip -f -9c ${DEPLOY_DIR_IMAGE}/vmlinux-${MACHINE}.bin > ${DEPLOY_DIR_IMAGE}/${IMAGEDIR}/${KERNEL_FILE}; \
    echo ${DISTRO_NAME}-${DISTRO_VERSION}.${BUILD_VERSION} > ${DEPLOY_DIR_IMAGE}/${IMAGEDIR}/imageversion; \
    echo "This file forces a reboot after the update." > ${DEPLOY_DIR_IMAGE}/${IMAGEDIR}/reboot.update; \
    cd ${DEPLOY_DIR_IMAGE}; \
    zip ${IMAGE_NAME}_usb.zip ${IMAGEDIR}/*; \
    rm -f ${DEPLOY_DIR_IMAGE}/*.ubifs; \
    rm -Rf vuplus; \
    "

EXTRA_IMAGEDEPENDS = "\
    vuplus-displayvfd \
    enigma2-plugin-systemplugins-firmwareupgrade \
    enigma2-plugin-systemplugins-remotecontrolcode \
    "

MACHINE_EXTRA_RDEPENDS = "\
    vuplus-displayvfd \
    enigma2-plugin-systemplugins-firmwareupgrade \
    enigma2-plugin-systemplugins-remotecontrolcode \
    enigma2-plugin-systemplugins-audioeffect \
    "

PREFERRED_VERSION_linux-vuplus = "3.1.1"
PREFERRED_VERSION_linux-libc-headers = "3.1"
MKFS_UBI_MAX_ERASE_BLK_COUNT = "3894"
MKFS_EXTRA = "-F"

MACHINE_FEATURES += "vuprogress bwlcd255 fullgraphiclcd ci dvb-c fan blindscan-dvbc blindscan-dvbs"

CHIPSET = "bcm7413"

MACHINE_KERNEL_PR = "r3"
```

## conf/machine/vuuno.conf
```bitbake
#@TYPE: Machine
#@NAME: Vu+ Uno
#@DESCRIPTION: Machine configuration for the Vu+ Uno

MACHINE_NAME = "Uno"

UPDATE_DIR = "uno"

require conf/machine/include/vuplus.inc

IMAGE_CMD_ubi_append = " \
	mkdir -p ${DEPLOY_DIR_IMAGE}/${IMAGEDIR}; \
	${@base_contains("MACHINE_FEATURES", "bootsplash", "cp ${DEPLOY_DIR_IMAGE}/splash_cfe_auto.bin ${DEPLOY_DIR_IMAGE}/${IMAGEDIR}/splash_cfe_auto.bin;" , "", d)} \
	mv ${DEPLOY_DIR_IMAGE}/${IMAGE_NAME}.rootfs.ubi ${DEPLOY_DIR_IMAGE}/${IMAGEDIR}/root_cfe_auto.jffs2; \
	gzip -f -9c ${DEPLOY_DIR_IMAGE}/vmlinux-${MACHINE}.bin > ${DEPLOY_DIR_IMAGE}/${IMAGEDIR}/kernel_cfe_auto.bin; \
	echo ${DISTRO_NAME}-${DISTRO_VERSION}.${BUILD_VERSION} > ${DEPLOY_DIR_IMAGE}/${IMAGEDIR}/imageversion; \
	echo "This file forces a reboot after the update." > ${DEPLOY_DIR_IMAGE}/${IMAGEDIR}/reboot.update; \
	cd ${DEPLOY_DIR_IMAGE}; \
	zip ${IMAGE_NAME}_usb.zip ${IMAGEDIR}/*; \
	rm -f ${DEPLOY_DIR_IMAGE}/*.ubifs; \
	rm -Rf vuplus; \
	"

EXTRA_IMAGEDEPENDS = "\
	vuplus-displayvfd \
"

MACHINE_EXTRA_RDEPENDS = "\
	vuplus-displayvfd \
	enigma2-plugin-systemplugins-firmwareupgrade \
	enigma2-plugin-systemplugins-remotecontrolcode \
	enigma2-plugin-systemplugins-audioeffect \
"

PREFERRED_VERSION_linux-vuplus = "3.1.1"
PREFERRED_VERSION_linux-libc-headers = "3.1"

MACHINE_FEATURES += "vuprogress textlcd ci dvb-c fan blindscan-dvbc blindscan-dvbs"

CHIPSET = "bcm7413"

MACHINE_KERNEL_PR = "r2"
```

## conf/machine/xp1000.conf
```bitbake
#@TYPE: Machine
#@NAME: xp1000
#@DESCRIPTION: Machine configuration for the MaxDigital xp1000

MACHINE_NAME = "XP1000"

CHIPSET = "bcm7358"
TARGET_FPU = "soft"

require conf/machine/include/xp.inc

MACHINE_KERNEL_PR = "r2"

EXTRA_IMAGEDEPENDS += "\
	enigma2-plugin-systemplugins-vfdcontrol \
	gigablue-vfdctl \
	"

MACHINE_EXTRA_RDEPENDS = "\
	enigma2-plugin-systemplugins-vfdcontrol \
	gigablue-vfdctl \
	"
```

## meta-brands/conf/layer.conf
```bitbake
# We have a conf and classes directory, append to BBPATH
BBPATH .= ":${LAYERDIR}"

# We have a recipes directory, add to BBFILES
BBFILES += "${LAYERDIR}/meta-*/recipes-*/*.bb ${LAYERDIR}/meta-*/recipes-*/*.bbappend \
            ${LAYERDIR}/meta-*/recipes-*/*/*.bb ${LAYERDIR}/meta-*/recipes-*/*/*.bbappend"

BBFILE_COLLECTIONS += "brands-layer"
BBFILE_PATTERN_brands-layer := "^${LAYERDIR}/"
BBFILE_PRIORITY_brands-layer = "7"

OEA-META-VENDOR-BASE := '${@os.path.normpath("${LAYERDIR}/../")}'
```
