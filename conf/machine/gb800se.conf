## conf/machine/gb800se.conf
```bitbake
#@TYPE: Machine
#@NAME: GigaBlue HD 800 SE
#@DESCRIPTION: Machine configuration for the GigaBlue HD 800 SE

MACHINE_NAME = "HD 800 SE"

require conf/machine/include/gigablue.inc

EXTRA_IMAGEDEPENDS += "\
    enigma2-plugin-systemplugins-vfdcontrol \
    gigablue-vfdctl \
    "

MACHINE_EXTRA_RDEPENDS = "\
    enigma2-plugin-systemplugins-vfdcontrol \
    "

MACHINE_FEATURES += "blindscan-dvbc blindscan-dvbs gbprogress singlecore"    
    
PREFERRED_VERSION_linux-gigablue = "3.1.1"
PREFERRED_VERSION_linux-libc-headers = "3.1"
PREFERRED_VERSION_nfs-utils ?= "1.2.8"

CHIPSET = "bcm7325"

MACHINE_KERNEL_PR = "r3"

IMAGE_FSTYPES ?= "ubi"

UBI_VOLNAME = "rootfs"
MKUBIFS_ARGS = "-m 2048 -e 126976 -c 4096"
UBINIZE_ARGS = "-m 2048 -p 128KiB"

IMAGEDIR ?= "gigablue/se"

IMAGE_CMD_ubi_prepend = " \
    rm -rf ${IMAGE_ROOTFS}/boot/*; \
    rm -rf ${IMAGE_ROOTFS}/tmp/*; \
"

IMAGE_CMD_ubi_append = " \
    mkdir -p ${DEPLOY_DIR_IMAGE}/${IMAGEDIR}; \
    cp ${DEPLOY_DIR_IMAGE}/splash.bin ${DEPLOY_DIR_IMAGE}/${IMAGEDIR}/splash.bin; \
    mv ${DEPLOY_DIR_IMAGE}/${IMAGE_NAME}.rootfs.ubi ${DEPLOY_DIR_IMAGE}/${IMAGEDIR}/${ROOTFS_FILE}; \
    gzip -f -c ${DEPLOY_DIR_IMAGE}/vmlinux-${MACHINE}.bin > ${DEPLOY_DIR_IMAGE}/${IMAGEDIR}/${KERNEL_FILE}; \
    echo ${DISTRO_NAME}-${DISTRO_VERSION}-${DATE} > ${DEPLOY_DIR_IMAGE}/${IMAGEDIR}/imageversion; \
    echo "rename this file to 'force' to force an update without confirmation" > ${DEPLOY_DIR_IMAGE}/${IMAGEDIR}/noforce; \
    cd ${DEPLOY_DIR_IMAGE}; \
    zip -r ${IMAGE_NAME}_usb.zip gigablue/*; \
    rm -f ${DEPLOY_DIR_IMAGE}/*.ubifs; \
    rm -rf ${DEPLOY_DIR_IMAGE}/gigablue; \
    "
```

## conf/machine/gb800seplus.conf
```bitbake
#@TYPE: Machine
#@NAME: Gigablue SE Plus
#@DESCRIPTION: Machine configuration for the Gigablue SE Plus

MACHINE_NAME = "SE Plus"

CHIPSET = "bcm7358"
TARGET_FPU = "soft"

require conf/machine/include/gigablue.inc

EXTRA_IMAGEDEPENDS += "\
    gigablue-initrd-${MACHINE} \
    enigma2-plugin-systemplugins-vfdcontrol \
    gigablue-vfdctl \
    "

MACHINE_EXTRA_RDEPENDS = "\
    enigma2-plugin-systemplugins-vfdcontrol \
    "

MACHINE_FEATURES += "blindscan-dvbc blindscan-dvbs gbplusprogress videoenhancement singlecore"

module_autoload_rt5370sta = "rt5370sta"
module_autoload_hid-logitech = "hid-logitech"
module_autoload_hid-logitech-dj = "hid-logitech-dj"

PREFERRED_VERSION_linux-gigablue = "3.8.7"
PREFERRED_VERSION_linux-libc-headers = "3.8"

DVBMEDIASINK_CONFIG += " --with-wma --with-pcm --with-eac3 --with-wmv"

GLIBC_EXTRA_OECONF += " --with-__thread"


MACHINE_KERNEL_PR = "r2"

IMAGE_FSTYPES ?= "ubi"

UBI_VOLNAME = "rootfs"
MKUBIFS_ARGS = "-m 2048 -e 126976 -c 4096"
UBINIZE_ARGS = "-m 2048 -p 128KiB"

IMAGEDIR ?= "gigablue/seplus"

IMAGE_CMD_ubi_prepend = " \
    rm -rf ${IMAGE_ROOTFS}/boot/*; \
    rm -rf ${IMAGE_ROOTFS}/tmp/*; \
    "

IMAGE_CMD_ubi_append = " \
    mkdir -p ${DEPLOY_DIR_IMAGE}/${IMAGEDIR}; \
    cp ${DEPLOY_DIR_IMAGE}/splash.bin ${DEPLOY_DIR_IMAGE}/${IMAGEDIR}/splash.bin; \
    cp ${DEPLOY_DIR_IMAGE}/initrd.bin ${DEPLOY_DIR_IMAGE}/${IMAGEDIR}/initrd.bin; \	
    mv ${DEPLOY_DIR_IMAGE}/${IMAGE_NAME}.rootfs.ubi ${DEPLOY_DIR_IMAGE}/${IMAGEDIR}/${ROOTFS_FILE}; \
    gzip -f -c ${DEPLOY_DIR_IMAGE}/vmlinux-${MACHINE}.bin > ${DEPLOY_DIR_IMAGE}/${IMAGEDIR}/${KERNEL_FILE}; \
    echo ${DISTRO_NAME}-${DISTRO_VERSION}.${BUILD_VERSION} > ${DEPLOY_DIR_IMAGE}/${IMAGEDIR}/imageversion; \
    echo "rename this file to 'force' to force an update without confirmation" > ${DEPLOY_DIR_IMAGE}/${IMAGEDIR}/noforce; \
    cd ${DEPLOY_DIR_IMAGE}; \
    zip -r ${IMAGE_NAME}_usb.zip gigablue/*; \
    rm -f ${DEPLOY_DIR_IMAGE}/*.ubifs; \
    rm -rf ${DEPLOY_DIR_IMAGE}/gigablue; \
    "
```

## conf/machine/gb800solo.conf
```bitbake
#@TYPE: Machine
#@NAME: GigaBlue HD 800 Solo
#@DESCRIPTION: Machine configuration for the GigaBlue HD 800 Solo

require conf/machine/include/gigablue.inc

EXTRA_IMAGEDEPENDS += "\
	enigma2-plugin-systemplugins-vfdcontrol \
	gigablue-vfdctl \
	"

MACHINE_EXTRA_RDEPENDS = " \
	enigma2-plugin-systemplugins-vfdcontrol \
	"

PREFERRED_VERSION_linux-gigablue = "3.1.1"
PREFERRED_VERSION_linux-libc-headers = "3.1"

CHIPSET = "bcm7325"

MACHINE_KERNEL_PR = "r0"

IMAGE_FSTYPES ?= "jffs2"

KERNEL_EXTRA_CMD = "--disable-compressor=lzo "

IMAGEDIR ?= "gigablue/solo"

EXTRA_IMAGECMD_jffs2 = " -e131072 -l -p125829120"
IMAGE_CMD_jffs2_prepend = " \
	rm -rf ${IMAGE_ROOTFS}/boot/*; \
	rm -rf ${IMAGE_ROOTFS}/tmp/*; \
	"

IMAGE_CMD_jffs2_append = "; \
	mkdir -p ${DEPLOY_DIR_IMAGE}/${IMAGEDIR}; \
	gzip -f -c ${DEPLOY_DIR_IMAGE}/vmlinux-${MACHINE}.bin > ${DEPLOY_DIR_IMAGE}/${IMAGEDIR}/kernel.bin; \
	mv ${DEPLOY_DIR_IMAGE}/${IMAGE_NAME}.rootfs.jffs2 ${DEPLOY_DIR_IMAGE}/${IMAGEDIR}/rootfs.bin; \
	cp ${DEPLOY_DIR_IMAGE}/burn.bat ${DEPLOY_DIR_IMAGE}/burn.bat; \
	cd ${DEPLOY_DIR_IMAGE}; \
	zip -r ${IMAGE_NAME}_usb.zip ${IMAGEDIR}/*; \
	rm -f ${DEPLOY_DIR_IMAGE}/*.jffs2; \
	rm -Rf ${IMAGEDIR}; \
	"
```

## conf/machine/gb800ue.conf
```bitbake
#@TYPE: Machine
#@NAME: GigaBlue HD 800 UE
#@DESCRIPTION: Machine configuration for the GigaBlue HD 800 UE

MACHINE_NAME = "HD 800 UE"

require conf/machine/include/gigablue.inc

EXTRA_IMAGEDEPENDS += "\
    enigma2-plugin-systemplugins-vfdcontrol \
    gigablue-vfdctl \
    "

MACHINE_EXTRA_RDEPENDS = "\
    enigma2-plugin-systemplugins-vfdcontrol \
    "

PREFERRED_VERSION_linux-gigablue = "3.1.1"
PREFERRED_VERSION_linux-libc-headers = "3.1"

MACHINE_FEATURES += "colorlcd220 gigabluelcd blindscan-dvbc blindscan-dvbs singlecore"

CHIPSET = "bcm7325"

MACHINE_KERNEL_PR = "r3"

IMAGE_FSTYPES ?= "ubi"

UBI_VOLNAME = "rootfs"
MKUBIFS_ARGS = "-m 2048 -e 126976 -c 4096"
UBINIZE_ARGS = "-m 2048 -p 128KiB"

IMAGEDIR ?= "gigablue/ue"

IMAGE_CMD_ubi_prepend = " \
    rm -rf ${IMAGE_ROOTFS}/boot/*; \
    rm -rf ${IMAGE_ROOTFS}/tmp/*; \
    "

IMAGE_CMD_ubi_append = " \
    mkdir -p ${DEPLOY_DIR_IMAGE}/${IMAGEDIR}; \
    cp ${DEPLOY_DIR_IMAGE}/splash.bin ${DEPLOY_DIR_IMAGE}/${IMAGEDIR}/splash.bin; \
    cp ${DEPLOY_DIR_IMAGE}/lcdsplash.bin ${DEPLOY_DIR_IMAGE}/${IMAGEDIR}/lcdsplash.bin; \
    cp ${DEPLOY_DIR_IMAGE}/lcdwarning.bin ${DEPLOY_DIR_IMAGE}/${IMAGEDIR}/lcdwarning.bin; \
    cp ${DEPLOY_DIR_IMAGE}/lcdwaitkey.bin ${DEPLOY_DIR_IMAGE}/${IMAGEDIR}/lcdwaitkey.bin; \
    mv ${DEPLOY_DIR_IMAGE}/${IMAGE_NAME}.rootfs.ubi ${DEPLOY_DIR_IMAGE}/${IMAGEDIR}/${ROOTFS_FILE}; \
    gzip -f -c ${DEPLOY_DIR_IMAGE}/vmlinux-${MACHINE}.bin > ${DEPLOY_DIR_IMAGE}/${IMAGEDIR}/${KERNEL_FILE}; \
    echo ${DISTRO_NAME}-${DISTRO_VERSION}-${DATE} > ${DEPLOY_DIR_IMAGE}/${IMAGEDIR}/imageversion; \
    echo "rename this file to 'force' to force an update without confirmation" > ${DEPLOY_DIR_IMAGE}/${IMAGEDIR}/noforce; \
    cd ${DEPLOY_DIR_IMAGE}; \
    zip -r ${IMAGE_NAME}_usb.zip gigablue/*; \
    rm -f ${DEPLOY_DIR_IMAGE}/*.ubifs; \
    rm -rf ${DEPLOY_DIR_IMAGE}/gigablue; \
    "
```

## conf/machine/gb800ueplus.conf
```bitbake
#@TYPE: Machine
#@NAME: GigaBlue UE Plus
#@DESCRIPTION: Machine configuration for the GigaBlue UE Plus

MACHINE_NAME = "UE Plus"

CHIPSET = "bcm7358"
TARGET_FPU = "soft"

require conf/machine/include/gigablue.inc

EXTRA_IMAGEDEPENDS += "\
    gigablue-initrd-${MACHINE} \
    enigma2-plugin-systemplugins-vfdcontrol \
    gigablue-vfdctl \
    "

MACHINE_EXTRA_RDEPENDS = "\
    enigma2-plugin-systemplugins-vfdcontrol \
    "

module_autoload_rt5370sta = "rt5370sta"
module_autoload_hid-logitech = "hid-logitech"
module_autoload_hid-logitech-dj = "hid-logitech-dj"

PREFERRED_VERSION_linux-gigablue = "3.8.7"
PREFERRED_VERSION_linux-libc-headers = "3.8"

MACHINE_FEATURES += "colorlcd220 gigabluelcd blindscan-dvbc blindscan-dvbs videoenhancement"

DVBMEDIASINK_CONFIG += "--with-wma --with-pcm --with-eac3 --with-wmv"

GLIBC_EXTRA_OECONF += " --with-__thread"


MACHINE_KERNEL_PR = "r2"

IMAGE_FSTYPES ?= "ubi"

UBI_VOLNAME = "rootfs"
MKUBIFS_ARGS = "-m 2048 -e 126976 -c 4096"
UBINIZE_ARGS = "-m 2048 -p 128KiB"

IMAGEDIR ?= "gigablue/ueplus"

IMAGE_CMD_ubi_prepend = " \
    rm -rf ${IMAGE_ROOTFS}/boot/*; \
    rm -rf ${IMAGE_ROOTFS}/tmp/*; \
    "

IMAGE_CMD_ubi_append = " \
    mkdir -p ${DEPLOY_DIR_IMAGE}/${IMAGEDIR}; \
    cp ${DEPLOY_DIR_IMAGE}/splash.bin ${DEPLOY_DIR_IMAGE}/${IMAGEDIR}/splash.bin; \
    cp ${DEPLOY_DIR_IMAGE}/lcdsplash.bin ${DEPLOY_DIR_IMAGE}/${IMAGEDIR}/lcdsplash.bin; \
    cp ${DEPLOY_DIR_IMAGE}/lcdwarning.bin ${DEPLOY_DIR_IMAGE}/${IMAGEDIR}/lcdwarning.bin; \
    cp ${DEPLOY_DIR_IMAGE}/lcdwaitkey.bin ${DEPLOY_DIR_IMAGE}/${IMAGEDIR}/lcdwaitkey.bin; \
    mv ${DEPLOY_DIR_IMAGE}/${IMAGE_NAME}.rootfs.ubi ${DEPLOY_DIR_IMAGE}/${IMAGEDIR}/${ROOTFS_FILE}; \
    gzip -f -c ${DEPLOY_DIR_IMAGE}/vmlinux-${MACHINE}.bin > ${DEPLOY_DIR_IMAGE}/${IMAGEDIR}/${KERNEL_FILE}; \
    echo ${DISTRO_NAME}-${DISTRO_VERSION}-${DATE} > ${DEPLOY_DIR_IMAGE}/${IMAGEDIR}/imageversion; \
    echo "rename this file to 'force' to force an update without confirmation" > ${DEPLOY_DIR_IMAGE}/${IMAGEDIR}/noforce; \
    cd ${DEPLOY_DIR_IMAGE}; \
    zip -r ${IMAGE_NAME}_usb.zip gigablue/*; \
    rm -f ${DEPLOY_DIR_IMAGE}/*.ubifs; \
    rm -rf ${DEPLOY_DIR_IMAGE}/gigablue; \
    "
```

## conf/machine/gbquad.conf
```bitbake
#@TYPE: Machine
#@NAME: GigaBlue HD Quad
#@DESCRIPTION: Machine configuration for the GigaBlue HD Quad

require conf/machine/include/gigablue.inc

MACHINE_ESSENTIAL_EXTRA_RRECOMMENDS += "\
	kernel-module-ext2 \
	kernel-module-ext3 \
	kernel-module-ext4 \
	"

EXTRA_IMAGEDEPENDS += "\
	enigma2-plugin-systemplugins-vfdcontrol \
	gigablue-vfdctl \
	"

MACHINE_EXTRA_RDEPENDS = "\
	enigma2-plugin-systemplugins-vfdcontrol \
	"

module_autoload_ext2 = "ext2"
module_autoload_ext3 = "ext3"
module_autoload_ext4 = "ext4"
module_autoload_rt5370sta = "rt5370sta"

PREFERRED_VERSION_linux-gigablue = "2.6.37"
PREFERRED_VERSION_linux-libc-headers = "2.6.31"
PREFERRED_VERSION_libgcc = "4.5.1"
PREFERRED_VERSION_gcc-runtime = "4.5.1"
PREFERRED_VERSION_gcc-crosssdk = "4.5.1"
PREFERRED_VERSION_gcc-crosssdk-intermediate = "4.5.1"
PREFERRED_VERSION_gcc-crosssdk-initial = "4.5.1"
PREFERRED_VERSION_gcc-cross = "4.5.1"
PREFERRED_VERSION_gcc-cross-intermediate = "4.5.1"
PREFERRED_VERSION_gcc-cross-initial = "4.5.1"
PREFERRED_VERSION_gcc-cross-canadian = "4.5.1"

MACHINE_FEATURES += "colorlcd blindscan-dvbc wifiusblegacy"

DVBMEDIASINK_CONFIG += "--with-wma --with-pcm"

CHIPSET = "bcm7346"

MACHINE_KERNEL_PR = "r5"

IMAGE_FSTYPES ?= "ubi"

UBI_VOLNAME = "rootfs"
MKUBIFS_ARGS = "-m 2048 -e 126976 -c 4000"
UBINIZE_ARGS = "-m 2048 -p 128KiB"

IMAGEDIR ?= "gigablue/quad"

IMAGE_CMD_ubi_prepend = " \
	rm -rf ${IMAGE_ROOTFS}/boot/*; \
	rm -rf ${IMAGE_ROOTFS}/tmp/*; \
	"

IMAGE_CMD_ubi_append = " \
	mkdir -p ${DEPLOY_DIR_IMAGE}/${IMAGEDIR}; \
	cp ${DEPLOY_DIR_IMAGE}/splash.bin ${DEPLOY_DIR_IMAGE}/${IMAGEDIR}/splash.bin; \
	cp ${DEPLOY_DIR_IMAGE}/lcdsplash.bin ${DEPLOY_DIR_IMAGE}/${IMAGEDIR}/lcdsplash.bin; \
	cp ${DEPLOY_DIR_IMAGE}/lcdwarning.bin ${DEPLOY_DIR_IMAGE}/${IMAGEDIR}/lcdwarning.bin; \
	cp ${DEPLOY_DIR_IMAGE}/lcdwaitkey.bin ${DEPLOY_DIR_IMAGE}/${IMAGEDIR}/lcdwaitkey.bin; \
	mv ${DEPLOY_DIR_IMAGE}/${IMAGE_NAME}.rootfs.ubi ${DEPLOY_DIR_IMAGE}/${IMAGEDIR}/rootfs.bin; \
	gzip -f -c ${DEPLOY_DIR_IMAGE}/vmlinux-${MACHINE}.bin > ${DEPLOY_DIR_IMAGE}/${IMAGEDIR}/kernel.bin; \
	echo ${DISTRO_NAME}-${DISTRO_VERSION}-${DATE} > ${DEPLOY_DIR_IMAGE}/${IMAGEDIR}/imageversion; \
	echo "rename this file to 'force' to force an update without confirmation" > ${DEPLOY_DIR_IMAGE}/${IMAGEDIR}/noforce; \
	cd ${DEPLOY_DIR_IMAGE}; \
	zip -r ${IMAGE_NAME}_usb.zip gigablue/*; \
	rm -f ${DEPLOY_DIR_IMAGE}/*.ubifs; \
	rm -rf ${DEPLOY_DIR_IMAGE}/gigablue; \
	"
```

## conf/machine/gbquattro.conf
```bitbake
#@TYPE: Machine
#@NAME: GigaBlue Quattro
#@DESCRIPTION: Machine configuration for the GigaBlue Quattro

UPDATE_DIR = "quad"

require conf/machine/include/gigablue.inc

PREFERRED_VERSION_linux-gigablue = "2.6.37"
PREFERRED_VERSION_linux-libc-headers = "2.6.31"

MACHINE_FEATURES += "colorlcd ci"

CHIPSET = "bcm7346"

MACHINE_KERNEL_PR = "r0"
```

## conf/machine/hd2400.conf
```bitbake
CHIPSET = "bcm7425"

UBI_VOLNAME = "rootfs"
MKUBIFS_ARGS = "-m 2048 -e 126976 -c 8192"
UBINIZE_ARGS = "-m 2048 -p 128KiB"

require conf/machine/include/skylake-oem.inc

MACHINE_FEATURES += "dvb-c ci fanctrl extrakernelwifi kernelrt2800 bwlcd255 videoenhancement"

MACHINE_KERNEL_PR = "r0"
```

## conf/machine/iclassm7.conf
```bitbake
#@TYPE: Machine
#@NAME: iclass SetTopBox
#@DESCRIPTION: Machine configuration for the iclass SetTopBox

EXTRA_IMAGEDEPENDS += "\
	iclass-backup \
	"

MACHINE_EXTRA_RDEPENDS = "\
	iclass-backup \
	"

CHIPSET = "bcm7358"
TARGET_FPU = "soft"

require conf/machine/include/iclass.inc

MACHINE_KERNEL_PR = "r0"
```

## conf/machine/include/autoload-dvb-usb.inc
```bitbake
module_autoload_em28xx-dvb = "em28xx-dvb"
module_autoload_dvb-as102 = "dvb-as102"
module_autoload_dvb-usb-a800 = "dvb-usb-a800"
module_autoload_dvb-usb-a867 = "dvb-usb-a867"
module_autoload_dvb-usb-af9005 = "dvb-usb-af9005"
module_autoload_dvb-usb-af9015 = "dvb-usb-af9015"
module_autoload_dvb-usb-af9035 = "dvb-usb-af9035"
module_autoload_dvb-usb-anysee = "dvb-usb-anysee"
module_autoload_dvb-usb-au6610 = "dvb-usb-au6610"
module_autoload_dvb-usb-az6027 = "dvb-usb-az6027"
module_autoload_dvb-usb-ce6230 = "dvb-usb-ce6230"
module_autoload_dvb-usb-cxusb = "dvb-usb-cxusb"
module_autoload_dvb-usb-cinergyT2 = "dvb-usb-cinergyT2"
module_autoload_dvb-usb-digitv = "dvb-usb-digitv"
module_autoload_dvb-usb-dib0700 = "dvb-usb-dib0700"
module_autoload_dvb-usb-dibusb-mb = "dvb-usb-dibusb-mb"
module_autoload_dvb-usb-dibusb-mc = "dvb-usb-dibusb-mc"
module_autoload_dvb-usb-dtv5100 = "dvb-usb-dtv5100"
module_autoload_dvb-usb-dtt200u = "dvb-usb-dtt200u"
module_autoload_dvb-usb-dw2102 = "dvb-usb-dw2102"
module_autoload_dvb-usb-ec168 = "dvb-usb-ec168"
module_autoload_dvb-usb-friio = "dvb-usb-friio"
module_autoload_dvb-usb-gl861 = "dvb-usb-gl861"
module_autoload_dvb-usb-gp8psk = "dvb-usb-gp8psk"
module_autoload_dvb-usb-it913x = "dvb-usb-it913x"
module_autoload_dvb-usb-m920x = "dvb-usb-m920x"
module_autoload_dvb-usb-opera = "dvb-usb-opera"
module_autoload_dvb-usb-pctv452e = "dvb-usb-pctv452e"
module_autoload_dvb-usb-rtl2832 = "dvb-usb-rtl2832"
module_autoload_dvb-usb-technisat-usb2 = "dvb-usb-technisat-usb2"
module_autoload_dvb-usb-ttusb2 = "dvb-usb-ttusb2"
module_autoload_dvb-ttusb-budget = "dvb-ttusb-budget"
module_autoload_dvb-usb-nova-t-usb2 = "dvb-usb-nova-t-usb2"
module_autoload_dvb-usb-umt-010 = "dvb-usb-umt-010"
module_autoload_dvb-usb-vp702x = "dvb-usb-vp702x"
module_autoload_dvb-usb-vp7045 = "dvb-usb-vp7045"
module_autoload_smsusb = "smsdvb smsusb"
```

## conf/machine/include/autoload-usbserial.inc
```bitbake
module_autoload_usbserial = "usbserial"
module_autoload_ftdi_sio = "ftdi_sio"
module_autoload_pl2303 = "pl2303"
module_autoload_belkin_sa = "belkin_sa"
module_autoload_keyspan = "keyspan"
```

## conf/machine/include/autoload-wifi.inc
```bitbake
module_autoload_ath9k = "ath9k"
module_autoload_ath9k_htc = "ath9k_htc"
module_autoload_carl9170 = "carl9170"
module_autoload_prism2_usb = "prism2_usb"
module_autoload_rt73usb = "rt73usb"
module_autoload_rt2500usb = "rt2500usb"
module_autoload_rt2800usb = "rt2800usb"
module_autoload_r8192u_usb = "r8192u_usb"
module_autoload_rtl8192cu = "rtl8192cu"
module_autoload_rtl8187 = "rtl8187"
module_autoload_r8712u = "r8712u"
module_autoload_w35und = "w35und"
module_autoload_zd1211rw = "zd1211rw"
```
